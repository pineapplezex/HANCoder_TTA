/******************************************************************************
* ASAP2 file: HANcoder_E407_TTA_Controller_v2.a2l
* Academic License - for use in teaching, academic research, and meeting
* course requirements at degree granting institutions only. Not for
* government, commercial, or other organizational use.
* Code generation for model "HANcoder_E407_TTA_Controller_v2".
* Model version : 1.87
* Simulink Coder version : 9.0 (R2018b) 24-May-2018
* C source code generated on : Mon Jan 3 18:30:06 2022
* Target selection: ert.tlc
* Embedded hardware selection: ARM Compatible->ARM Cortex
* Code generation objectives: Unspecified
* Validation result: Not run
* (add additional file header information here)
******************************************************************************/ ASAP2_VERSION 1 31
/* Version 1.31 */
/begin PROJECT ProjectName "HANcoder_E407_TTA_Controller_v2_softwareID_v1_030122_182904"
/begin HEADER "Header Comments go here" /end HEADER
/begin MODULE ModuleName "Module Comment Goes Here"
/begin MOD_PAR "MOD PAR Comment Goes Here" ADDR_EPK 0x0800c8cc CPU_TYPE "STM32F407" ECU "E407" EPK "HANcoder_E407_TTA_Controller_v2_softwareID_v1_030122_182904"
 SYSTEM_CONSTANT "XcpStationID string length" "0x0000003b"
 SYSTEM_CONSTANT "RAM-FlashOffset" "-402496992" /end MOD_PAR
/begin MOD_COMMON "Mod Common Comment Here" BYTE_ORDER MSB_LAST /end MOD_COMMON
/begin RECORD_LAYOUT Scalar_BOOLEAN FNC_VALUES 1 UBYTE COLUMN_DIR DIRECT /end RECORD_LAYOUT
/begin RECORD_LAYOUT Scalar_UBYTE FNC_VALUES 1 UBYTE COLUMN_DIR DIRECT /end RECORD_LAYOUT
/begin RECORD_LAYOUT Scalar_BYTE FNC_VALUES 1 SBYTE COLUMN_DIR DIRECT /end RECORD_LAYOUT
/begin RECORD_LAYOUT Scalar_UWORD FNC_VALUES 1 UWORD COLUMN_DIR DIRECT /end RECORD_LAYOUT
/begin RECORD_LAYOUT Scalar_SWORD FNC_VALUES 1 SWORD COLUMN_DIR DIRECT /end RECORD_LAYOUT
/begin RECORD_LAYOUT Scalar_ULONG FNC_VALUES 1 ULONG COLUMN_DIR DIRECT /end RECORD_LAYOUT
/begin RECORD_LAYOUT Scalar_LONG FNC_VALUES 1 SLONG COLUMN_DIR DIRECT /end RECORD_LAYOUT
/begin RECORD_LAYOUT Scalar_FLOAT32_IEEE FNC_VALUES 1 FLOAT32_IEEE COLUMN_DIR DIRECT /end RECORD_LAYOUT
/begin RECORD_LAYOUT Scalar_FLOAT64_IEEE FNC_VALUES 1 FLOAT64_IEEE COLUMN_DIR DIRECT /end RECORD_LAYOUT
/begin RECORD_LAYOUT Lookup1D_BYTE FNC_VALUES 1 SBYTE COLUMN_DIR DIRECT /end RECORD_LAYOUT
/begin RECORD_LAYOUT Lookup1D_X_BYTE AXIS_PTS_X 1 SBYTE INDEX_INCR DIRECT /end RECORD_LAYOUT
/begin RECORD_LAYOUT Lookup1D_UBYTE FNC_VALUES 1 UBYTE COLUMN_DIR DIRECT /end RECORD_LAYOUT
/begin RECORD_LAYOUT Lookup1D_X_UBYTE AXIS_PTS_X 1 UBYTE INDEX_INCR DIRECT /end RECORD_LAYOUT
/begin RECORD_LAYOUT Lookup1D_UWORD FNC_VALUES 1 UWORD COLUMN_DIR DIRECT /end RECORD_LAYOUT
/begin RECORD_LAYOUT Lookup1D_X_UWORD AXIS_PTS_X 1 UWORD INDEX_INCR DIRECT /end RECORD_LAYOUT
/begin RECORD_LAYOUT Lookup1D_WORD FNC_VALUES 1 SWORD COLUMN_DIR DIRECT /end RECORD_LAYOUT
/begin RECORD_LAYOUT Lookup1D_X_WORD AXIS_PTS_X 1 SWORD INDEX_INCR DIRECT /end RECORD_LAYOUT
/begin RECORD_LAYOUT Lookup1D_ULONG FNC_VALUES 1 ULONG COLUMN_DIR DIRECT /end RECORD_LAYOUT
/begin RECORD_LAYOUT Lookup1D_X_ULONG AXIS_PTS_X 1 ULONG INDEX_INCR DIRECT /end RECORD_LAYOUT
/begin RECORD_LAYOUT Lookup1D_SLONG FNC_VALUES 1 SLONG COLUMN_DIR DIRECT /end RECORD_LAYOUT
/begin RECORD_LAYOUT Lookup1D_X_LONG AXIS_PTS_X 1 SLONG INDEX_INCR DIRECT /end RECORD_LAYOUT
/begin RECORD_LAYOUT Lookup1D_FLOAT32_IEEE FNC_VALUES 1 FLOAT32_IEEE COLUMN_DIR DIRECT /end RECORD_LAYOUT
/begin RECORD_LAYOUT Lookup1D_X_FLOAT32_IEEE AXIS_PTS_X 1 FLOAT32_IEEE INDEX_INCR DIRECT /end RECORD_LAYOUT
/begin RECORD_LAYOUT Lookup1D_FLOAT64_IEEE FNC_VALUES 1 FLOAT64_IEEE COLUMN_DIR DIRECT /end RECORD_LAYOUT
/begin RECORD_LAYOUT Lookup1D_X_FLOAT64_IEEE AXIS_PTS_X 1 FLOAT64_IEEE INDEX_INCR DIRECT /end RECORD_LAYOUT
/begin RECORD_LAYOUT Lookup2D_UBYTE FNC_VALUES 1 UBYTE COLUMN_DIR DIRECT /end RECORD_LAYOUT
/begin RECORD_LAYOUT Lookup2D_X_UBYTE AXIS_PTS_X 1 UBYTE INDEX_INCR DIRECT /end RECORD_LAYOUT
/begin RECORD_LAYOUT Lookup2D_BYTE FNC_VALUES 1 SBYTE COLUMN_DIR DIRECT /end RECORD_LAYOUT
/begin RECORD_LAYOUT Lookup2D_X_BYTE AXIS_PTS_X 1 SBYTE INDEX_INCR DIRECT /end RECORD_LAYOUT
/begin RECORD_LAYOUT Lookup2D_UWORD FNC_VALUES 1 UWORD COLUMN_DIR DIRECT /end RECORD_LAYOUT
/begin RECORD_LAYOUT Lookup2D_X_UWORD AXIS_PTS_X 1 UWORD INDEX_INCR DIRECT /end RECORD_LAYOUT
/begin RECORD_LAYOUT Lookup2D_WORD FNC_VALUES 1 SWORD COLUMN_DIR DIRECT /end RECORD_LAYOUT
/begin RECORD_LAYOUT Lookup2D_X_WORD AXIS_PTS_X 1 SWORD INDEX_INCR DIRECT /end RECORD_LAYOUT
/begin RECORD_LAYOUT Lookup2D_ULONG FNC_VALUES 1 ULONG COLUMN_DIR DIRECT /end RECORD_LAYOUT
/begin RECORD_LAYOUT Lookup2D_X_ULONG AXIS_PTS_X 1 ULONG INDEX_INCR DIRECT /end RECORD_LAYOUT
/begin RECORD_LAYOUT Lookup2D_LONG FNC_VALUES 1 SLONG COLUMN_DIR DIRECT /end RECORD_LAYOUT
/begin RECORD_LAYOUT Lookup2D_X_LONG AXIS_PTS_X 1 SLONG INDEX_INCR DIRECT /end RECORD_LAYOUT
/begin RECORD_LAYOUT Lookup2D_FLOAT32_IEEE FNC_VALUES 1 FLOAT32_IEEE COLUMN_DIR DIRECT /end RECORD_LAYOUT
/begin RECORD_LAYOUT Lookup2D_X_FLOAT32_IEEE AXIS_PTS_X 1 FLOAT32_IEEE INDEX_INCR DIRECT /end RECORD_LAYOUT
/begin RECORD_LAYOUT Lookup2D_FLOAT64_IEEE FNC_VALUES 1 FLOAT64_IEEE COLUMN_DIR DIRECT /end RECORD_LAYOUT
/begin RECORD_LAYOUT Lookup2D_X_FLOAT64_IEEE AXIS_PTS_X 1 FLOAT64_IEEE INDEX_INCR DIRECT /end RECORD_LAYOUT
/begin CHARACTERISTIC speed_k_d "" VALUE 0x20000038 Scalar_FLOAT64_IEEE 0 HANcoder_E407_TTA_Controller_v2_CM_double -1.7E+308 1.7E+308 /end CHARACTERISTIC
/begin CHARACTERISTIC speed_k_i "" VALUE 0x20000040 Scalar_FLOAT64_IEEE 0 HANcoder_E407_TTA_Controller_v2_CM_double -1.7E+308 1.7E+308 /end CHARACTERISTIC
/begin CHARACTERISTIC speed_k_p "" VALUE 0x20000048 Scalar_FLOAT64_IEEE 0 HANcoder_E407_TTA_Controller_v2_CM_double -1.7E+308 1.7E+308 /end CHARACTERISTIC
/begin CHARACTERISTIC torque_a_k_d "" VALUE 0x20000008 Scalar_FLOAT64_IEEE 0 HANcoder_E407_TTA_Controller_v2_CM_double -1.7E+308 1.7E+308 /end CHARACTERISTIC
/begin CHARACTERISTIC torque_a_k_i "" VALUE 0x20000010 Scalar_FLOAT64_IEEE 0 HANcoder_E407_TTA_Controller_v2_CM_double -1.7E+308 1.7E+308 /end CHARACTERISTIC
/begin CHARACTERISTIC torque_a_k_p "" VALUE 0x20000020 Scalar_FLOAT64_IEEE 0 HANcoder_E407_TTA_Controller_v2_CM_double -1.7E+308 1.7E+308 /end CHARACTERISTIC
/begin CHARACTERISTIC torque_f_k_d "" VALUE 0x20000028 Scalar_FLOAT64_IEEE 0 HANcoder_E407_TTA_Controller_v2_CM_double -1.7E+308 1.7E+308 /end CHARACTERISTIC
/begin CHARACTERISTIC torque_f_k_i "" VALUE 0x20000018 Scalar_FLOAT64_IEEE 0 HANcoder_E407_TTA_Controller_v2_CM_double -1.7E+308 1.7E+308 /end CHARACTERISTIC
/begin CHARACTERISTIC torque_f_k_p "" VALUE 0x20000030 Scalar_FLOAT64_IEEE 0 HANcoder_E407_TTA_Controller_v2_CM_double -1.7E+308 1.7E+308 /end CHARACTERISTIC
/begin CHARACTERISTIC HANtuneOverride "" VALUE 0x20000003 Scalar_BOOLEAN 0 HANcoder_E407_TTA_Controller_v2_CM_boolean 0 1 /end CHARACTERISTIC
/begin MEASUREMENT simulation_time "" FLOAT64_IEEE HANcoder_E407_TTA_Controller_v2_CM_double 0 0 -1.7E+308 1.7E+308 ECU_ADDRESS 0x2000c128 /end MEASUREMENT
/begin MEASUREMENT Board_ID_s "" FLOAT64_IEEE HANcoder_E407_TTA_Controller_v2_CM_double 0 0 -1.7E+308 1.7E+308 ECU_ADDRESS 0x2000bf30 /end MEASUREMENT
/begin MEASUREMENT SI_FreeHeap "" ULONG HANcoder_E407_TTA_Controller_v2_CM_uint32 0 0 0 4294967295 ECU_ADDRESS 0x2000c014 /end MEASUREMENT
/begin MEASUREMENT SI_FreeStack "" ULONG HANcoder_E407_TTA_Controller_v2_CM_uint32 0 0 0 4294967295 ECU_ADDRESS 0x2000c170 /end MEASUREMENT
/begin MEASUREMENT local_ticks_interrupt "" UWORD HANcoder_E407_TTA_Controller_v2_CM_uint16 0 0 0 65535 ECU_ADDRESS 0x2000c50a /end MEASUREMENT
/begin MEASUREMENT SI_CPUload "" UBYTE HANcoder_E407_TTA_Controller_v2_CM_uint8 0 0 0 255 ECU_ADDRESS 0x2000c49a /end MEASUREMENT
/begin MEASUREMENT LedValue "" UBYTE HANcoder_E407_TTA_Controller_v2_CM_boolean 0 0 0 1 ECU_ADDRESS 0x2000c059 /end MEASUREMENT
/begin MEASUREMENT Master_ID_s "" FLOAT64_IEEE HANcoder_E407_TTA_Controller_v2_CM_double 0 0 -1.7E+308 1.7E+308 ECU_ADDRESS 0x2000c050 /end MEASUREMENT
/begin MEASUREMENT Role_ID_s "" FLOAT64_IEEE HANcoder_E407_TTA_Controller_v2_CM_double 0 0 -1.7E+308 1.7E+308 ECU_ADDRESS 0x2000bb78 /end MEASUREMENT
/begin MEASUREMENT votes_Board_1_DEBUG "" FLOAT64_IEEE HANcoder_E407_TTA_Controller_v2_CM_double 0 0 -1.7E+308 1.7E+308 ECU_ADDRESS 0x2000c4f0 /end MEASUREMENT
/begin MEASUREMENT votes_Board_2_DEBUG "" FLOAT64_IEEE HANcoder_E407_TTA_Controller_v2_CM_double 0 0 -1.7E+308 1.7E+308 ECU_ADDRESS 0x2000c4a8 /end MEASUREMENT
/begin MEASUREMENT votes_Board_3_DEBUG "" FLOAT64_IEEE HANcoder_E407_TTA_Controller_v2_CM_double 0 0 -1.7E+308 1.7E+308 ECU_ADDRESS 0x2000bf70 /end MEASUREMENT
/begin MEASUREMENT Board_1_error_counter_s "" FLOAT64_IEEE HANcoder_E407_TTA_Controller_v2_CM_double 0 0 -1.7E+308 1.7E+308 ECU_ADDRESS 0x2000bfe0 /end MEASUREMENT
/begin MEASUREMENT Board_2_error_counter_s "" FLOAT64_IEEE HANcoder_E407_TTA_Controller_v2_CM_double 0 0 -1.7E+308 1.7E+308 ECU_ADDRESS 0x2000bbb8 /end MEASUREMENT
/begin MEASUREMENT Board_3_error_counter_s "" FLOAT64_IEEE HANcoder_E407_TTA_Controller_v2_CM_double 0 0 -1.7E+308 1.7E+308 ECU_ADDRESS 0x2000c438 /end MEASUREMENT
/begin MEASUREMENT msg_count_DEBUG_s "" FLOAT64_IEEE HANcoder_E407_TTA_Controller_v2_CM_double 0 0 -1.7E+308 1.7E+308 ECU_ADDRESS 0x2000bf98 /end MEASUREMENT
/begin MEASUREMENT Desync_Sync_bc1_s "" FLOAT64_IEEE HANcoder_E407_TTA_Controller_v2_CM_double 0 0 -1.7E+308 1.7E+308 ECU_ADDRESS 0x2000c0c0 /end MEASUREMENT
/begin MEASUREMENT expected_LT_setvalues_CAN1_s "" FLOAT64_IEEE HANcoder_E407_TTA_Controller_v2_CM_double 0 0 -1.7E+308 1.7E+308 ECU_ADDRESS 0x2000bbe0 /end MEASUREMENT
/begin MEASUREMENT expected_LT_setvalues_CAN2_s "" FLOAT64_IEEE HANcoder_E407_TTA_Controller_v2_CM_double 0 0 -1.7E+308 1.7E+308 ECU_ADDRESS 0x2000c028 /end MEASUREMENT
/begin MEASUREMENT Desync_setvalues_s "" FLOAT64_IEEE HANcoder_E407_TTA_Controller_v2_CM_double 0 0 -1.7E+308 1.7E+308 ECU_ADDRESS 0x2000c148 /end MEASUREMENT
/begin MEASUREMENT Rx_temporal_setvalues_CAN2 "" FLOAT64_IEEE HANcoder_E407_TTA_Controller_v2_CM_double 0 0 -1.7E+308 1.7E+308 ECU_ADDRESS 0x2000c198 /end MEASUREMENT
/begin MEASUREMENT Rx_temporal_setvalues_CAN1 "" FLOAT64_IEEE HANcoder_E407_TTA_Controller_v2_CM_double 0 0 -1.7E+308 1.7E+308 ECU_ADDRESS 0x2000bba8 /end MEASUREMENT
/begin MEASUREMENT expected_LT_sensorvalues_CAN1_s "" FLOAT64_IEEE HANcoder_E407_TTA_Controller_v2_CM_double 0 0 -1.7E+308 1.7E+308 ECU_ADDRESS 0x2000bb10 /end MEASUREMENT
/begin MEASUREMENT expected_LT_sensorvalues_CAN2_s "" FLOAT64_IEEE HANcoder_E407_TTA_Controller_v2_CM_double 0 0 -1.7E+308 1.7E+308 ECU_ADDRESS 0x2000c118 /end MEASUREMENT
/begin MEASUREMENT Desync_sensorvalues_s "" FLOAT64_IEEE HANcoder_E407_TTA_Controller_v2_CM_double 0 0 -1.7E+308 1.7E+308 ECU_ADDRESS 0x2000c008 /end MEASUREMENT
/begin MEASUREMENT Rx_temporal_sensorvalues_CAN2 "" FLOAT64_IEEE HANcoder_E407_TTA_Controller_v2_CM_double 0 0 -1.7E+308 1.7E+308 ECU_ADDRESS 0x2000c510 /end MEASUREMENT
/begin MEASUREMENT Rx_temporal_sensorvalues_CAN1 "" FLOAT64_IEEE HANcoder_E407_TTA_Controller_v2_CM_double 0 0 -1.7E+308 1.7E+308 ECU_ADDRESS 0x2000c518 /end MEASUREMENT
/begin MEASUREMENT expected_LT_outemulator_CAN1_s "" FLOAT64_IEEE HANcoder_E407_TTA_Controller_v2_CM_double 0 0 -1.7E+308 1.7E+308 ECU_ADDRESS 0x2000bb48 /end MEASUREMENT
/begin MEASUREMENT expected_LT_outemulator_CAN2_s "" FLOAT64_IEEE HANcoder_E407_TTA_Controller_v2_CM_double 0 0 -1.7E+308 1.7E+308 ECU_ADDRESS 0x2000bb00 /end MEASUREMENT
/begin MEASUREMENT Desync_outemulator_s "" FLOAT64_IEEE HANcoder_E407_TTA_Controller_v2_CM_double 0 0 -1.7E+308 1.7E+308 ECU_ADDRESS 0x2000bb58 /end MEASUREMENT
/begin MEASUREMENT Rx_temporal_outemulator_CAN2 "" FLOAT64_IEEE HANcoder_E407_TTA_Controller_v2_CM_double 0 0 -1.7E+308 1.7E+308 ECU_ADDRESS 0x2000c0b8 /end MEASUREMENT
/begin MEASUREMENT Rx_temporal_outemulator_CAN1 "" FLOAT64_IEEE HANcoder_E407_TTA_Controller_v2_CM_double 0 0 -1.7E+308 1.7E+308 ECU_ADDRESS 0x2000bf18 /end MEASUREMENT
/begin MEASUREMENT expected_LT_outcontrol2_CAN1_s "" FLOAT64_IEEE HANcoder_E407_TTA_Controller_v2_CM_double 0 0 -1.7E+308 1.7E+308 ECU_ADDRESS 0x2000bb88 /end MEASUREMENT
/begin MEASUREMENT expected_LT_outcontrol2_CAN2_s "" FLOAT64_IEEE HANcoder_E407_TTA_Controller_v2_CM_double 0 0 -1.7E+308 1.7E+308 ECU_ADDRESS 0x2000bfe8 /end MEASUREMENT
/begin MEASUREMENT Desync_outcontrol2_s "" FLOAT64_IEEE HANcoder_E407_TTA_Controller_v2_CM_double 0 0 -1.7E+308 1.7E+308 ECU_ADDRESS 0x2000c490 /end MEASUREMENT
/begin MEASUREMENT Rx_temporal_outcontrol2_CAN2 "" FLOAT64_IEEE HANcoder_E407_TTA_Controller_v2_CM_double 0 0 -1.7E+308 1.7E+308 ECU_ADDRESS 0x2000c178 /end MEASUREMENT
/begin MEASUREMENT Rx_temporal_outcontrol2_CAN1 "" FLOAT64_IEEE HANcoder_E407_TTA_Controller_v2_CM_double 0 0 -1.7E+308 1.7E+308 ECU_ADDRESS 0x2000bff8 /end MEASUREMENT
/begin MEASUREMENT expected_LT_outcontrol1_CAN1_s "" FLOAT64_IEEE HANcoder_E407_TTA_Controller_v2_CM_double 0 0 -1.7E+308 1.7E+308 ECU_ADDRESS 0x2000c4a0 /end MEASUREMENT
/begin MEASUREMENT expected_LT_outcontrol1_CAN2_s "" FLOAT64_IEEE HANcoder_E407_TTA_Controller_v2_CM_double 0 0 -1.7E+308 1.7E+308 ECU_ADDRESS 0x2000c0e0 /end MEASUREMENT
/begin MEASUREMENT Desync_outcontrol1_s "" FLOAT64_IEEE HANcoder_E407_TTA_Controller_v2_CM_double 0 0 -1.7E+308 1.7E+308 ECU_ADDRESS 0x2000c448 /end MEASUREMENT
/begin MEASUREMENT Rx_temporal_outcontrol1_CAN2 "" FLOAT64_IEEE HANcoder_E407_TTA_Controller_v2_CM_double 0 0 -1.7E+308 1.7E+308 ECU_ADDRESS 0x2000bb90 /end MEASUREMENT
/begin MEASUREMENT Rx_temporal_outcontrol1_CAN1 "" FLOAT64_IEEE HANcoder_E407_TTA_Controller_v2_CM_double 0 0 -1.7E+308 1.7E+308 ECU_ADDRESS 0x2000bb18 /end MEASUREMENT
/begin MEASUREMENT theta_fr_stored_s "" FLOAT64_IEEE HANcoder_E407_TTA_Controller_v2_CM_double 0 0 -1.7E+308 1.7E+308 ECU_ADDRESS 0x2000c478 /end MEASUREMENT
/begin MEASUREMENT theta_fl_stored_s "" FLOAT64_IEEE HANcoder_E407_TTA_Controller_v2_CM_double 0 0 -1.7E+308 1.7E+308 ECU_ADDRESS 0x2000bf88 /end MEASUREMENT
/begin MEASUREMENT delta_dot_f_s "" FLOAT64_IEEE HANcoder_E407_TTA_Controller_v2_CM_double 0 0 -1.7E+308 1.7E+308 ECU_ADDRESS 0x2000bb20 /end MEASUREMENT
/begin MEASUREMENT theta_ar_stored_s "" FLOAT64_IEEE HANcoder_E407_TTA_Controller_v2_CM_double 0 0 -1.7E+308 1.7E+308 ECU_ADDRESS 0x2000c450 /end MEASUREMENT
/begin MEASUREMENT theta_al_stored_s "" FLOAT64_IEEE HANcoder_E407_TTA_Controller_v2_CM_double 0 0 -1.7E+308 1.7E+308 ECU_ADDRESS 0x2000c078 /end MEASUREMENT
/begin MEASUREMENT delta_dot_a_s "" FLOAT64_IEEE HANcoder_E407_TTA_Controller_v2_CM_double 0 0 -1.7E+308 1.7E+308 ECU_ADDRESS 0x2000bf78 /end MEASUREMENT
/begin MEASUREMENT delta_f_est_current_s "" FLOAT64_IEEE HANcoder_E407_TTA_Controller_v2_CM_double 0 0 -1.7E+308 1.7E+308 ECU_ADDRESS 0x2000c188 /end MEASUREMENT
/begin MEASUREMENT delta_dot_f_prev_s "" FLOAT64_IEEE HANcoder_E407_TTA_Controller_v2_CM_double 0 0 -1.7E+308 1.7E+308 ECU_ADDRESS 0x2000bfb8 /end MEASUREMENT
/begin MEASUREMENT rx_data_t_steerF_s "" FLOAT64_IEEE HANcoder_E407_TTA_Controller_v2_CM_double 0 0 -1.7E+308 1.7E+308 ECU_ADDRESS 0x2000bf40 /end MEASUREMENT
/begin MEASUREMENT delta_f_est_s "" FLOAT64_IEEE HANcoder_E407_TTA_Controller_v2_CM_double 0 0 -1.7E+308 1.7E+308 ECU_ADDRESS 0x2000c038 /end MEASUREMENT
/begin MEASUREMENT delta_a_est_current_s "" FLOAT64_IEEE HANcoder_E407_TTA_Controller_v2_CM_double 0 0 -1.7E+308 1.7E+308 ECU_ADDRESS 0x2000bfc8 /end MEASUREMENT
/begin MEASUREMENT delta_dot_a_prev_s "" FLOAT64_IEEE HANcoder_E407_TTA_Controller_v2_CM_double 0 0 -1.7E+308 1.7E+308 ECU_ADDRESS 0x2000bfa8 /end MEASUREMENT
/begin MEASUREMENT rx_data_t_steerA_s "" FLOAT64_IEEE HANcoder_E407_TTA_Controller_v2_CM_double 0 0 -1.7E+308 1.7E+308 ECU_ADDRESS 0x2000bb68 /end MEASUREMENT
/begin MEASUREMENT delta_a_est_s "" FLOAT64_IEEE HANcoder_E407_TTA_Controller_v2_CM_double 0 0 -1.7E+308 1.7E+308 ECU_ADDRESS 0x2000c048 /end MEASUREMENT
/begin MEASUREMENT v_est_s "" FLOAT64_IEEE HANcoder_E407_TTA_Controller_v2_CM_double 0 0 -1.7E+308 1.7E+308 ECU_ADDRESS 0x2000c108 /end MEASUREMENT
/begin MEASUREMENT v_integral_s "" FLOAT64_IEEE HANcoder_E407_TTA_Controller_v2_CM_double 0 0 -1.7E+308 1.7E+308 ECU_ADDRESS 0x2000bb38 /end MEASUREMENT
/begin MEASUREMENT v_ctreff_s "" FLOAT64_IEEE HANcoder_E407_TTA_Controller_v2_CM_double 0 0 -1.7E+308 1.7E+308 ECU_ADDRESS 0x2000c168 /end MEASUREMENT
/begin MEASUREMENT torque_fr_set_s "" FLOAT64_IEEE HANcoder_E407_TTA_Controller_v2_CM_double 0 0 -1.7E+308 1.7E+308 ECU_ADDRESS 0x2000c138 /end MEASUREMENT
/begin MEASUREMENT torque_fl_set_s "" FLOAT64_IEEE HANcoder_E407_TTA_Controller_v2_CM_double 0 0 -1.7E+308 1.7E+308 ECU_ADDRESS 0x2000bf50 /end MEASUREMENT
/begin MEASUREMENT torque_ar_set_s "" FLOAT64_IEEE HANcoder_E407_TTA_Controller_v2_CM_double 0 0 -1.7E+308 1.7E+308 ECU_ADDRESS 0x2000c090 /end MEASUREMENT
/begin MEASUREMENT torque_al_set_s "" FLOAT64_IEEE HANcoder_E407_TTA_Controller_v2_CM_double 0 0 -1.7E+308 1.7E+308 ECU_ADDRESS 0x2000c488 /end MEASUREMENT
/begin MEASUREMENT expected_LT_vote3_CAN1_s "" FLOAT64_IEEE HANcoder_E407_TTA_Controller_v2_CM_double 0 0 -1.7E+308 1.7E+308 ECU_ADDRESS 0x2000c4c8 /end MEASUREMENT
/begin MEASUREMENT expected_LT_vote3_CAN2_s "" FLOAT64_IEEE HANcoder_E407_TTA_Controller_v2_CM_double 0 0 -1.7E+308 1.7E+308 ECU_ADDRESS 0x2000c088 /end MEASUREMENT
/begin MEASUREMENT Desync_Vote3_s "" FLOAT64_IEEE HANcoder_E407_TTA_Controller_v2_CM_double 0 0 -1.7E+308 1.7E+308 ECU_ADDRESS 0x2000bb98 /end MEASUREMENT
/begin MEASUREMENT Rx_temporal_vote3_CAN2 "" FLOAT64_IEEE HANcoder_E407_TTA_Controller_v2_CM_double 0 0 -1.7E+308 1.7E+308 ECU_ADDRESS 0x2000c0d8 /end MEASUREMENT
/begin MEASUREMENT Rx_temporal_vote3_CAN1 "" FLOAT64_IEEE HANcoder_E407_TTA_Controller_v2_CM_double 0 0 -1.7E+308 1.7E+308 ECU_ADDRESS 0x2000c4b8 /end MEASUREMENT
/begin MEASUREMENT expected_LT_vote2_CAN1_s "" FLOAT64_IEEE HANcoder_E407_TTA_Controller_v2_CM_double 0 0 -1.7E+308 1.7E+308 ECU_ADDRESS 0x2000bf60 /end MEASUREMENT
/begin MEASUREMENT expected_LT_vote2_CAN2_s "" FLOAT64_IEEE HANcoder_E407_TTA_Controller_v2_CM_double 0 0 -1.7E+308 1.7E+308 ECU_ADDRESS 0x2000bbe8 /end MEASUREMENT
/begin MEASUREMENT Desync_Vote2_s "" FLOAT64_IEEE HANcoder_E407_TTA_Controller_v2_CM_double 0 0 -1.7E+308 1.7E+308 ECU_ADDRESS 0x2000bb80 /end MEASUREMENT
/begin MEASUREMENT Rx_temporal_vote2_CAN2 "" FLOAT64_IEEE HANcoder_E407_TTA_Controller_v2_CM_double 0 0 -1.7E+308 1.7E+308 ECU_ADDRESS 0x2000c0e8 /end MEASUREMENT
/begin MEASUREMENT Rx_temporal_vote2_CAN1 "" FLOAT64_IEEE HANcoder_E407_TTA_Controller_v2_CM_double 0 0 -1.7E+308 1.7E+308 ECU_ADDRESS 0x2000c4e8 /end MEASUREMENT
/begin MEASUREMENT expected_LT_vote1_CAN1_s "" FLOAT64_IEEE HANcoder_E407_TTA_Controller_v2_CM_double 0 0 -1.7E+308 1.7E+308 ECU_ADDRESS 0x2000c140 /end MEASUREMENT
/begin MEASUREMENT expected_LT_vote1_CAN2_s "" FLOAT64_IEEE HANcoder_E407_TTA_Controller_v2_CM_double 0 0 -1.7E+308 1.7E+308 ECU_ADDRESS 0x2000c0f8 /end MEASUREMENT
/begin MEASUREMENT Desync_Vote1_s "" FLOAT64_IEEE HANcoder_E407_TTA_Controller_v2_CM_double 0 0 -1.7E+308 1.7E+308 ECU_ADDRESS 0x2000c460 /end MEASUREMENT
/begin MEASUREMENT Rx_temporal_vote1_CAN2 "" FLOAT64_IEEE HANcoder_E407_TTA_Controller_v2_CM_double 0 0 -1.7E+308 1.7E+308 ECU_ADDRESS 0x2000c068 /end MEASUREMENT
/begin MEASUREMENT Rx_temporal_vote1_CAN1 "" FLOAT64_IEEE HANcoder_E407_TTA_Controller_v2_CM_double 0 0 -1.7E+308 1.7E+308 ECU_ADDRESS 0x2000bfd0 /end MEASUREMENT
/begin MEASUREMENT Desync_Sync_bc0_s "" FLOAT64_IEEE HANcoder_E407_TTA_Controller_v2_CM_double 0 0 -1.7E+308 1.7E+308 ECU_ADDRESS 0x2000bbc0 /end MEASUREMENT
/begin MEASUREMENT TM1_timeout_counter_s "" FLOAT64_IEEE HANcoder_E407_TTA_Controller_v2_CM_double 0 0 -1.7E+308 1.7E+308 ECU_ADDRESS 0x2000bf80 /end MEASUREMENT
/begin MEASUREMENT TM2_timeout_counter_s "" FLOAT64_IEEE HANcoder_E407_TTA_Controller_v2_CM_double 0 0 -1.7E+308 1.7E+308 ECU_ADDRESS 0x2000c158 /end MEASUREMENT
/begin MEASUREMENT TM3_timeout_counter_s "" FLOAT64_IEEE HANcoder_E407_TTA_Controller_v2_CM_double 0 0 -1.7E+308 1.7E+308 ECU_ADDRESS 0x2000c020 /end MEASUREMENT
/begin MEASUREMENT Rx_msg_ticks_setvalues_CAN1_s "" UWORD HANcoder_E407_TTA_Controller_v2_CM_uint16 0 0 0 65535 ECU_ADDRESS 0x2000c522 /end MEASUREMENT
/begin MEASUREMENT Rx_msg_ticks_setvalues_CAN2_s "" UWORD HANcoder_E407_TTA_Controller_v2_CM_uint16 0 0 0 65535 ECU_ADDRESS 0x2000bbd4 /end MEASUREMENT
/begin MEASUREMENT Rx_msg_ticks_sensorvalues_CAN1_s "" UWORD HANcoder_E407_TTA_Controller_v2_CM_uint16 0 0 0 65535 ECU_ADDRESS 0x2000c1a0 /end MEASUREMENT
/begin MEASUREMENT Rx_msg_ticks_sensorvalues_CAN2_s "" UWORD HANcoder_E407_TTA_Controller_v2_CM_uint16 0 0 0 65535 ECU_ADDRESS 0x2000bb30 /end MEASUREMENT
/begin MEASUREMENT Rx_msg_ticks_outemulator_CAN1_s "" UWORD HANcoder_E407_TTA_Controller_v2_CM_uint16 0 0 0 65535 ECU_ADDRESS 0x2000baf8 /end MEASUREMENT
/begin MEASUREMENT Rx_msg_ticks_outemulator_CAN2_s "" UWORD HANcoder_E407_TTA_Controller_v2_CM_uint16 0 0 0 65535 ECU_ADDRESS 0x2000bfda /end MEASUREMENT
/begin MEASUREMENT Rx_msg_ticks_outcontrol2_CAN1_s "" UWORD HANcoder_E407_TTA_Controller_v2_CM_uint16 0 0 0 65535 ECU_ADDRESS 0x2000c160 /end MEASUREMENT
/begin MEASUREMENT Rx_msg_ticks_outcontrol2_CAN2_s "" UWORD HANcoder_E407_TTA_Controller_v2_CM_uint16 0 0 0 65535 ECU_ADDRESS 0x2000c4b4 /end MEASUREMENT
/begin MEASUREMENT Rx_msg_ticks_outcontrol1_CAN1_s "" UWORD HANcoder_E407_TTA_Controller_v2_CM_uint16 0 0 0 65535 ECU_ADDRESS 0x2000c102 /end MEASUREMENT
/begin MEASUREMENT Rx_msg_ticks_outcontrol1_CAN2_s "" UWORD HANcoder_E407_TTA_Controller_v2_CM_uint16 0 0 0 65535 ECU_ADDRESS 0x2000bf68 /end MEASUREMENT
/begin MEASUREMENT Rx_msg_ticks_vote3_CAN1_s "" UWORD HANcoder_E407_TTA_Controller_v2_CM_uint16 0 0 0 65535 ECU_ADDRESS 0x2000c500 /end MEASUREMENT
/begin MEASUREMENT Rx_msg_ticks_vote3_CAN2_s "" UWORD HANcoder_E407_TTA_Controller_v2_CM_uint16 0 0 0 65535 ECU_ADDRESS 0x2000c110 /end MEASUREMENT
/begin MEASUREMENT Rx_msg_ticks_vote2_CAN1_s "" UWORD HANcoder_E407_TTA_Controller_v2_CM_uint16 0 0 0 65535 ECU_ADDRESS 0x2000bb50 /end MEASUREMENT
/begin MEASUREMENT Rx_msg_ticks_vote2_CAN2_s "" UWORD HANcoder_E407_TTA_Controller_v2_CM_uint16 0 0 0 65535 ECU_ADDRESS 0x2000c0ae /end MEASUREMENT
/begin MEASUREMENT Rx_msg_ticks_vote1_CAN1_s "" UWORD HANcoder_E407_TTA_Controller_v2_CM_uint16 0 0 0 65535 ECU_ADDRESS 0x2000c150 /end MEASUREMENT
/begin MEASUREMENT Rx_msg_ticks_vote1_CAN2_s "" UWORD HANcoder_E407_TTA_Controller_v2_CM_uint16 0 0 0 65535 ECU_ADDRESS 0x2000c062 /end MEASUREMENT
/begin MEASUREMENT Rx_init_LT "" UWORD HANcoder_E407_TTA_Controller_v2_CM_uint16 0 0 0 65535 ECU_ADDRESS 0x2000c0d0 /end MEASUREMENT
/begin MEASUREMENT TMR_miss1_set "" UBYTE HANcoder_E407_TTA_Controller_v2_CM_uint8 0 0 0 255 ECU_ADDRESS 0x2000c4b0 /end MEASUREMENT
/begin MEASUREMENT TMR_miss2_set "" UBYTE HANcoder_E407_TTA_Controller_v2_CM_uint8 0 0 0 255 ECU_ADDRESS 0x2000bf58 /end MEASUREMENT
/begin MEASUREMENT TMR_miss1_sensor "" UBYTE HANcoder_E407_TTA_Controller_v2_CM_uint8 0 0 0 255 ECU_ADDRESS 0x2000c0aa /end MEASUREMENT
/begin MEASUREMENT TMR_miss2_sensor "" UBYTE HANcoder_E407_TTA_Controller_v2_CM_uint8 0 0 0 255 ECU_ADDRESS 0x2000c121 /end MEASUREMENT
/begin MEASUREMENT error_log1_s "" UBYTE HANcoder_E407_TTA_Controller_v2_CM_uint8 0 0 0 255 ECU_ADDRESS 0x2000c441 /end MEASUREMENT
/begin MEASUREMENT error_log2_s "" UBYTE HANcoder_E407_TTA_Controller_v2_CM_uint8 0 0 0 255 ECU_ADDRESS 0x2000c113 /end MEASUREMENT
/begin MEASUREMENT error_log3_s "" UBYTE HANcoder_E407_TTA_Controller_v2_CM_uint8 0 0 0 255 ECU_ADDRESS 0x2000c190 /end MEASUREMENT
/begin MEASUREMENT shift7_s "" UBYTE HANcoder_E407_TTA_Controller_v2_CM_uint8 0 0 0 255 ECU_ADDRESS 0x2000bafc /end MEASUREMENT
/begin MEASUREMENT shift6_s "" UBYTE HANcoder_E407_TTA_Controller_v2_CM_uint8 0 0 0 255 ECU_ADDRESS 0x2000c112 /end MEASUREMENT
/begin MEASUREMENT shift5_s "" UBYTE HANcoder_E407_TTA_Controller_v2_CM_uint8 0 0 0 255 ECU_ADDRESS 0x2000bf38 /end MEASUREMENT
/begin MEASUREMENT shift4_s "" UBYTE HANcoder_E407_TTA_Controller_v2_CM_uint8 0 0 0 255 ECU_ADDRESS 0x2000bb2d /end MEASUREMENT
/begin MEASUREMENT shift3_s "" UBYTE HANcoder_E407_TTA_Controller_v2_CM_uint8 0 0 0 255 ECU_ADDRESS 0x2000c458 /end MEASUREMENT
/begin MEASUREMENT shift2_s "" UBYTE HANcoder_E407_TTA_Controller_v2_CM_uint8 0 0 0 255 ECU_ADDRESS 0x2000bff2 /end MEASUREMENT
/begin MEASUREMENT shift1_s "" UBYTE HANcoder_E407_TTA_Controller_v2_CM_uint8 0 0 0 255 ECU_ADDRESS 0x2000bb08 /end MEASUREMENT
/begin MEASUREMENT Rx_id_sync1_CAN2 "" UBYTE HANcoder_E407_TTA_Controller_v2_CM_uint8 0 0 0 255 ECU_ADDRESS 0x2000c098 /end MEASUREMENT
/begin MEASUREMENT Rx_mc_sync1_CAN2 "" UBYTE HANcoder_E407_TTA_Controller_v2_CM_uint8 0 0 0 255 ECU_ADDRESS 0x2000bfb0 /end MEASUREMENT
/begin MEASUREMENT Rx_bc_sync1_CAN2 "" UBYTE HANcoder_E407_TTA_Controller_v2_CM_uint8 0 0 0 255 ECU_ADDRESS 0x2000c4b1 /end MEASUREMENT
/begin MEASUREMENT Rx_id_sync1_CAN1 "" UBYTE HANcoder_E407_TTA_Controller_v2_CM_uint8 0 0 0 255 ECU_ADDRESS 0x2000c130 /end MEASUREMENT
/begin MEASUREMENT Rx_mc_sync1_CAN1 "" UBYTE HANcoder_E407_TTA_Controller_v2_CM_uint8 0 0 0 255 ECU_ADDRESS 0x2000c520 /end MEASUREMENT
/begin MEASUREMENT Rx_bc_sync1_CAN1 "" UBYTE HANcoder_E407_TTA_Controller_v2_CM_uint8 0 0 0 255 ECU_ADDRESS 0x2000bf24 /end MEASUREMENT
/begin MEASUREMENT Rx_id_setvalues_CAN2 "" UBYTE HANcoder_E407_TTA_Controller_v2_CM_uint8 0 0 0 255 ECU_ADDRESS 0x2000c481 /end MEASUREMENT
/begin MEASUREMENT Rx_mc_setvalues_CAN2 "" UBYTE HANcoder_E407_TTA_Controller_v2_CM_uint8 0 0 0 255 ECU_ADDRESS 0x2000bfc0 /end MEASUREMENT
/begin MEASUREMENT Rx_bc_setvalues_CAN2 "" UBYTE HANcoder_E407_TTA_Controller_v2_CM_uint8 0 0 0 255 ECU_ADDRESS 0x2000c05b /end MEASUREMENT
/begin MEASUREMENT Rx_id_setvalues_CAN1 "" UBYTE HANcoder_E407_TTA_Controller_v2_CM_uint8 0 0 0 255 ECU_ADDRESS 0x2000bbdc /end MEASUREMENT
/begin MEASUREMENT Rx_mc_setvalues_CAN1 "" UBYTE HANcoder_E407_TTA_Controller_v2_CM_uint8 0 0 0 255 ECU_ADDRESS 0x2000c506 /end MEASUREMENT
/begin MEASUREMENT Rx_bc_setvalues_CAN1 "" UBYTE HANcoder_E407_TTA_Controller_v2_CM_uint8 0 0 0 255 ECU_ADDRESS 0x2000c45c /end MEASUREMENT
/begin MEASUREMENT Rx_id_sensorvalues_CAN2 "" UBYTE HANcoder_E407_TTA_Controller_v2_CM_uint8 0 0 0 255 ECU_ADDRESS 0x2000c152 /end MEASUREMENT
/begin MEASUREMENT Rx_mc_sensorvalues_CAN2 "" UBYTE HANcoder_E407_TTA_Controller_v2_CM_uint8 0 0 0 255 ECU_ADDRESS 0x2000bfd8 /end MEASUREMENT
/begin MEASUREMENT Rx_bc_sensorvalues_CAN2 "" UBYTE HANcoder_E407_TTA_Controller_v2_CM_uint8 0 0 0 255 ECU_ADDRESS 0x2000bbde /end MEASUREMENT
/begin MEASUREMENT Rx_id_sensorvalues_CAN1 "" UBYTE HANcoder_E407_TTA_Controller_v2_CM_uint8 0 0 0 255 ECU_ADDRESS 0x2000c0a8 /end MEASUREMENT
/begin MEASUREMENT Rx_mc_sensorvalues_CAN1 "" UBYTE HANcoder_E407_TTA_Controller_v2_CM_uint8 0 0 0 255 ECU_ADDRESS 0x2000c470 /end MEASUREMENT
/begin MEASUREMENT Rx_bc_sensorvalues_CAN1 "" UBYTE HANcoder_E407_TTA_Controller_v2_CM_uint8 0 0 0 255 ECU_ADDRESS 0x2000bb2a /end MEASUREMENT
/begin MEASUREMENT Rx_id_outemulator_CAN2 "" UBYTE HANcoder_E407_TTA_Controller_v2_CM_uint8 0 0 0 255 ECU_ADDRESS 0x2000c4d0 /end MEASUREMENT
/begin MEASUREMENT Rx_mc_outemulator_CAN2 "" UBYTE HANcoder_E407_TTA_Controller_v2_CM_uint8 0 0 0 255 ECU_ADDRESS 0x2000bff1 /end MEASUREMENT
/begin MEASUREMENT Rx_bc_outemulator_CAN2 "" UBYTE HANcoder_E407_TTA_Controller_v2_CM_uint8 0 0 0 255 ECU_ADDRESS 0x2000c459 /end MEASUREMENT
/begin MEASUREMENT Rx_id_outemulator_CAN1 "" UBYTE HANcoder_E407_TTA_Controller_v2_CM_uint8 0 0 0 255 ECU_ADDRESS 0x2000c09a /end MEASUREMENT
/begin MEASUREMENT Rx_mc_outemulator_CAN1 "" UBYTE HANcoder_E407_TTA_Controller_v2_CM_uint8 0 0 0 255 ECU_ADDRESS 0x2000c45b /end MEASUREMENT
/begin MEASUREMENT Rx_bc_outemulator_CAN1 "" UBYTE HANcoder_E407_TTA_Controller_v2_CM_uint8 0 0 0 255 ECU_ADDRESS 0x2000c010 /end MEASUREMENT
/begin MEASUREMENT Rx_id_outcontrol2_CAN2 "" UBYTE HANcoder_E407_TTA_Controller_v2_CM_uint8 0 0 0 255 ECU_ADDRESS 0x2000c440 /end MEASUREMENT
/begin MEASUREMENT Rx_mc_outcontrol2_CAN2 "" UBYTE HANcoder_E407_TTA_Controller_v2_CM_uint8 0 0 0 255 ECU_ADDRESS 0x2000c0cd /end MEASUREMENT
/begin MEASUREMENT Rx_bc_outcontrol2_CAN2 "" UBYTE HANcoder_E407_TTA_Controller_v2_CM_uint8 0 0 0 255 ECU_ADDRESS 0x2000bf26 /end MEASUREMENT
/begin MEASUREMENT Rx_id_outcontrol2_CAN1 "" UBYTE HANcoder_E407_TTA_Controller_v2_CM_uint8 0 0 0 255 ECU_ADDRESS 0x2000bb52 /end MEASUREMENT
/begin MEASUREMENT Rx_mc_outcontrol2_CAN1 "" UBYTE HANcoder_E407_TTA_Controller_v2_CM_uint8 0 0 0 255 ECU_ADDRESS 0x2000c508 /end MEASUREMENT
/begin MEASUREMENT Rx_bc_outcontrol2_CAN1 "" UBYTE HANcoder_E407_TTA_Controller_v2_CM_uint8 0 0 0 255 ECU_ADDRESS 0x2000c080 /end MEASUREMENT
/begin MEASUREMENT Rx_id_outcontrol1_CAN2 "" UBYTE HANcoder_E407_TTA_Controller_v2_CM_uint8 0 0 0 255 ECU_ADDRESS 0x2000bf59 /end MEASUREMENT
/begin MEASUREMENT Rx_mc_outcontrol1_CAN2 "" UBYTE HANcoder_E407_TTA_Controller_v2_CM_uint8 0 0 0 255 ECU_ADDRESS 0x2000c060 /end MEASUREMENT
/begin MEASUREMENT Rx_bc_outcontrol1_CAN2 "" UBYTE HANcoder_E407_TTA_Controller_v2_CM_uint8 0 0 0 255 ECU_ADDRESS 0x2000c0f4 /end MEASUREMENT
/begin MEASUREMENT Rx_id_outcontrol1_CAN1 "" UBYTE HANcoder_E407_TTA_Controller_v2_CM_uint8 0 0 0 255 ECU_ADDRESS 0x2000c0cc /end MEASUREMENT
/begin MEASUREMENT Rx_mc_outcontrol1_CAN1 "" UBYTE HANcoder_E407_TTA_Controller_v2_CM_uint8 0 0 0 255 ECU_ADDRESS 0x2000c175 /end MEASUREMENT
/begin MEASUREMENT Rx_bc_outcontrol1_CAN1 "" UBYTE HANcoder_E407_TTA_Controller_v2_CM_uint8 0 0 0 255 ECU_ADDRESS 0x2000c100 /end MEASUREMENT
/begin MEASUREMENT Rx_id_vote3_CAN2 "" UBYTE HANcoder_E407_TTA_Controller_v2_CM_uint8 0 0 0 255 ECU_ADDRESS 0x2000c521 /end MEASUREMENT
/begin MEASUREMENT Rx_mc_vote3_CAN2 "" UBYTE HANcoder_E407_TTA_Controller_v2_CM_uint8 0 0 0 255 ECU_ADDRESS 0x2000bbdd /end MEASUREMENT
/begin MEASUREMENT Rx_bc_vote3_CAN2 "" UBYTE HANcoder_E407_TTA_Controller_v2_CM_uint8 0 0 0 255 ECU_ADDRESS 0x2000c468 /end MEASUREMENT
/begin MEASUREMENT Rx_id_vote3_CAN1 "" UBYTE HANcoder_E407_TTA_Controller_v2_CM_uint8 0 0 0 255 ECU_ADDRESS 0x2000c4e0 /end MEASUREMENT
/begin MEASUREMENT Rx_mc_vote3_CAN1 "" UBYTE HANcoder_E407_TTA_Controller_v2_CM_uint8 0 0 0 255 ECU_ADDRESS 0x2000c4b2 /end MEASUREMENT
/begin MEASUREMENT Rx_bc_vote3_CAN1 "" UBYTE HANcoder_E407_TTA_Controller_v2_CM_uint8 0 0 0 255 ECU_ADDRESS 0x2000bbb0 /end MEASUREMENT
/begin MEASUREMENT Rx_id_vote2_CAN2 "" UBYTE HANcoder_E407_TTA_Controller_v2_CM_uint8 0 0 0 255 ECU_ADDRESS 0x2000c430 /end MEASUREMENT
/begin MEASUREMENT Rx_mc_vote2_CAN2 "" UBYTE HANcoder_E407_TTA_Controller_v2_CM_uint8 0 0 0 255 ECU_ADDRESS 0x2000bb70 /end MEASUREMENT
/begin MEASUREMENT Rx_bc_vote2_CAN2 "" UBYTE HANcoder_E407_TTA_Controller_v2_CM_uint8 0 0 0 255 ECU_ADDRESS 0x2000c120 /end MEASUREMENT
/begin MEASUREMENT Rx_id_vote2_CAN1 "" UBYTE HANcoder_E407_TTA_Controller_v2_CM_uint8 0 0 0 255 ECU_ADDRESS 0x2000bba1 /end MEASUREMENT
/begin MEASUREMENT Rx_mc_vote2_CAN1 "" UBYTE HANcoder_E407_TTA_Controller_v2_CM_uint8 0 0 0 255 ECU_ADDRESS 0x2000c030 /end MEASUREMENT
/begin MEASUREMENT Rx_bc_vote2_CAN1 "" UBYTE HANcoder_E407_TTA_Controller_v2_CM_uint8 0 0 0 255 ECU_ADDRESS 0x2000c524 /end MEASUREMENT
/begin MEASUREMENT Rx_id_vote1_CAN2 "" UBYTE HANcoder_E407_TTA_Controller_v2_CM_uint8 0 0 0 255 ECU_ADDRESS 0x2000c131 /end MEASUREMENT
/begin MEASUREMENT Rx_mc_vote1_CAN2 "" UBYTE HANcoder_E407_TTA_Controller_v2_CM_uint8 0 0 0 255 ECU_ADDRESS 0x2000c075 /end MEASUREMENT
/begin MEASUREMENT Rx_bc_vote1_CAN2 "" UBYTE HANcoder_E407_TTA_Controller_v2_CM_uint8 0 0 0 255 ECU_ADDRESS 0x2000bfa0 /end MEASUREMENT
/begin MEASUREMENT Rx_id_vote1_CAN1 "" UBYTE HANcoder_E407_TTA_Controller_v2_CM_uint8 0 0 0 255 ECU_ADDRESS 0x2000bb29 /end MEASUREMENT
/begin MEASUREMENT Rx_mc_vote1_CAN1 "" UBYTE HANcoder_E407_TTA_Controller_v2_CM_uint8 0 0 0 255 ECU_ADDRESS 0x2000c0ab /end MEASUREMENT
/begin MEASUREMENT Rx_bc_vote1_CAN1 "" UBYTE HANcoder_E407_TTA_Controller_v2_CM_uint8 0 0 0 255 ECU_ADDRESS 0x2000c507 /end MEASUREMENT
/begin MEASUREMENT Vote_s "" UBYTE HANcoder_E407_TTA_Controller_v2_CM_uint8 0 0 0 255 ECU_ADDRESS 0x2000bafb /end MEASUREMENT
/begin MEASUREMENT Rx_id_sync0_CAN2 "" UBYTE HANcoder_E407_TTA_Controller_v2_CM_uint8 0 0 0 255 ECU_ADDRESS 0x2000bba0 /end MEASUREMENT
/begin MEASUREMENT Rx_mc_sync0_CAN2 "" UBYTE HANcoder_E407_TTA_Controller_v2_CM_uint8 0 0 0 255 ECU_ADDRESS 0x2000c070 /end MEASUREMENT
/begin MEASUREMENT Rx_bc_sync0_CAN2 "" UBYTE HANcoder_E407_TTA_Controller_v2_CM_uint8 0 0 0 255 ECU_ADDRESS 0x2000c0f3 /end MEASUREMENT
/begin MEASUREMENT Rx_id_sync0_CAN1 "" UBYTE HANcoder_E407_TTA_Controller_v2_CM_uint8 0 0 0 255 ECU_ADDRESS 0x2000c05a /end MEASUREMENT
/begin MEASUREMENT Rx_mc_sync0_CAN1 "" UBYTE HANcoder_E407_TTA_Controller_v2_CM_uint8 0 0 0 255 ECU_ADDRESS 0x2000bb60 /end MEASUREMENT
/begin MEASUREMENT Rx_bc_sync0_CAN1 "" UBYTE HANcoder_E407_TTA_Controller_v2_CM_uint8 0 0 0 255 ECU_ADDRESS 0x2000c0f0 /end MEASUREMENT
/begin MEASUREMENT Rx_init_id "" UBYTE HANcoder_E407_TTA_Controller_v2_CM_uint8 0 0 0 255 ECU_ADDRESS 0x2000c45a /end MEASUREMENT
/begin MEASUREMENT Rx_init_mc "" UBYTE HANcoder_E407_TTA_Controller_v2_CM_uint8 0 0 0 255 ECU_ADDRESS 0x2000c499 /end MEASUREMENT
/begin MEASUREMENT Rx_init_bc "" UBYTE HANcoder_E407_TTA_Controller_v2_CM_uint8 0 0 0 255 ECU_ADDRESS 0x2000bff0 /end MEASUREMENT
/begin MEASUREMENT bacic_cycle_s "" UBYTE HANcoder_E407_TTA_Controller_v2_CM_uint8 0 0 0 255 ECU_ADDRESS 0x2000bfdc /end MEASUREMENT
/begin MEASUREMENT BC1_sync_processed_s "" UBYTE HANcoder_E407_TTA_Controller_v2_CM_boolean 0 0 0 1 ECU_ADDRESS 0x2000c480 /end MEASUREMENT
/begin MEASUREMENT BC0_sync_processed_s "" UBYTE HANcoder_E407_TTA_Controller_v2_CM_boolean 0 0 0 1 ECU_ADDRESS 0x2000bb2b /end MEASUREMENT
/begin MEASUREMENT BC0_vote1_processed_s "" UBYTE HANcoder_E407_TTA_Controller_v2_CM_boolean 0 0 0 1 ECU_ADDRESS 0x2000c099 /end MEASUREMENT
/begin MEASUREMENT BC0_vote2_processed_s "" UBYTE HANcoder_E407_TTA_Controller_v2_CM_boolean 0 0 0 1 ECU_ADDRESS 0x2000c180 /end MEASUREMENT
/begin MEASUREMENT BC0_vote3_processed_s "" UBYTE HANcoder_E407_TTA_Controller_v2_CM_boolean 0 0 0 1 ECU_ADDRESS 0x2000c0a9 /end MEASUREMENT
/begin MEASUREMENT TMR_miss_set "" UBYTE HANcoder_E407_TTA_Controller_v2_CM_boolean 0 0 0 1 ECU_ADDRESS 0x2000bf25 /end MEASUREMENT
/begin MEASUREMENT TMR_miss_sensor "" UBYTE HANcoder_E407_TTA_Controller_v2_CM_boolean 0 0 0 1 ECU_ADDRESS 0x2000c012 /end MEASUREMENT
/begin MEASUREMENT TMR_miss_out1 "" UBYTE HANcoder_E407_TTA_Controller_v2_CM_boolean 0 0 0 1 ECU_ADDRESS 0x2000c076 /end MEASUREMENT
/begin MEASUREMENT TMR_miss_out2 "" UBYTE HANcoder_E407_TTA_Controller_v2_CM_boolean 0 0 0 1 ECU_ADDRESS 0x2000c0f2 /end MEASUREMENT
/begin MEASUREMENT tau_fr_agree_s "" UBYTE HANcoder_E407_TTA_Controller_v2_CM_boolean 0 0 0 1 ECU_ADDRESS 0x2000c498 /end MEASUREMENT
/begin MEASUREMENT tau_fl_agree_s "" UBYTE HANcoder_E407_TTA_Controller_v2_CM_boolean 0 0 0 1 ECU_ADDRESS 0x2000bafa /end MEASUREMENT
/begin MEASUREMENT tau_ar_agree_s "" UBYTE HANcoder_E407_TTA_Controller_v2_CM_boolean 0 0 0 1 ECU_ADDRESS 0x2000bf27 /end MEASUREMENT
/begin MEASUREMENT tau_al_agree_s "" UBYTE HANcoder_E407_TTA_Controller_v2_CM_boolean 0 0 0 1 ECU_ADDRESS 0x2000c011 /end MEASUREMENT
/begin MEASUREMENT tau_fr2_agree_s "" UBYTE HANcoder_E407_TTA_Controller_v2_CM_boolean 0 0 0 1 ECU_ADDRESS 0x2000c0f1 /end MEASUREMENT
/begin MEASUREMENT tau_fl2_agree_s "" UBYTE HANcoder_E407_TTA_Controller_v2_CM_boolean 0 0 0 1 ECU_ADDRESS 0x2000c013 /end MEASUREMENT
/begin MEASUREMENT tau_ar2_agree_s "" UBYTE HANcoder_E407_TTA_Controller_v2_CM_boolean 0 0 0 1 ECU_ADDRESS 0x2000bb2c /end MEASUREMENT
/begin MEASUREMENT tau_al2_agree_s "" UBYTE HANcoder_E407_TTA_Controller_v2_CM_boolean 0 0 0 1 ECU_ADDRESS 0x2000bb2e /end MEASUREMENT
/begin MEASUREMENT tau_fr1_agree_s "" UBYTE HANcoder_E407_TTA_Controller_v2_CM_boolean 0 0 0 1 ECU_ADDRESS 0x2000c174 /end MEASUREMENT
/begin MEASUREMENT tau_fl1_agree_s "" UBYTE HANcoder_E407_TTA_Controller_v2_CM_boolean 0 0 0 1 ECU_ADDRESS 0x2000bf2a /end MEASUREMENT
/begin MEASUREMENT tau_ar1_agree_s "" UBYTE HANcoder_E407_TTA_Controller_v2_CM_boolean 0 0 0 1 ECU_ADDRESS 0x2000bb28 /end MEASUREMENT
/begin MEASUREMENT tau_al1_agree_s "" UBYTE HANcoder_E407_TTA_Controller_v2_CM_boolean 0 0 0 1 ECU_ADDRESS 0x2000c058 /end MEASUREMENT
/begin MEASUREMENT new_set_rx_s "" UBYTE HANcoder_E407_TTA_Controller_v2_CM_boolean 0 0 0 1 ECU_ADDRESS 0x2000bb40 /end MEASUREMENT
/begin MEASUREMENT new_sensor_rx_s "" UBYTE HANcoder_E407_TTA_Controller_v2_CM_boolean 0 0 0 1 ECU_ADDRESS 0x2000c000 /end MEASUREMENT
/begin MEASUREMENT out2_rx_s "" UBYTE HANcoder_E407_TTA_Controller_v2_CM_boolean 0 0 0 1 ECU_ADDRESS 0x2000bf48 /end MEASUREMENT
/begin MEASUREMENT out1_rx_s "" UBYTE HANcoder_E407_TTA_Controller_v2_CM_boolean 0 0 0 1 ECU_ADDRESS 0x2000c502 /end MEASUREMENT
/begin MEASUREMENT reset_s "" UBYTE HANcoder_E407_TTA_Controller_v2_CM_boolean 0 0 0 1 ECU_ADDRESS 0x2000c0ce /end MEASUREMENT
/begin MEASUREMENT Tx_temporal_msg_CAN2 "" FLOAT64_IEEE HANcoder_E407_TTA_Controller_v2_CM_double 0 0 -1.7E+308 1.7E+308 ECU_ADDRESS 0x2000bf90 /end MEASUREMENT
/begin MEASUREMENT TxCAN2_counter_s "" ULONG HANcoder_E407_TTA_Controller_v2_CM_uint32 0 0 0 4294967295 ECU_ADDRESS 0x2000c0c8 /end MEASUREMENT
/begin MEASUREMENT TxID_CAN2_s "" ULONG HANcoder_E407_TTA_Controller_v2_CM_uint32 0 0 0 4294967295 ECU_ADDRESS 0x2000bbd8 /end MEASUREMENT
/begin MEASUREMENT Local_Ticks_Activation_CAN2_send "" UWORD HANcoder_E407_TTA_Controller_v2_CM_uint16 0 0 0 65535 ECU_ADDRESS 0x2000c05c /end MEASUREMENT
/begin MEASUREMENT FRC_Activation_CAN2_send "" UWORD HANcoder_E407_TTA_Controller_v2_CM_uint16 0 0 0 65535 ECU_ADDRESS 0x2000c0ac /end MEASUREMENT
/begin MEASUREMENT Rx_temporal_msg_CAN2 "" FLOAT64_IEEE HANcoder_E407_TTA_Controller_v2_CM_double 0 0 -1.7E+308 1.7E+308 ECU_ADDRESS 0x2000c4d8 /end MEASUREMENT
/begin MEASUREMENT RxCAN2_counter_s "" ULONG HANcoder_E407_TTA_Controller_v2_CM_uint32 0 0 0 4294967295 ECU_ADDRESS 0x2000c0b0 /end MEASUREMENT
/begin MEASUREMENT RxID_CAN2_s "" ULONG HANcoder_E407_TTA_Controller_v2_CM_uint32 0 0 0 4294967295 ECU_ADDRESS 0x2000c4c0 /end MEASUREMENT
/begin MEASUREMENT Rx_msg_ticks_CAN2 "" UWORD HANcoder_E407_TTA_Controller_v2_CM_uint16 0 0 0 65535 ECU_ADDRESS 0x2000c504 /end MEASUREMENT
/begin MEASUREMENT Rx_temporal_msg_CAN1 "" FLOAT64_IEEE HANcoder_E407_TTA_Controller_v2_CM_double 0 0 -1.7E+308 1.7E+308 ECU_ADDRESS 0x2000c0a0 /end MEASUREMENT
/begin MEASUREMENT RxCAN1_counter_s "" ULONG HANcoder_E407_TTA_Controller_v2_CM_uint32 0 0 0 4294967295 ECU_ADDRESS 0x2000bf20 /end MEASUREMENT
/begin MEASUREMENT RxID_CAN1_s "" ULONG HANcoder_E407_TTA_Controller_v2_CM_uint32 0 0 0 4294967295 ECU_ADDRESS 0x2000c040 /end MEASUREMENT
/begin MEASUREMENT Rx_msg_ticks_CAN1 "" UWORD HANcoder_E407_TTA_Controller_v2_CM_uint16 0 0 0 65535 ECU_ADDRESS 0x2000c032 /end MEASUREMENT
/begin MEASUREMENT Tx_temporal_msg_CAN1 "" FLOAT64_IEEE HANcoder_E407_TTA_Controller_v2_CM_double 0 0 -1.7E+308 1.7E+308 ECU_ADDRESS 0x2000c4f8 /end MEASUREMENT
/begin MEASUREMENT TxCAN1_counter_s "" ULONG HANcoder_E407_TTA_Controller_v2_CM_uint32 0 0 0 4294967295 ECU_ADDRESS 0x2000c46c /end MEASUREMENT
/begin MEASUREMENT TxID_CAN1_s "" ULONG HANcoder_E407_TTA_Controller_v2_CM_uint32 0 0 0 4294967295 ECU_ADDRESS 0x2000c018 /end MEASUREMENT
/begin MEASUREMENT Local_Ticks_Activation_CAN1_send "" UWORD HANcoder_E407_TTA_Controller_v2_CM_uint16 0 0 0 65535 ECU_ADDRESS 0x2000bf28 /end MEASUREMENT
/begin MEASUREMENT FRC_Activation_CAN1_send "" UWORD HANcoder_E407_TTA_Controller_v2_CM_uint16 0 0 0 65535 ECU_ADDRESS 0x2000c05e /end MEASUREMENT
/begin COMPU_METHOD HANcoder_E407_TTA_Controller_v2_CM_double "Q = V" RAT_FUNC "%15.10" "" COEFFS 0 1 0 0 0 1 /end COMPU_METHOD
/begin COMPU_METHOD HANcoder_E407_TTA_Controller_v2_CM_boolean "Q = V" RAT_FUNC "%1.0" "" COEFFS 0 1 0 0 0 1 /end COMPU_METHOD
/begin COMPU_METHOD HANcoder_E407_TTA_Controller_v2_CM_uint32 "Q = V" RAT_FUNC "%10.0" "" COEFFS 0 1 0 0 0 1 /end COMPU_METHOD
/begin COMPU_METHOD HANcoder_E407_TTA_Controller_v2_CM_uint16 "Q = V" RAT_FUNC "%5.0" "" COEFFS 0 1 0 0 0 1 /end COMPU_METHOD
/begin COMPU_METHOD HANcoder_E407_TTA_Controller_v2_CM_uint8 "Q = V" RAT_FUNC "%3.0" "" COEFFS 0 1 0 0 0 1 /end COMPU_METHOD
/begin GROUP HANcoder_E407_TTA_Controller_v2 "HANcoder_E407_TTA_Controller_v2" /* Root */ ROOT /begin SUB_GROUP Root_HANcoder_STM32_Target___E407_STM32_algorithm /end SUB_GROUP /end GROUP
/begin GROUP Root_HANcoder_STM32_Target___E407_STM32_algorithm "HANcoder_E407_TTA_Controller_v2/HANcoder STM32 Target - E407-STM32 algorithm"
 /begin SUB_GROUP S1_Algorithm S1_Global_Ticks_Increment S1_System_information /end SUB_GROUP
/end GROUP
/begin GROUP S1_Algorithm "HANcoder_E407_TTA_Controller_v2/HANcoder STM32 Target - E407-STM32 algorithm/Algorithm" /begin REF_CHARACTERISTIC HANtuneOverride /end REF_CHARACTERISTIC /begin REF_MEASUREMENT LedValue /end REF_MEASUREMENT /end GROUP
/begin GROUP S1_Global_Ticks_Increment "HANcoder_E407_TTA_Controller_v2/HANcoder STM32 Target - E407-STM32 algorithm/Global Ticks Increment"
 /begin SUB_GROUP S6_CAN1_Recieve S6_CAN1_Send S6_CAN2_Recieve S6_CAN2_Send S6_CAN_Management S6_If_Action_Subsystem S6_Local_Time_generation /end SUB_GROUP
 /begin REF_MEASUREMENT simulation_time /end REF_MEASUREMENT
/end GROUP
/begin GROUP S1_System_information "HANcoder_E407_TTA_Controller_v2/HANcoder STM32 Target - E407-STM32 algorithm/System information" /begin SUB_GROUP S10_Get_CPU_load S10_Get_free_Heap S10_Get_free_Stack /end SUB_GROUP /end GROUP
/begin GROUP S6_CAN_Management "HANcoder_E407_TTA_Controller_v2/HANcoder STM32 Target - E407-STM32 algorithm/Global Ticks Increment/CAN Management"
 /begin SUB_GROUP S18_Basic_Cycle_Increment S18_Initialization S18_Matrix_Cycle_Manager /end SUB_GROUP
/end GROUP
/begin GROUP S6_CAN1_Recieve "HANcoder_E407_TTA_Controller_v2/HANcoder STM32 Target - E407-STM32 algorithm/Global Ticks Increment/CAN1 Recieve" /begin SUB_GROUP S19_Update_message_buffers /end SUB_GROUP /begin REF_MEASUREMENT RxCAN1_counter_s RxID_CAN1_s /end REF_MEASUREMENT /end GROUP
/begin GROUP S6_CAN1_Send "HANcoder_E407_TTA_Controller_v2/HANcoder STM32 Target - E407-STM32 algorithm/Global Ticks Increment/CAN1 Send" /begin SUB_GROUP S20_Get_Free_Running_Counter /end SUB_GROUP
 /begin REF_MEASUREMENT Local_Ticks_Activation_CAN1_send TxCAN1_counter_s TxID_CAN1_s Tx_temporal_msg_CAN1 /end REF_MEASUREMENT
/end GROUP
/begin GROUP S6_CAN2_Recieve "HANcoder_E407_TTA_Controller_v2/HANcoder STM32 Target - E407-STM32 algorithm/Global Ticks Increment/CAN2 Recieve" /begin SUB_GROUP S21_Update_message_buffers /end SUB_GROUP /begin REF_MEASUREMENT RxCAN2_counter_s RxID_CAN2_s /end REF_MEASUREMENT /end GROUP
/begin GROUP S6_CAN2_Send "HANcoder_E407_TTA_Controller_v2/HANcoder STM32 Target - E407-STM32 algorithm/Global Ticks Increment/CAN2 Send" /begin SUB_GROUP S22_Get_Free_Running_Counter1 /end SUB_GROUP
 /begin REF_MEASUREMENT Local_Ticks_Activation_CAN2_send TxCAN2_counter_s TxID_CAN2_s Tx_temporal_msg_CAN2 /end REF_MEASUREMENT
/end GROUP
/begin GROUP S6_If_Action_Subsystem "HANcoder_E407_TTA_Controller_v2/HANcoder STM32 Target - E407-STM32 algorithm/Global Ticks Increment/If Action Subsystem" /begin REF_MEASUREMENT Board_ID_s /end REF_MEASUREMENT /end GROUP
/begin GROUP S6_Local_Time_generation "HANcoder_E407_TTA_Controller_v2/HANcoder STM32 Target - E407-STM32 algorithm/Global Ticks Increment/Local Time generation" /begin REF_MEASUREMENT local_ticks_interrupt /end REF_MEASUREMENT /end GROUP
/begin GROUP S10_Get_CPU_load "HANcoder_E407_TTA_Controller_v2/HANcoder STM32 Target - E407-STM32 algorithm/System information/Get CPU load" /begin REF_MEASUREMENT SI_CPUload /end REF_MEASUREMENT /end GROUP
/begin GROUP S10_Get_free_Heap "HANcoder_E407_TTA_Controller_v2/HANcoder STM32 Target - E407-STM32 algorithm/System information/Get free Heap" /begin REF_MEASUREMENT SI_FreeHeap /end REF_MEASUREMENT /end GROUP
/begin GROUP S10_Get_free_Stack "HANcoder_E407_TTA_Controller_v2/HANcoder STM32 Target - E407-STM32 algorithm/System information/Get free Stack" /begin REF_MEASUREMENT SI_FreeStack /end REF_MEASUREMENT /end GROUP
/begin GROUP S18_Basic_Cycle_Increment "HANcoder_E407_TTA_Controller_v2/HANcoder STM32 Target - E407-STM32 algorithm/Global Ticks Increment/CAN Management/Basic Cycle Increment" /begin REF_MEASUREMENT bacic_cycle_s /end REF_MEASUREMENT /end GROUP
/begin GROUP S18_Initialization "HANcoder_E407_TTA_Controller_v2/HANcoder STM32 Target - E407-STM32 algorithm/Global Ticks Increment/CAN Management/Initialization" /begin SUB_GROUP S39_RoleID_and_Global_Time_init /end SUB_GROUP /end GROUP
/begin GROUP S18_Matrix_Cycle_Manager "HANcoder_E407_TTA_Controller_v2/HANcoder STM32 Target - E407-STM32 algorithm/Global Ticks Increment/CAN Management/Matrix Cycle Manager"
 /begin SUB_GROUP S41_Matrix_Cycle_Observation_DEBUG S41_controller_basic_cycle_0 S41_controller_basic_cycle_1 S41_msg_count_DEBUG_observer /end SUB_GROUP
/end GROUP
/begin GROUP S19_Update_message_buffers "HANcoder_E407_TTA_Controller_v2/HANcoder STM32 Target - E407-STM32 algorithm/Global Ticks Increment/CAN1 Recieve/Update message buffers" /begin REF_MEASUREMENT Rx_msg_ticks_CAN1 Rx_temporal_msg_CAN1 /end REF_MEASUREMENT /end GROUP
/begin GROUP S20_Get_Free_Running_Counter "HANcoder_E407_TTA_Controller_v2/HANcoder STM32 Target - E407-STM32 algorithm/Global Ticks Increment/CAN1 Send/Get Free Running Counter" /begin REF_MEASUREMENT FRC_Activation_CAN1_send /end REF_MEASUREMENT /end GROUP
/begin GROUP S21_Update_message_buffers "HANcoder_E407_TTA_Controller_v2/HANcoder STM32 Target - E407-STM32 algorithm/Global Ticks Increment/CAN2 Recieve/Update message buffers" /begin REF_MEASUREMENT Rx_msg_ticks_CAN2 Rx_temporal_msg_CAN2 /end REF_MEASUREMENT /end GROUP
/begin GROUP S22_Get_Free_Running_Counter1 "HANcoder_E407_TTA_Controller_v2/HANcoder STM32 Target - E407-STM32 algorithm/Global Ticks Increment/CAN2 Send/Get Free Running Counter1" /begin REF_MEASUREMENT FRC_Activation_CAN2_send /end REF_MEASUREMENT /end GROUP
/begin GROUP S39_RoleID_and_Global_Time_init "HANcoder_E407_TTA_Controller_v2/HANcoder STM32 Target - E407-STM32 algorithm/Global Ticks Increment/CAN Management/Initialization/RoleID and Global Time init" /begin SUB_GROUP S47_Global_Time_Initialization_Slave /end SUB_GROUP /end GROUP
/begin GROUP S41_Matrix_Cycle_Observation_DEBUG "HANcoder_E407_TTA_Controller_v2/HANcoder STM32 Target - E407-STM32 algorithm/Global Ticks Increment/CAN Management/Matrix Cycle Manager/Matrix_Cycle_Observation_DEBUG"
 /begin REF_MEASUREMENT BC0_sync_processed_s BC0_vote1_processed_s BC0_vote2_processed_s BC0_vote3_processed_s BC1_sync_processed_s Board_1_error_counter_s Board_2_error_counter_s Board_3_error_counter_s Master_ID_s Role_ID_s votes_Board_1_DEBUG votes_Board_2_DEBUG votes_Board_3_DEBUG /end REF_MEASUREMENT
/end GROUP
/begin GROUP S41_controller_basic_cycle_0 "HANcoder_E407_TTA_Controller_v2/HANcoder STM32 Target - E407-STM32 algorithm/Global Ticks Increment/CAN Management/Matrix Cycle Manager/controller basic cycle 0"
 /begin SUB_GROUP S89_COMP_Task___Check_Timeouts S89_COMP_Task___Reset_Board S89_COMP_Task___Sync_bc0_check S89_COMP_Task___Vote1_check S89_COMP_Task___Vote2_check S89_COMP_Task___Vote3_check S89_COMP_Task___Vote_Decision /end SUB_GROUP
/end GROUP
/begin GROUP S41_controller_basic_cycle_1 "HANcoder_E407_TTA_Controller_v2/HANcoder STM32 Target - E407-STM32 algorithm/Global Ticks Increment/CAN Management/Matrix Cycle Manager/controller basic cycle 1"
 /begin SUB_GROUP S90_COMP_Task___Calculate_Speed S90_COMP_Task___Calculate_Steer S90_COMP_Task___Calculate_Torque S90_COMP_Task___Rx_Output_Control1_Check S90_COMP_Task___Rx_Output_Control2_Check S90_COMP_Task___Rx_Output_Emulator_Check S90_COMP_Task___Rx_Sensor_Values_Check S90_COMP_Task___Rx_Set_Values_Check S90_COMP_Task___Sync_bc1_check S90_COMP_Task___TMR /end SUB_GROUP
/end GROUP
/begin GROUP S41_msg_count_DEBUG_observer "HANcoder_E407_TTA_Controller_v2/HANcoder STM32 Target - E407-STM32 algorithm/Global Ticks Increment/CAN Management/Matrix Cycle Manager/msg_count_DEBUG observer" /begin REF_MEASUREMENT msg_count_DEBUG_s /end REF_MEASUREMENT /end GROUP
/begin GROUP S47_Global_Time_Initialization_Slave "HANcoder_E407_TTA_Controller_v2/HANcoder STM32 Target - E407-STM32 algorithm/Global Ticks Increment/CAN Management/Initialization/RoleID and Global Time init/Global Time Initialization Slave" /begin SUB_GROUP S49_msg_decoding /end SUB_GROUP /begin REF_MEASUREMENT Rx_init_LT /end REF_MEASUREMENT /end GROUP
/begin GROUP S89_COMP_Task___Check_Timeouts "HANcoder_E407_TTA_Controller_v2/HANcoder STM32 Target - E407-STM32 algorithm/Global Ticks Increment/CAN Management/Matrix Cycle Manager/controller basic cycle 0/COMP Task - Check Timeouts" /begin SUB_GROUP S96_Timeout_and_Board_error_counter /end SUB_GROUP /end GROUP
/begin GROUP S89_COMP_Task___Reset_Board "HANcoder_E407_TTA_Controller_v2/HANcoder STM32 Target - E407-STM32 algorithm/Global Ticks Increment/CAN Management/Matrix Cycle Manager/controller basic cycle 0/COMP Task - Reset Board" /begin REF_MEASUREMENT reset_s /end REF_MEASUREMENT /end GROUP
/begin GROUP S89_COMP_Task___Sync_bc0_check "HANcoder_E407_TTA_Controller_v2/HANcoder STM32 Target - E407-STM32 algorithm/Global Ticks Increment/CAN Management/Matrix Cycle Manager/controller basic cycle 0/COMP Task - Sync bc0 check" /begin SUB_GROUP S100_Process_Messages /end SUB_GROUP /end GROUP
/begin GROUP S89_COMP_Task___Vote_Decision "HANcoder_E407_TTA_Controller_v2/HANcoder STM32 Target - E407-STM32 algorithm/Global Ticks Increment/CAN Management/Matrix Cycle Manager/controller basic cycle 0/COMP Task - Vote Decision" /begin SUB_GROUP S102_Vote_Decision /end SUB_GROUP /end GROUP
/begin GROUP S89_COMP_Task___Vote1_check "HANcoder_E407_TTA_Controller_v2/HANcoder STM32 Target - E407-STM32 algorithm/Global Ticks Increment/CAN Management/Matrix Cycle Manager/controller basic cycle 0/COMP Task - Vote1 check" /begin SUB_GROUP S104_Process_Messages1 /end SUB_GROUP /end GROUP
/begin GROUP S89_COMP_Task___Vote2_check "HANcoder_E407_TTA_Controller_v2/HANcoder STM32 Target - E407-STM32 algorithm/Global Ticks Increment/CAN Management/Matrix Cycle Manager/controller basic cycle 0/COMP Task - Vote2 check" /begin SUB_GROUP S106_Process_Messages /end SUB_GROUP /end GROUP
/begin GROUP S89_COMP_Task___Vote3_check "HANcoder_E407_TTA_Controller_v2/HANcoder STM32 Target - E407-STM32 algorithm/Global Ticks Increment/CAN Management/Matrix Cycle Manager/controller basic cycle 0/COMP Task - Vote3 check" /begin SUB_GROUP S108_Process_Messages /end SUB_GROUP /end GROUP
/begin GROUP S90_COMP_Task___Calculate_Speed "HANcoder_E407_TTA_Controller_v2/HANcoder STM32 Target - E407-STM32 algorithm/Global Ticks Increment/CAN Management/Matrix Cycle Manager/controller basic cycle 1/COMP Task - Calculate Speed" /begin SUB_GROUP S332_Calculate_speed /end SUB_GROUP /end GROUP
/begin GROUP S90_COMP_Task___Calculate_Steer "HANcoder_E407_TTA_Controller_v2/HANcoder STM32 Target - E407-STM32 algorithm/Global Ticks Increment/CAN Management/Matrix Cycle Manager/controller basic cycle 1/COMP Task - Calculate Steer" /begin SUB_GROUP S333_Calculate_steering /end SUB_GROUP /end GROUP
/begin GROUP S90_COMP_Task___Calculate_Torque "HANcoder_E407_TTA_Controller_v2/HANcoder STM32 Target - E407-STM32 algorithm/Global Ticks Increment/CAN Management/Matrix Cycle Manager/controller basic cycle 1/COMP Task - Calculate Torque" /begin SUB_GROUP S334_Calculate_torque /end SUB_GROUP /end GROUP
/begin GROUP S90_COMP_Task___Rx_Output_Control1_Check "HANcoder_E407_TTA_Controller_v2/HANcoder STM32 Target - E407-STM32 algorithm/Global Ticks Increment/CAN Management/Matrix Cycle Manager/controller basic cycle 1/COMP Task - Rx_Output_Control1_Check" /begin SUB_GROUP S337_Process_Messages /end SUB_GROUP /end GROUP
/begin GROUP S90_COMP_Task___Rx_Output_Control2_Check "HANcoder_E407_TTA_Controller_v2/HANcoder STM32 Target - E407-STM32 algorithm/Global Ticks Increment/CAN Management/Matrix Cycle Manager/controller basic cycle 1/COMP Task - Rx_Output_Control2_Check" /begin SUB_GROUP S338_Process_Messages /end SUB_GROUP /end GROUP
/begin GROUP S90_COMP_Task___Rx_Output_Emulator_Check "HANcoder_E407_TTA_Controller_v2/HANcoder STM32 Target - E407-STM32 algorithm/Global Ticks Increment/CAN Management/Matrix Cycle Manager/controller basic cycle 1/COMP Task - Rx_Output_Emulator_Check" /begin SUB_GROUP S339_Process_Messages /end SUB_GROUP /end GROUP
/begin GROUP S90_COMP_Task___Rx_Sensor_Values_Check "HANcoder_E407_TTA_Controller_v2/HANcoder STM32 Target - E407-STM32 algorithm/Global Ticks Increment/CAN Management/Matrix Cycle Manager/controller basic cycle 1/COMP Task - Rx_Sensor_Values_Check" /begin SUB_GROUP S340_Process_Messages S340_Update_Msg_buffer /end SUB_GROUP /end GROUP
/begin GROUP S90_COMP_Task___Rx_Set_Values_Check "HANcoder_E407_TTA_Controller_v2/HANcoder STM32 Target - E407-STM32 algorithm/Global Ticks Increment/CAN Management/Matrix Cycle Manager/controller basic cycle 1/COMP Task - Rx_Set_Values_Check" /begin SUB_GROUP S341_Process_Messages S341_Update_Msg_buffer /end SUB_GROUP /end GROUP
/begin GROUP S90_COMP_Task___Sync_bc1_check "HANcoder_E407_TTA_Controller_v2/HANcoder STM32 Target - E407-STM32 algorithm/Global Ticks Increment/CAN Management/Matrix Cycle Manager/controller basic cycle 1/COMP Task - Sync bc1 check" /begin SUB_GROUP S342_Process_Messages /end SUB_GROUP /end GROUP
/begin GROUP S90_COMP_Task___TMR "HANcoder_E407_TTA_Controller_v2/HANcoder STM32 Target - E407-STM32 algorithm/Global Ticks Increment/CAN Management/Matrix Cycle Manager/controller basic cycle 1/COMP Task - TMR" /begin SUB_GROUP S343_TMR_main /end SUB_GROUP /end GROUP
/begin GROUP S49_msg_decoding "HANcoder_E407_TTA_Controller_v2/HANcoder STM32 Target - E407-STM32 algorithm/Global Ticks Increment/CAN Management/Initialization/RoleID and Global Time init/Global Time Initialization Slave/msg_decoding" /begin SUB_GROUP S50_Bit_Shift S50_Bit_Shift1 S50_Bit_Shift2 /end SUB_GROUP /end GROUP
/begin GROUP S96_Timeout_and_Board_error_counter "HANcoder_E407_TTA_Controller_v2/HANcoder STM32 Target - E407-STM32 algorithm/Global Ticks Increment/CAN Management/Matrix Cycle Manager/controller basic cycle 0/COMP Task - Check Timeouts/Timeout and Board error counter"
 /begin SUB_GROUP S196_Timeout_Counter_1_DEBUG S196_Timeout_Counter_2_DEBUG S196_Timeout_Counter_3_DEBUG /end SUB_GROUP
/end GROUP
/begin GROUP S100_Process_Messages "HANcoder_E407_TTA_Controller_v2/HANcoder STM32 Target - E407-STM32 algorithm/Global Ticks Increment/CAN Management/Matrix Cycle Manager/controller basic cycle 0/COMP Task - Sync bc0 check/Process_Messages"
 /begin SUB_GROUP S205_Demux_message_CAN1_and_check_coherence S205_Demux_message_CAN1_and_check_coherence1 /end SUB_GROUP
 /begin REF_MEASUREMENT Desync_Sync_bc0_s /end REF_MEASUREMENT
/end GROUP
/begin GROUP S102_Vote_Decision "HANcoder_E407_TTA_Controller_v2/HANcoder STM32 Target - E407-STM32 algorithm/Global Ticks Increment/CAN Management/Matrix Cycle Manager/controller basic cycle 0/COMP Task - Vote Decision/Vote Decision" /begin REF_MEASUREMENT Vote_s /end REF_MEASUREMENT /end GROUP
/begin GROUP S104_Process_Messages1 "HANcoder_E407_TTA_Controller_v2/HANcoder STM32 Target - E407-STM32 algorithm/Global Ticks Increment/CAN Management/Matrix Cycle Manager/controller basic cycle 0/COMP Task - Vote1 check/Process_Messages1"
 /begin SUB_GROUP S240_Demux_message_CAN1_and_check_coherence S240_Demux_message_CAN1_and_check_coherence1 /end SUB_GROUP
 /begin REF_MEASUREMENT Desync_Vote1_s Rx_msg_ticks_vote1_CAN1_s Rx_msg_ticks_vote1_CAN2_s expected_LT_vote1_CAN1_s expected_LT_vote1_CAN2_s /end REF_MEASUREMENT
/end GROUP
/begin GROUP S106_Process_Messages "HANcoder_E407_TTA_Controller_v2/HANcoder STM32 Target - E407-STM32 algorithm/Global Ticks Increment/CAN Management/Matrix Cycle Manager/controller basic cycle 0/COMP Task - Vote2 check/Process_Messages"
 /begin SUB_GROUP S269_Demux_message_CAN1_and_check_coherence S269_Demux_message_CAN1_and_check_coherence1 /end SUB_GROUP
 /begin REF_MEASUREMENT Desync_Vote2_s Rx_msg_ticks_vote2_CAN1_s Rx_msg_ticks_vote2_CAN2_s expected_LT_vote2_CAN1_s expected_LT_vote2_CAN2_s /end REF_MEASUREMENT
/end GROUP
/begin GROUP S108_Process_Messages "HANcoder_E407_TTA_Controller_v2/HANcoder STM32 Target - E407-STM32 algorithm/Global Ticks Increment/CAN Management/Matrix Cycle Manager/controller basic cycle 0/COMP Task - Vote3 check/Process_Messages"
 /begin SUB_GROUP S298_Demux_message_CAN1_and_check_coherence S298_Demux_message_CAN1_and_check_coherence1 /end SUB_GROUP
 /begin REF_MEASUREMENT Desync_Vote3_s Rx_msg_ticks_vote3_CAN1_s Rx_msg_ticks_vote3_CAN2_s expected_LT_vote3_CAN1_s expected_LT_vote3_CAN2_s /end REF_MEASUREMENT
/end GROUP
/begin GROUP S332_Calculate_speed "HANcoder_E407_TTA_Controller_v2/HANcoder STM32 Target - E407-STM32 algorithm/Global Ticks Increment/CAN Management/Matrix Cycle Manager/controller basic cycle 1/COMP Task - Calculate Speed/Calculate speed" /begin SUB_GROUP S527_Integral_speed /end SUB_GROUP /begin REF_CHARACTERISTIC speed_k_d speed_k_i speed_k_p /end REF_CHARACTERISTIC
 /begin REF_MEASUREMENT torque_al_set_s torque_ar_set_s torque_fl_set_s torque_fr_set_s v_ctreff_s v_est_s /end REF_MEASUREMENT
/end GROUP
/begin GROUP S333_Calculate_steering "HANcoder_E407_TTA_Controller_v2/HANcoder STM32 Target - E407-STM32 algorithm/Global Ticks Increment/CAN Management/Matrix Cycle Manager/controller basic cycle 1/COMP Task - Calculate Steer/Calculate steering" /begin SUB_GROUP S530_Integral_delta_a_est S530_Integral_delta_f_est /end SUB_GROUP
 /begin REF_MEASUREMENT delta_a_est_current_s delta_dot_a_prev_s delta_dot_a_s delta_dot_f_prev_s delta_dot_f_s delta_f_est_current_s rx_data_t_steerA_s rx_data_t_steerF_s theta_al_stored_s theta_ar_stored_s theta_fl_stored_s theta_fr_stored_s /end REF_MEASUREMENT
/end GROUP
/begin GROUP S334_Calculate_torque "HANcoder_E407_TTA_Controller_v2/HANcoder STM32 Target - E407-STM32 algorithm/Global Ticks Increment/CAN Management/Matrix Cycle Manager/controller basic cycle 1/COMP Task - Calculate Torque/Calculate torque"
 /begin REF_CHARACTERISTIC torque_a_k_d torque_a_k_i torque_a_k_p torque_f_k_d torque_f_k_i torque_f_k_p /end REF_CHARACTERISTIC
/end GROUP
/begin GROUP S337_Process_Messages "HANcoder_E407_TTA_Controller_v2/HANcoder STM32 Target - E407-STM32 algorithm/Global Ticks Increment/CAN Management/Matrix Cycle Manager/controller basic cycle 1/COMP Task - Rx_Output_Control1_Check/Process_Messages"
 /begin SUB_GROUP S552_Demux_message_CAN1_and_check_coherence S552_Demux_message_CAN1_and_check_coherence1 /end SUB_GROUP
 /begin REF_MEASUREMENT Desync_outcontrol1_s Rx_msg_ticks_outcontrol1_CAN1_s Rx_msg_ticks_outcontrol1_CAN2_s expected_LT_outcontrol1_CAN1_s expected_LT_outcontrol1_CAN2_s out1_rx_s /end REF_MEASUREMENT
/end GROUP
/begin GROUP S338_Process_Messages "HANcoder_E407_TTA_Controller_v2/HANcoder STM32 Target - E407-STM32 algorithm/Global Ticks Increment/CAN Management/Matrix Cycle Manager/controller basic cycle 1/COMP Task - Rx_Output_Control2_Check/Process_Messages"
 /begin SUB_GROUP S581_Demux_message_CAN1_and_check_coherence S581_Demux_message_CAN1_and_check_coherence1 /end SUB_GROUP
 /begin REF_MEASUREMENT Desync_outcontrol2_s Rx_msg_ticks_outcontrol2_CAN1_s Rx_msg_ticks_outcontrol2_CAN2_s expected_LT_outcontrol2_CAN1_s expected_LT_outcontrol2_CAN2_s out2_rx_s /end REF_MEASUREMENT
/end GROUP
/begin GROUP S339_Process_Messages "HANcoder_E407_TTA_Controller_v2/HANcoder STM32 Target - E407-STM32 algorithm/Global Ticks Increment/CAN Management/Matrix Cycle Manager/controller basic cycle 1/COMP Task - Rx_Output_Emulator_Check/Process_Messages"
 /begin SUB_GROUP S609_Demux_message_CAN1_and_check_coherence S609_Demux_message_CAN1_and_check_coherence1 /end SUB_GROUP
 /begin REF_MEASUREMENT Desync_outemulator_s Rx_msg_ticks_outemulator_CAN1_s Rx_msg_ticks_outemulator_CAN2_s expected_LT_outemulator_CAN1_s expected_LT_outemulator_CAN2_s /end REF_MEASUREMENT
/end GROUP
/begin GROUP S340_Process_Messages "HANcoder_E407_TTA_Controller_v2/HANcoder STM32 Target - E407-STM32 algorithm/Global Ticks Increment/CAN Management/Matrix Cycle Manager/controller basic cycle 1/COMP Task - Rx_Sensor_Values_Check/Process_Messages"
 /begin SUB_GROUP S637_Demux_message_CAN1_and_check_coherence S637_Demux_message_CAN1_and_check_coherence1 /end SUB_GROUP
 /begin REF_MEASUREMENT Desync_sensorvalues_s Rx_msg_ticks_sensorvalues_CAN1_s Rx_msg_ticks_sensorvalues_CAN2_s expected_LT_sensorvalues_CAN1_s expected_LT_sensorvalues_CAN2_s /end REF_MEASUREMENT
/end GROUP
/begin GROUP S340_Update_Msg_buffer "HANcoder_E407_TTA_Controller_v2/HANcoder STM32 Target - E407-STM32 algorithm/Global Ticks Increment/CAN Management/Matrix Cycle Manager/controller basic cycle 1/COMP Task - Rx_Sensor_Values_Check/Update Msg buffer" /begin REF_MEASUREMENT new_sensor_rx_s /end REF_MEASUREMENT /end GROUP
/begin GROUP S341_Process_Messages "HANcoder_E407_TTA_Controller_v2/HANcoder STM32 Target - E407-STM32 algorithm/Global Ticks Increment/CAN Management/Matrix Cycle Manager/controller basic cycle 1/COMP Task - Rx_Set_Values_Check/Process_Messages"
 /begin SUB_GROUP S690_Demux_message_CAN1_and_check_coherence S690_Demux_message_CAN1_and_check_coherence1 /end SUB_GROUP
 /begin REF_MEASUREMENT Desync_setvalues_s Rx_msg_ticks_setvalues_CAN1_s Rx_msg_ticks_setvalues_CAN2_s expected_LT_setvalues_CAN1_s expected_LT_setvalues_CAN2_s /end REF_MEASUREMENT
/end GROUP
/begin GROUP S341_Update_Msg_buffer "HANcoder_E407_TTA_Controller_v2/HANcoder STM32 Target - E407-STM32 algorithm/Global Ticks Increment/CAN Management/Matrix Cycle Manager/controller basic cycle 1/COMP Task - Rx_Set_Values_Check/Update Msg buffer" /begin REF_MEASUREMENT new_set_rx_s /end REF_MEASUREMENT /end GROUP
/begin GROUP S342_Process_Messages "HANcoder_E407_TTA_Controller_v2/HANcoder STM32 Target - E407-STM32 algorithm/Global Ticks Increment/CAN Management/Matrix Cycle Manager/controller basic cycle 1/COMP Task - Sync bc1 check/Process_Messages"
 /begin SUB_GROUP S736_Demux_message_CAN1_and_check_coherence S736_Demux_message_CAN1_and_check_coherence1 /end SUB_GROUP
 /begin REF_MEASUREMENT Desync_Sync_bc1_s /end REF_MEASUREMENT
/end GROUP
/begin GROUP S343_TMR_main "HANcoder_E407_TTA_Controller_v2/HANcoder STM32 Target - E407-STM32 algorithm/Global Ticks Increment/CAN Management/Matrix Cycle Manager/controller basic cycle 1/COMP Task - TMR/TMR_main"
 /begin SUB_GROUP S766_Agreement_Out1 S766_Agreement_Out2 S766_Agreement_Out3 S766_Bit_Shift S766_Bit_Shift1 S766_Bit_Shift2 S766_Bit_Shift3 S766_Bit_Shift4 S766_Bit_Shift5 S766_Bit_Shift6 /end SUB_GROUP
 /begin REF_MEASUREMENT TMR_miss1_sensor TMR_miss1_set TMR_miss2_sensor TMR_miss2_set TMR_miss_out1 TMR_miss_out2 TMR_miss_sensor TMR_miss_set error_log1_s error_log2_s error_log3_s /end REF_MEASUREMENT
/end GROUP
/begin GROUP S50_Bit_Shift "HANcoder_E407_TTA_Controller_v2/HANcoder STM32 Target - E407-STM32 algorithm/Global Ticks Increment/CAN Management/Initialization/RoleID and Global Time init/Global Time Initialization Slave/msg_decoding/Bit Shift" /begin REF_MEASUREMENT Rx_init_bc /end REF_MEASUREMENT /end GROUP
/begin GROUP S50_Bit_Shift1 "HANcoder_E407_TTA_Controller_v2/HANcoder STM32 Target - E407-STM32 algorithm/Global Ticks Increment/CAN Management/Initialization/RoleID and Global Time init/Global Time Initialization Slave/msg_decoding/Bit Shift1" /begin REF_MEASUREMENT Rx_init_mc /end REF_MEASUREMENT /end GROUP
/begin GROUP S50_Bit_Shift2 "HANcoder_E407_TTA_Controller_v2/HANcoder STM32 Target - E407-STM32 algorithm/Global Ticks Increment/CAN Management/Initialization/RoleID and Global Time init/Global Time Initialization Slave/msg_decoding/Bit Shift2" /begin REF_MEASUREMENT Rx_init_id /end REF_MEASUREMENT /end GROUP
/begin GROUP S196_Timeout_Counter_1_DEBUG "HANcoder_E407_TTA_Controller_v2/HANcoder STM32 Target - E407-STM32 algorithm/Global Ticks Increment/CAN Management/Matrix Cycle Manager/controller basic cycle 0/COMP Task - Check Timeouts/Timeout and Board error counter/Timeout Counter 1 DEBUG" /begin REF_MEASUREMENT TM1_timeout_counter_s /end REF_MEASUREMENT /end GROUP
/begin GROUP S196_Timeout_Counter_2_DEBUG "HANcoder_E407_TTA_Controller_v2/HANcoder STM32 Target - E407-STM32 algorithm/Global Ticks Increment/CAN Management/Matrix Cycle Manager/controller basic cycle 0/COMP Task - Check Timeouts/Timeout and Board error counter/Timeout Counter 2 DEBUG" /begin REF_MEASUREMENT TM2_timeout_counter_s /end REF_MEASUREMENT /end GROUP
/begin GROUP S196_Timeout_Counter_3_DEBUG "HANcoder_E407_TTA_Controller_v2/HANcoder STM32 Target - E407-STM32 algorithm/Global Ticks Increment/CAN Management/Matrix Cycle Manager/controller basic cycle 0/COMP Task - Check Timeouts/Timeout and Board error counter/Timeout Counter 3 DEBUG" /begin REF_MEASUREMENT TM3_timeout_counter_s /end REF_MEASUREMENT /end GROUP
/begin GROUP S205_Demux_message_CAN1_and_check_coherence "HANcoder_E407_TTA_Controller_v2/HANcoder STM32 Target - E407-STM32 algorithm/Global Ticks Increment/CAN Management/Matrix Cycle Manager/controller basic cycle 0/COMP Task - Sync bc0 check/Process_Messages/Demux message CAN1 and check coherence" /begin SUB_GROUP S207_Subsystem /end SUB_GROUP /end GROUP
/begin GROUP S205_Demux_message_CAN1_and_check_coherence1 "HANcoder_E407_TTA_Controller_v2/HANcoder STM32 Target - E407-STM32 algorithm/Global Ticks Increment/CAN Management/Matrix Cycle Manager/controller basic cycle 0/COMP Task - Sync bc0 check/Process_Messages/Demux message CAN1 and check coherence1" /begin SUB_GROUP S208_Subsystem /end SUB_GROUP /end GROUP
/begin GROUP S240_Demux_message_CAN1_and_check_coherence "HANcoder_E407_TTA_Controller_v2/HANcoder STM32 Target - E407-STM32 algorithm/Global Ticks Increment/CAN Management/Matrix Cycle Manager/controller basic cycle 0/COMP Task - Vote1 check/Process_Messages1/Demux message CAN1 and check coherence" /begin SUB_GROUP S242_Subsystem /end SUB_GROUP /begin REF_MEASUREMENT Rx_temporal_vote1_CAN1 /end REF_MEASUREMENT /end GROUP
/begin GROUP S240_Demux_message_CAN1_and_check_coherence1 "HANcoder_E407_TTA_Controller_v2/HANcoder STM32 Target - E407-STM32 algorithm/Global Ticks Increment/CAN Management/Matrix Cycle Manager/controller basic cycle 0/COMP Task - Vote1 check/Process_Messages1/Demux message CAN1 and check coherence1" /begin SUB_GROUP S243_Subsystem /end SUB_GROUP /begin REF_MEASUREMENT Rx_temporal_vote1_CAN2 /end REF_MEASUREMENT /end GROUP
/begin GROUP S269_Demux_message_CAN1_and_check_coherence "HANcoder_E407_TTA_Controller_v2/HANcoder STM32 Target - E407-STM32 algorithm/Global Ticks Increment/CAN Management/Matrix Cycle Manager/controller basic cycle 0/COMP Task - Vote2 check/Process_Messages/Demux message CAN1 and check coherence" /begin SUB_GROUP S271_Subsystem /end SUB_GROUP /begin REF_MEASUREMENT Rx_temporal_vote2_CAN1 /end REF_MEASUREMENT /end GROUP
/begin GROUP S269_Demux_message_CAN1_and_check_coherence1 "HANcoder_E407_TTA_Controller_v2/HANcoder STM32 Target - E407-STM32 algorithm/Global Ticks Increment/CAN Management/Matrix Cycle Manager/controller basic cycle 0/COMP Task - Vote2 check/Process_Messages/Demux message CAN1 and check coherence1" /begin SUB_GROUP S272_Subsystem /end SUB_GROUP /begin REF_MEASUREMENT Rx_temporal_vote2_CAN2 /end REF_MEASUREMENT /end GROUP
/begin GROUP S298_Demux_message_CAN1_and_check_coherence "HANcoder_E407_TTA_Controller_v2/HANcoder STM32 Target - E407-STM32 algorithm/Global Ticks Increment/CAN Management/Matrix Cycle Manager/controller basic cycle 0/COMP Task - Vote3 check/Process_Messages/Demux message CAN1 and check coherence" /begin SUB_GROUP S300_Subsystem /end SUB_GROUP /begin REF_MEASUREMENT Rx_temporal_vote3_CAN1 /end REF_MEASUREMENT /end GROUP
/begin GROUP S298_Demux_message_CAN1_and_check_coherence1 "HANcoder_E407_TTA_Controller_v2/HANcoder STM32 Target - E407-STM32 algorithm/Global Ticks Increment/CAN Management/Matrix Cycle Manager/controller basic cycle 0/COMP Task - Vote3 check/Process_Messages/Demux message CAN1 and check coherence1" /begin SUB_GROUP S301_Subsystem /end SUB_GROUP /begin REF_MEASUREMENT Rx_temporal_vote3_CAN2 /end REF_MEASUREMENT /end GROUP
/begin GROUP S527_Integral_speed "HANcoder_E407_TTA_Controller_v2/HANcoder STM32 Target - E407-STM32 algorithm/Global Ticks Increment/CAN Management/Matrix Cycle Manager/controller basic cycle 1/COMP Task - Calculate Speed/Calculate speed/Integral speed" /begin REF_MEASUREMENT v_integral_s /end REF_MEASUREMENT /end GROUP
/begin GROUP S530_Integral_delta_a_est "HANcoder_E407_TTA_Controller_v2/HANcoder STM32 Target - E407-STM32 algorithm/Global Ticks Increment/CAN Management/Matrix Cycle Manager/controller basic cycle 1/COMP Task - Calculate Steer/Calculate steering/Integral_delta_a_est" /begin REF_MEASUREMENT delta_a_est_s /end REF_MEASUREMENT /end GROUP
/begin GROUP S530_Integral_delta_f_est "HANcoder_E407_TTA_Controller_v2/HANcoder STM32 Target - E407-STM32 algorithm/Global Ticks Increment/CAN Management/Matrix Cycle Manager/controller basic cycle 1/COMP Task - Calculate Steer/Calculate steering/Integral_delta_f_est" /begin REF_MEASUREMENT delta_f_est_s /end REF_MEASUREMENT /end GROUP
/begin GROUP S552_Demux_message_CAN1_and_check_coherence "HANcoder_E407_TTA_Controller_v2/HANcoder STM32 Target - E407-STM32 algorithm/Global Ticks Increment/CAN Management/Matrix Cycle Manager/controller basic cycle 1/COMP Task - Rx_Output_Control1_Check/Process_Messages/Demux message CAN1 and check coherence" /begin SUB_GROUP S554_Subsystem /end SUB_GROUP /begin REF_MEASUREMENT Rx_temporal_outcontrol1_CAN1 /end REF_MEASUREMENT /end GROUP
/begin GROUP S552_Demux_message_CAN1_and_check_coherence1 "HANcoder_E407_TTA_Controller_v2/HANcoder STM32 Target - E407-STM32 algorithm/Global Ticks Increment/CAN Management/Matrix Cycle Manager/controller basic cycle 1/COMP Task - Rx_Output_Control1_Check/Process_Messages/Demux message CAN1 and check coherence1" /begin SUB_GROUP S555_Subsystem /end SUB_GROUP /begin REF_MEASUREMENT Rx_temporal_outcontrol1_CAN2 /end REF_MEASUREMENT /end GROUP
/begin GROUP S581_Demux_message_CAN1_and_check_coherence "HANcoder_E407_TTA_Controller_v2/HANcoder STM32 Target - E407-STM32 algorithm/Global Ticks Increment/CAN Management/Matrix Cycle Manager/controller basic cycle 1/COMP Task - Rx_Output_Control2_Check/Process_Messages/Demux message CAN1 and check coherence" /begin SUB_GROUP S583_Subsystem /end SUB_GROUP /begin REF_MEASUREMENT Rx_temporal_outcontrol2_CAN1 /end REF_MEASUREMENT /end GROUP
/begin GROUP S581_Demux_message_CAN1_and_check_coherence1 "HANcoder_E407_TTA_Controller_v2/HANcoder STM32 Target - E407-STM32 algorithm/Global Ticks Increment/CAN Management/Matrix Cycle Manager/controller basic cycle 1/COMP Task - Rx_Output_Control2_Check/Process_Messages/Demux message CAN1 and check coherence1" /begin SUB_GROUP S584_Subsystem /end SUB_GROUP /begin REF_MEASUREMENT Rx_temporal_outcontrol2_CAN2 /end REF_MEASUREMENT /end GROUP
/begin GROUP S609_Demux_message_CAN1_and_check_coherence "HANcoder_E407_TTA_Controller_v2/HANcoder STM32 Target - E407-STM32 algorithm/Global Ticks Increment/CAN Management/Matrix Cycle Manager/controller basic cycle 1/COMP Task - Rx_Output_Emulator_Check/Process_Messages/Demux message CAN1 and check coherence" /begin SUB_GROUP S611_Subsystem /end SUB_GROUP /begin REF_MEASUREMENT Rx_temporal_outemulator_CAN1 /end REF_MEASUREMENT /end GROUP
/begin GROUP S609_Demux_message_CAN1_and_check_coherence1 "HANcoder_E407_TTA_Controller_v2/HANcoder STM32 Target - E407-STM32 algorithm/Global Ticks Increment/CAN Management/Matrix Cycle Manager/controller basic cycle 1/COMP Task - Rx_Output_Emulator_Check/Process_Messages/Demux message CAN1 and check coherence1" /begin SUB_GROUP S612_Subsystem /end SUB_GROUP /begin REF_MEASUREMENT Rx_temporal_outemulator_CAN2 /end REF_MEASUREMENT /end GROUP
/begin GROUP S637_Demux_message_CAN1_and_check_coherence "HANcoder_E407_TTA_Controller_v2/HANcoder STM32 Target - E407-STM32 algorithm/Global Ticks Increment/CAN Management/Matrix Cycle Manager/controller basic cycle 1/COMP Task - Rx_Sensor_Values_Check/Process_Messages/Demux message CAN1 and check coherence" /begin SUB_GROUP S640_Subsystem /end SUB_GROUP /begin REF_MEASUREMENT Rx_temporal_sensorvalues_CAN1 /end REF_MEASUREMENT /end GROUP
/begin GROUP S637_Demux_message_CAN1_and_check_coherence1 "HANcoder_E407_TTA_Controller_v2/HANcoder STM32 Target - E407-STM32 algorithm/Global Ticks Increment/CAN Management/Matrix Cycle Manager/controller basic cycle 1/COMP Task - Rx_Sensor_Values_Check/Process_Messages/Demux message CAN1 and check coherence1" /begin SUB_GROUP S641_Subsystem /end SUB_GROUP /begin REF_MEASUREMENT Rx_temporal_sensorvalues_CAN2 /end REF_MEASUREMENT /end GROUP
/begin GROUP S690_Demux_message_CAN1_and_check_coherence "HANcoder_E407_TTA_Controller_v2/HANcoder STM32 Target - E407-STM32 algorithm/Global Ticks Increment/CAN Management/Matrix Cycle Manager/controller basic cycle 1/COMP Task - Rx_Set_Values_Check/Process_Messages/Demux message CAN1 and check coherence" /begin SUB_GROUP S693_Subsystem /end SUB_GROUP /begin REF_MEASUREMENT Rx_temporal_setvalues_CAN1 /end REF_MEASUREMENT /end GROUP
/begin GROUP S690_Demux_message_CAN1_and_check_coherence1 "HANcoder_E407_TTA_Controller_v2/HANcoder STM32 Target - E407-STM32 algorithm/Global Ticks Increment/CAN Management/Matrix Cycle Manager/controller basic cycle 1/COMP Task - Rx_Set_Values_Check/Process_Messages/Demux message CAN1 and check coherence1" /begin SUB_GROUP S694_Subsystem /end SUB_GROUP /begin REF_MEASUREMENT Rx_temporal_setvalues_CAN2 /end REF_MEASUREMENT /end GROUP
/begin GROUP S736_Demux_message_CAN1_and_check_coherence "HANcoder_E407_TTA_Controller_v2/HANcoder STM32 Target - E407-STM32 algorithm/Global Ticks Increment/CAN Management/Matrix Cycle Manager/controller basic cycle 1/COMP Task - Sync bc1 check/Process_Messages/Demux message CAN1 and check coherence" /begin SUB_GROUP S738_Subsystem /end SUB_GROUP /end GROUP
/begin GROUP S736_Demux_message_CAN1_and_check_coherence1 "HANcoder_E407_TTA_Controller_v2/HANcoder STM32 Target - E407-STM32 algorithm/Global Ticks Increment/CAN Management/Matrix Cycle Manager/controller basic cycle 1/COMP Task - Sync bc1 check/Process_Messages/Demux message CAN1 and check coherence1" /begin SUB_GROUP S739_Subsystem /end SUB_GROUP /end GROUP
/begin GROUP S766_Agreement_Out1 "HANcoder_E407_TTA_Controller_v2/HANcoder STM32 Target - E407-STM32 algorithm/Global Ticks Increment/CAN Management/Matrix Cycle Manager/controller basic cycle 1/COMP Task - TMR/TMR_main/Agreement Out1"
 /begin REF_MEASUREMENT tau_al1_agree_s tau_ar1_agree_s tau_fl1_agree_s tau_fr1_agree_s /end REF_MEASUREMENT
/end GROUP
/begin GROUP S766_Agreement_Out2 "HANcoder_E407_TTA_Controller_v2/HANcoder STM32 Target - E407-STM32 algorithm/Global Ticks Increment/CAN Management/Matrix Cycle Manager/controller basic cycle 1/COMP Task - TMR/TMR_main/Agreement Out2"
 /begin REF_MEASUREMENT tau_al2_agree_s tau_ar2_agree_s tau_fl2_agree_s tau_fr2_agree_s /end REF_MEASUREMENT
/end GROUP
/begin GROUP S766_Agreement_Out3 "HANcoder_E407_TTA_Controller_v2/HANcoder STM32 Target - E407-STM32 algorithm/Global Ticks Increment/CAN Management/Matrix Cycle Manager/controller basic cycle 1/COMP Task - TMR/TMR_main/Agreement Out3"
 /begin REF_MEASUREMENT tau_al_agree_s tau_ar_agree_s tau_fl_agree_s tau_fr_agree_s /end REF_MEASUREMENT
/end GROUP
/begin GROUP S766_Bit_Shift "HANcoder_E407_TTA_Controller_v2/HANcoder STM32 Target - E407-STM32 algorithm/Global Ticks Increment/CAN Management/Matrix Cycle Manager/controller basic cycle 1/COMP Task - TMR/TMR_main/Bit Shift" /begin REF_MEASUREMENT shift1_s /end REF_MEASUREMENT /end GROUP
/begin GROUP S766_Bit_Shift1 "HANcoder_E407_TTA_Controller_v2/HANcoder STM32 Target - E407-STM32 algorithm/Global Ticks Increment/CAN Management/Matrix Cycle Manager/controller basic cycle 1/COMP Task - TMR/TMR_main/Bit Shift1" /begin REF_MEASUREMENT shift2_s /end REF_MEASUREMENT /end GROUP
/begin GROUP S766_Bit_Shift2 "HANcoder_E407_TTA_Controller_v2/HANcoder STM32 Target - E407-STM32 algorithm/Global Ticks Increment/CAN Management/Matrix Cycle Manager/controller basic cycle 1/COMP Task - TMR/TMR_main/Bit Shift2" /begin REF_MEASUREMENT shift3_s /end REF_MEASUREMENT /end GROUP
/begin GROUP S766_Bit_Shift3 "HANcoder_E407_TTA_Controller_v2/HANcoder STM32 Target - E407-STM32 algorithm/Global Ticks Increment/CAN Management/Matrix Cycle Manager/controller basic cycle 1/COMP Task - TMR/TMR_main/Bit Shift3" /begin REF_MEASUREMENT shift4_s /end REF_MEASUREMENT /end GROUP
/begin GROUP S766_Bit_Shift4 "HANcoder_E407_TTA_Controller_v2/HANcoder STM32 Target - E407-STM32 algorithm/Global Ticks Increment/CAN Management/Matrix Cycle Manager/controller basic cycle 1/COMP Task - TMR/TMR_main/Bit Shift4" /begin REF_MEASUREMENT shift5_s /end REF_MEASUREMENT /end GROUP
/begin GROUP S766_Bit_Shift5 "HANcoder_E407_TTA_Controller_v2/HANcoder STM32 Target - E407-STM32 algorithm/Global Ticks Increment/CAN Management/Matrix Cycle Manager/controller basic cycle 1/COMP Task - TMR/TMR_main/Bit Shift5" /begin REF_MEASUREMENT shift6_s /end REF_MEASUREMENT /end GROUP
/begin GROUP S766_Bit_Shift6 "HANcoder_E407_TTA_Controller_v2/HANcoder STM32 Target - E407-STM32 algorithm/Global Ticks Increment/CAN Management/Matrix Cycle Manager/controller basic cycle 1/COMP Task - TMR/TMR_main/Bit Shift6" /begin REF_MEASUREMENT shift7_s /end REF_MEASUREMENT /end GROUP
/begin GROUP S207_Subsystem "HANcoder_E407_TTA_Controller_v2/HANcoder STM32 Target - E407-STM32 algorithm/Global Ticks Increment/CAN Management/Matrix Cycle Manager/controller basic cycle 0/COMP Task - Sync bc0 check/Process_Messages/Demux message CAN1 and check coherence/Subsystem" /begin SUB_GROUP S209_Bit_Shift S209_Bit_Shift1 S209_Bit_Shift2 /end SUB_GROUP /end GROUP
/begin GROUP S208_Subsystem "HANcoder_E407_TTA_Controller_v2/HANcoder STM32 Target - E407-STM32 algorithm/Global Ticks Increment/CAN Management/Matrix Cycle Manager/controller basic cycle 0/COMP Task - Sync bc0 check/Process_Messages/Demux message CAN1 and check coherence1/Subsystem" /begin SUB_GROUP S221_Bit_Shift S221_Bit_Shift1 S221_Bit_Shift2 /end SUB_GROUP /end GROUP
/begin GROUP S242_Subsystem "HANcoder_E407_TTA_Controller_v2/HANcoder STM32 Target - E407-STM32 algorithm/Global Ticks Increment/CAN Management/Matrix Cycle Manager/controller basic cycle 0/COMP Task - Vote1 check/Process_Messages1/Demux message CAN1 and check coherence/Subsystem" /begin SUB_GROUP S244_Bit_Shift S244_Bit_Shift1 S244_Bit_Shift2 /end SUB_GROUP /end GROUP
/begin GROUP S243_Subsystem "HANcoder_E407_TTA_Controller_v2/HANcoder STM32 Target - E407-STM32 algorithm/Global Ticks Increment/CAN Management/Matrix Cycle Manager/controller basic cycle 0/COMP Task - Vote1 check/Process_Messages1/Demux message CAN1 and check coherence1/Subsystem" /begin SUB_GROUP S256_Bit_Shift S256_Bit_Shift1 S256_Bit_Shift2 /end SUB_GROUP /end GROUP
/begin GROUP S271_Subsystem "HANcoder_E407_TTA_Controller_v2/HANcoder STM32 Target - E407-STM32 algorithm/Global Ticks Increment/CAN Management/Matrix Cycle Manager/controller basic cycle 0/COMP Task - Vote2 check/Process_Messages/Demux message CAN1 and check coherence/Subsystem" /begin SUB_GROUP S273_Bit_Shift S273_Bit_Shift1 S273_Bit_Shift2 /end SUB_GROUP /end GROUP
/begin GROUP S272_Subsystem "HANcoder_E407_TTA_Controller_v2/HANcoder STM32 Target - E407-STM32 algorithm/Global Ticks Increment/CAN Management/Matrix Cycle Manager/controller basic cycle 0/COMP Task - Vote2 check/Process_Messages/Demux message CAN1 and check coherence1/Subsystem" /begin SUB_GROUP S285_Bit_Shift S285_Bit_Shift1 S285_Bit_Shift2 /end SUB_GROUP /end GROUP
/begin GROUP S300_Subsystem "HANcoder_E407_TTA_Controller_v2/HANcoder STM32 Target - E407-STM32 algorithm/Global Ticks Increment/CAN Management/Matrix Cycle Manager/controller basic cycle 0/COMP Task - Vote3 check/Process_Messages/Demux message CAN1 and check coherence/Subsystem" /begin SUB_GROUP S302_Bit_Shift S302_Bit_Shift1 S302_Bit_Shift2 /end SUB_GROUP /end GROUP
/begin GROUP S301_Subsystem "HANcoder_E407_TTA_Controller_v2/HANcoder STM32 Target - E407-STM32 algorithm/Global Ticks Increment/CAN Management/Matrix Cycle Manager/controller basic cycle 0/COMP Task - Vote3 check/Process_Messages/Demux message CAN1 and check coherence1/Subsystem" /begin SUB_GROUP S314_Bit_Shift S314_Bit_Shift1 S314_Bit_Shift2 /end SUB_GROUP /end GROUP
/begin GROUP S554_Subsystem "HANcoder_E407_TTA_Controller_v2/HANcoder STM32 Target - E407-STM32 algorithm/Global Ticks Increment/CAN Management/Matrix Cycle Manager/controller basic cycle 1/COMP Task - Rx_Output_Control1_Check/Process_Messages/Demux message CAN1 and check coherence/Subsystem" /begin SUB_GROUP S556_Bit_Shift S556_Bit_Shift1 S556_Bit_Shift2 /end SUB_GROUP /end GROUP
/begin GROUP S555_Subsystem "HANcoder_E407_TTA_Controller_v2/HANcoder STM32 Target - E407-STM32 algorithm/Global Ticks Increment/CAN Management/Matrix Cycle Manager/controller basic cycle 1/COMP Task - Rx_Output_Control1_Check/Process_Messages/Demux message CAN1 and check coherence1/Subsystem" /begin SUB_GROUP S568_Bit_Shift S568_Bit_Shift1 S568_Bit_Shift2 /end SUB_GROUP /end GROUP
/begin GROUP S583_Subsystem "HANcoder_E407_TTA_Controller_v2/HANcoder STM32 Target - E407-STM32 algorithm/Global Ticks Increment/CAN Management/Matrix Cycle Manager/controller basic cycle 1/COMP Task - Rx_Output_Control2_Check/Process_Messages/Demux message CAN1 and check coherence/Subsystem" /begin SUB_GROUP S585_Bit_Shift S585_Bit_Shift1 S585_Bit_Shift2 /end SUB_GROUP /end GROUP
/begin GROUP S584_Subsystem "HANcoder_E407_TTA_Controller_v2/HANcoder STM32 Target - E407-STM32 algorithm/Global Ticks Increment/CAN Management/Matrix Cycle Manager/controller basic cycle 1/COMP Task - Rx_Output_Control2_Check/Process_Messages/Demux message CAN1 and check coherence1/Subsystem" /begin SUB_GROUP S597_Bit_Shift S597_Bit_Shift1 S597_Bit_Shift2 /end SUB_GROUP /end GROUP
/begin GROUP S611_Subsystem "HANcoder_E407_TTA_Controller_v2/HANcoder STM32 Target - E407-STM32 algorithm/Global Ticks Increment/CAN Management/Matrix Cycle Manager/controller basic cycle 1/COMP Task - Rx_Output_Emulator_Check/Process_Messages/Demux message CAN1 and check coherence/Subsystem" /begin SUB_GROUP S613_Bit_Shift S613_Bit_Shift1 S613_Bit_Shift2 /end SUB_GROUP /end GROUP
/begin GROUP S612_Subsystem "HANcoder_E407_TTA_Controller_v2/HANcoder STM32 Target - E407-STM32 algorithm/Global Ticks Increment/CAN Management/Matrix Cycle Manager/controller basic cycle 1/COMP Task - Rx_Output_Emulator_Check/Process_Messages/Demux message CAN1 and check coherence1/Subsystem" /begin SUB_GROUP S625_Bit_Shift S625_Bit_Shift1 S625_Bit_Shift2 /end SUB_GROUP /end GROUP
/begin GROUP S640_Subsystem "HANcoder_E407_TTA_Controller_v2/HANcoder STM32 Target - E407-STM32 algorithm/Global Ticks Increment/CAN Management/Matrix Cycle Manager/controller basic cycle 1/COMP Task - Rx_Sensor_Values_Check/Process_Messages/Demux message CAN1 and check coherence/Subsystem" /begin SUB_GROUP S642_Bit_Shift S642_Bit_Shift1 S642_Bit_Shift2 /end SUB_GROUP /end GROUP
/begin GROUP S641_Subsystem "HANcoder_E407_TTA_Controller_v2/HANcoder STM32 Target - E407-STM32 algorithm/Global Ticks Increment/CAN Management/Matrix Cycle Manager/controller basic cycle 1/COMP Task - Rx_Sensor_Values_Check/Process_Messages/Demux message CAN1 and check coherence1/Subsystem" /begin SUB_GROUP S654_Bit_Shift S654_Bit_Shift1 S654_Bit_Shift2 /end SUB_GROUP /end GROUP
/begin GROUP S693_Subsystem "HANcoder_E407_TTA_Controller_v2/HANcoder STM32 Target - E407-STM32 algorithm/Global Ticks Increment/CAN Management/Matrix Cycle Manager/controller basic cycle 1/COMP Task - Rx_Set_Values_Check/Process_Messages/Demux message CAN1 and check coherence/Subsystem" /begin SUB_GROUP S695_Bit_Shift S695_Bit_Shift1 S695_Bit_Shift2 /end SUB_GROUP /end GROUP
/begin GROUP S694_Subsystem "HANcoder_E407_TTA_Controller_v2/HANcoder STM32 Target - E407-STM32 algorithm/Global Ticks Increment/CAN Management/Matrix Cycle Manager/controller basic cycle 1/COMP Task - Rx_Set_Values_Check/Process_Messages/Demux message CAN1 and check coherence1/Subsystem" /begin SUB_GROUP S707_Bit_Shift S707_Bit_Shift1 S707_Bit_Shift2 /end SUB_GROUP /end GROUP
/begin GROUP S738_Subsystem "HANcoder_E407_TTA_Controller_v2/HANcoder STM32 Target - E407-STM32 algorithm/Global Ticks Increment/CAN Management/Matrix Cycle Manager/controller basic cycle 1/COMP Task - Sync bc1 check/Process_Messages/Demux message CAN1 and check coherence/Subsystem" /begin SUB_GROUP S740_Bit_Shift S740_Bit_Shift1 S740_Bit_Shift2 /end SUB_GROUP /end GROUP
/begin GROUP S739_Subsystem "HANcoder_E407_TTA_Controller_v2/HANcoder STM32 Target - E407-STM32 algorithm/Global Ticks Increment/CAN Management/Matrix Cycle Manager/controller basic cycle 1/COMP Task - Sync bc1 check/Process_Messages/Demux message CAN1 and check coherence1/Subsystem" /begin SUB_GROUP S752_Bit_Shift S752_Bit_Shift1 S752_Bit_Shift2 /end SUB_GROUP /end GROUP
/begin GROUP S209_Bit_Shift "HANcoder_E407_TTA_Controller_v2/HANcoder STM32 Target - E407-STM32 algorithm/Global Ticks Increment/CAN Management/Matrix Cycle Manager/controller basic cycle 0/COMP Task - Sync bc0 check/Process_Messages/Demux message CAN1 and check coherence/Subsystem/Bit Shift" /begin REF_MEASUREMENT Rx_bc_sync0_CAN1 /end REF_MEASUREMENT /end GROUP
/begin GROUP S209_Bit_Shift1 "HANcoder_E407_TTA_Controller_v2/HANcoder STM32 Target - E407-STM32 algorithm/Global Ticks Increment/CAN Management/Matrix Cycle Manager/controller basic cycle 0/COMP Task - Sync bc0 check/Process_Messages/Demux message CAN1 and check coherence/Subsystem/Bit Shift1" /begin REF_MEASUREMENT Rx_mc_sync0_CAN1 /end REF_MEASUREMENT /end GROUP
/begin GROUP S209_Bit_Shift2 "HANcoder_E407_TTA_Controller_v2/HANcoder STM32 Target - E407-STM32 algorithm/Global Ticks Increment/CAN Management/Matrix Cycle Manager/controller basic cycle 0/COMP Task - Sync bc0 check/Process_Messages/Demux message CAN1 and check coherence/Subsystem/Bit Shift2" /begin REF_MEASUREMENT Rx_id_sync0_CAN1 /end REF_MEASUREMENT /end GROUP
/begin GROUP S221_Bit_Shift "HANcoder_E407_TTA_Controller_v2/HANcoder STM32 Target - E407-STM32 algorithm/Global Ticks Increment/CAN Management/Matrix Cycle Manager/controller basic cycle 0/COMP Task - Sync bc0 check/Process_Messages/Demux message CAN1 and check coherence1/Subsystem/Bit Shift" /begin REF_MEASUREMENT Rx_bc_sync0_CAN2 /end REF_MEASUREMENT /end GROUP
/begin GROUP S221_Bit_Shift1 "HANcoder_E407_TTA_Controller_v2/HANcoder STM32 Target - E407-STM32 algorithm/Global Ticks Increment/CAN Management/Matrix Cycle Manager/controller basic cycle 0/COMP Task - Sync bc0 check/Process_Messages/Demux message CAN1 and check coherence1/Subsystem/Bit Shift1" /begin REF_MEASUREMENT Rx_mc_sync0_CAN2 /end REF_MEASUREMENT /end GROUP
/begin GROUP S221_Bit_Shift2 "HANcoder_E407_TTA_Controller_v2/HANcoder STM32 Target - E407-STM32 algorithm/Global Ticks Increment/CAN Management/Matrix Cycle Manager/controller basic cycle 0/COMP Task - Sync bc0 check/Process_Messages/Demux message CAN1 and check coherence1/Subsystem/Bit Shift2" /begin REF_MEASUREMENT Rx_id_sync0_CAN2 /end REF_MEASUREMENT /end GROUP
/begin GROUP S244_Bit_Shift "HANcoder_E407_TTA_Controller_v2/HANcoder STM32 Target - E407-STM32 algorithm/Global Ticks Increment/CAN Management/Matrix Cycle Manager/controller basic cycle 0/COMP Task - Vote1 check/Process_Messages1/Demux message CAN1 and check coherence/Subsystem/Bit Shift" /begin REF_MEASUREMENT Rx_bc_vote1_CAN1 /end REF_MEASUREMENT /end GROUP
/begin GROUP S244_Bit_Shift1 "HANcoder_E407_TTA_Controller_v2/HANcoder STM32 Target - E407-STM32 algorithm/Global Ticks Increment/CAN Management/Matrix Cycle Manager/controller basic cycle 0/COMP Task - Vote1 check/Process_Messages1/Demux message CAN1 and check coherence/Subsystem/Bit Shift1" /begin REF_MEASUREMENT Rx_mc_vote1_CAN1 /end REF_MEASUREMENT /end GROUP
/begin GROUP S244_Bit_Shift2 "HANcoder_E407_TTA_Controller_v2/HANcoder STM32 Target - E407-STM32 algorithm/Global Ticks Increment/CAN Management/Matrix Cycle Manager/controller basic cycle 0/COMP Task - Vote1 check/Process_Messages1/Demux message CAN1 and check coherence/Subsystem/Bit Shift2" /begin REF_MEASUREMENT Rx_id_vote1_CAN1 /end REF_MEASUREMENT /end GROUP
/begin GROUP S256_Bit_Shift "HANcoder_E407_TTA_Controller_v2/HANcoder STM32 Target - E407-STM32 algorithm/Global Ticks Increment/CAN Management/Matrix Cycle Manager/controller basic cycle 0/COMP Task - Vote1 check/Process_Messages1/Demux message CAN1 and check coherence1/Subsystem/Bit Shift" /begin REF_MEASUREMENT Rx_bc_vote1_CAN2 /end REF_MEASUREMENT /end GROUP
/begin GROUP S256_Bit_Shift1 "HANcoder_E407_TTA_Controller_v2/HANcoder STM32 Target - E407-STM32 algorithm/Global Ticks Increment/CAN Management/Matrix Cycle Manager/controller basic cycle 0/COMP Task - Vote1 check/Process_Messages1/Demux message CAN1 and check coherence1/Subsystem/Bit Shift1" /begin REF_MEASUREMENT Rx_mc_vote1_CAN2 /end REF_MEASUREMENT /end GROUP
/begin GROUP S256_Bit_Shift2 "HANcoder_E407_TTA_Controller_v2/HANcoder STM32 Target - E407-STM32 algorithm/Global Ticks Increment/CAN Management/Matrix Cycle Manager/controller basic cycle 0/COMP Task - Vote1 check/Process_Messages1/Demux message CAN1 and check coherence1/Subsystem/Bit Shift2" /begin REF_MEASUREMENT Rx_id_vote1_CAN2 /end REF_MEASUREMENT /end GROUP
/begin GROUP S273_Bit_Shift "HANcoder_E407_TTA_Controller_v2/HANcoder STM32 Target - E407-STM32 algorithm/Global Ticks Increment/CAN Management/Matrix Cycle Manager/controller basic cycle 0/COMP Task - Vote2 check/Process_Messages/Demux message CAN1 and check coherence/Subsystem/Bit Shift" /begin REF_MEASUREMENT Rx_bc_vote2_CAN1 /end REF_MEASUREMENT /end GROUP
/begin GROUP S273_Bit_Shift1 "HANcoder_E407_TTA_Controller_v2/HANcoder STM32 Target - E407-STM32 algorithm/Global Ticks Increment/CAN Management/Matrix Cycle Manager/controller basic cycle 0/COMP Task - Vote2 check/Process_Messages/Demux message CAN1 and check coherence/Subsystem/Bit Shift1" /begin REF_MEASUREMENT Rx_mc_vote2_CAN1 /end REF_MEASUREMENT /end GROUP
/begin GROUP S273_Bit_Shift2 "HANcoder_E407_TTA_Controller_v2/HANcoder STM32 Target - E407-STM32 algorithm/Global Ticks Increment/CAN Management/Matrix Cycle Manager/controller basic cycle 0/COMP Task - Vote2 check/Process_Messages/Demux message CAN1 and check coherence/Subsystem/Bit Shift2" /begin REF_MEASUREMENT Rx_id_vote2_CAN1 /end REF_MEASUREMENT /end GROUP
/begin GROUP S285_Bit_Shift "HANcoder_E407_TTA_Controller_v2/HANcoder STM32 Target - E407-STM32 algorithm/Global Ticks Increment/CAN Management/Matrix Cycle Manager/controller basic cycle 0/COMP Task - Vote2 check/Process_Messages/Demux message CAN1 and check coherence1/Subsystem/Bit Shift" /begin REF_MEASUREMENT Rx_bc_vote2_CAN2 /end REF_MEASUREMENT /end GROUP
/begin GROUP S285_Bit_Shift1 "HANcoder_E407_TTA_Controller_v2/HANcoder STM32 Target - E407-STM32 algorithm/Global Ticks Increment/CAN Management/Matrix Cycle Manager/controller basic cycle 0/COMP Task - Vote2 check/Process_Messages/Demux message CAN1 and check coherence1/Subsystem/Bit Shift1" /begin REF_MEASUREMENT Rx_mc_vote2_CAN2 /end REF_MEASUREMENT /end GROUP
/begin GROUP S285_Bit_Shift2 "HANcoder_E407_TTA_Controller_v2/HANcoder STM32 Target - E407-STM32 algorithm/Global Ticks Increment/CAN Management/Matrix Cycle Manager/controller basic cycle 0/COMP Task - Vote2 check/Process_Messages/Demux message CAN1 and check coherence1/Subsystem/Bit Shift2" /begin REF_MEASUREMENT Rx_id_vote2_CAN2 /end REF_MEASUREMENT /end GROUP
/begin GROUP S302_Bit_Shift "HANcoder_E407_TTA_Controller_v2/HANcoder STM32 Target - E407-STM32 algorithm/Global Ticks Increment/CAN Management/Matrix Cycle Manager/controller basic cycle 0/COMP Task - Vote3 check/Process_Messages/Demux message CAN1 and check coherence/Subsystem/Bit Shift" /begin REF_MEASUREMENT Rx_bc_vote3_CAN1 /end REF_MEASUREMENT /end GROUP
/begin GROUP S302_Bit_Shift1 "HANcoder_E407_TTA_Controller_v2/HANcoder STM32 Target - E407-STM32 algorithm/Global Ticks Increment/CAN Management/Matrix Cycle Manager/controller basic cycle 0/COMP Task - Vote3 check/Process_Messages/Demux message CAN1 and check coherence/Subsystem/Bit Shift1" /begin REF_MEASUREMENT Rx_mc_vote3_CAN1 /end REF_MEASUREMENT /end GROUP
/begin GROUP S302_Bit_Shift2 "HANcoder_E407_TTA_Controller_v2/HANcoder STM32 Target - E407-STM32 algorithm/Global Ticks Increment/CAN Management/Matrix Cycle Manager/controller basic cycle 0/COMP Task - Vote3 check/Process_Messages/Demux message CAN1 and check coherence/Subsystem/Bit Shift2" /begin REF_MEASUREMENT Rx_id_vote3_CAN1 /end REF_MEASUREMENT /end GROUP
/begin GROUP S314_Bit_Shift "HANcoder_E407_TTA_Controller_v2/HANcoder STM32 Target - E407-STM32 algorithm/Global Ticks Increment/CAN Management/Matrix Cycle Manager/controller basic cycle 0/COMP Task - Vote3 check/Process_Messages/Demux message CAN1 and check coherence1/Subsystem/Bit Shift" /begin REF_MEASUREMENT Rx_bc_vote3_CAN2 /end REF_MEASUREMENT /end GROUP
/begin GROUP S314_Bit_Shift1 "HANcoder_E407_TTA_Controller_v2/HANcoder STM32 Target - E407-STM32 algorithm/Global Ticks Increment/CAN Management/Matrix Cycle Manager/controller basic cycle 0/COMP Task - Vote3 check/Process_Messages/Demux message CAN1 and check coherence1/Subsystem/Bit Shift1" /begin REF_MEASUREMENT Rx_mc_vote3_CAN2 /end REF_MEASUREMENT /end GROUP
/begin GROUP S314_Bit_Shift2 "HANcoder_E407_TTA_Controller_v2/HANcoder STM32 Target - E407-STM32 algorithm/Global Ticks Increment/CAN Management/Matrix Cycle Manager/controller basic cycle 0/COMP Task - Vote3 check/Process_Messages/Demux message CAN1 and check coherence1/Subsystem/Bit Shift2" /begin REF_MEASUREMENT Rx_id_vote3_CAN2 /end REF_MEASUREMENT /end GROUP
/begin GROUP S556_Bit_Shift "HANcoder_E407_TTA_Controller_v2/HANcoder STM32 Target - E407-STM32 algorithm/Global Ticks Increment/CAN Management/Matrix Cycle Manager/controller basic cycle 1/COMP Task - Rx_Output_Control1_Check/Process_Messages/Demux message CAN1 and check coherence/Subsystem/Bit Shift" /begin REF_MEASUREMENT Rx_bc_outcontrol1_CAN1 /end REF_MEASUREMENT /end GROUP
/begin GROUP S556_Bit_Shift1 "HANcoder_E407_TTA_Controller_v2/HANcoder STM32 Target - E407-STM32 algorithm/Global Ticks Increment/CAN Management/Matrix Cycle Manager/controller basic cycle 1/COMP Task - Rx_Output_Control1_Check/Process_Messages/Demux message CAN1 and check coherence/Subsystem/Bit Shift1" /begin REF_MEASUREMENT Rx_mc_outcontrol1_CAN1 /end REF_MEASUREMENT /end GROUP
/begin GROUP S556_Bit_Shift2 "HANcoder_E407_TTA_Controller_v2/HANcoder STM32 Target - E407-STM32 algorithm/Global Ticks Increment/CAN Management/Matrix Cycle Manager/controller basic cycle 1/COMP Task - Rx_Output_Control1_Check/Process_Messages/Demux message CAN1 and check coherence/Subsystem/Bit Shift2" /begin REF_MEASUREMENT Rx_id_outcontrol1_CAN1 /end REF_MEASUREMENT /end GROUP
/begin GROUP S568_Bit_Shift "HANcoder_E407_TTA_Controller_v2/HANcoder STM32 Target - E407-STM32 algorithm/Global Ticks Increment/CAN Management/Matrix Cycle Manager/controller basic cycle 1/COMP Task - Rx_Output_Control1_Check/Process_Messages/Demux message CAN1 and check coherence1/Subsystem/Bit Shift" /begin REF_MEASUREMENT Rx_bc_outcontrol1_CAN2 /end REF_MEASUREMENT /end GROUP
/begin GROUP S568_Bit_Shift1 "HANcoder_E407_TTA_Controller_v2/HANcoder STM32 Target - E407-STM32 algorithm/Global Ticks Increment/CAN Management/Matrix Cycle Manager/controller basic cycle 1/COMP Task - Rx_Output_Control1_Check/Process_Messages/Demux message CAN1 and check coherence1/Subsystem/Bit Shift1" /begin REF_MEASUREMENT Rx_mc_outcontrol1_CAN2 /end REF_MEASUREMENT /end GROUP
/begin GROUP S568_Bit_Shift2 "HANcoder_E407_TTA_Controller_v2/HANcoder STM32 Target - E407-STM32 algorithm/Global Ticks Increment/CAN Management/Matrix Cycle Manager/controller basic cycle 1/COMP Task - Rx_Output_Control1_Check/Process_Messages/Demux message CAN1 and check coherence1/Subsystem/Bit Shift2" /begin REF_MEASUREMENT Rx_id_outcontrol1_CAN2 /end REF_MEASUREMENT /end GROUP
/begin GROUP S585_Bit_Shift "HANcoder_E407_TTA_Controller_v2/HANcoder STM32 Target - E407-STM32 algorithm/Global Ticks Increment/CAN Management/Matrix Cycle Manager/controller basic cycle 1/COMP Task - Rx_Output_Control2_Check/Process_Messages/Demux message CAN1 and check coherence/Subsystem/Bit Shift" /begin REF_MEASUREMENT Rx_bc_outcontrol2_CAN1 /end REF_MEASUREMENT /end GROUP
/begin GROUP S585_Bit_Shift1 "HANcoder_E407_TTA_Controller_v2/HANcoder STM32 Target - E407-STM32 algorithm/Global Ticks Increment/CAN Management/Matrix Cycle Manager/controller basic cycle 1/COMP Task - Rx_Output_Control2_Check/Process_Messages/Demux message CAN1 and check coherence/Subsystem/Bit Shift1" /begin REF_MEASUREMENT Rx_mc_outcontrol2_CAN1 /end REF_MEASUREMENT /end GROUP
/begin GROUP S585_Bit_Shift2 "HANcoder_E407_TTA_Controller_v2/HANcoder STM32 Target - E407-STM32 algorithm/Global Ticks Increment/CAN Management/Matrix Cycle Manager/controller basic cycle 1/COMP Task - Rx_Output_Control2_Check/Process_Messages/Demux message CAN1 and check coherence/Subsystem/Bit Shift2" /begin REF_MEASUREMENT Rx_id_outcontrol2_CAN1 /end REF_MEASUREMENT /end GROUP
/begin GROUP S597_Bit_Shift "HANcoder_E407_TTA_Controller_v2/HANcoder STM32 Target - E407-STM32 algorithm/Global Ticks Increment/CAN Management/Matrix Cycle Manager/controller basic cycle 1/COMP Task - Rx_Output_Control2_Check/Process_Messages/Demux message CAN1 and check coherence1/Subsystem/Bit Shift" /begin REF_MEASUREMENT Rx_bc_outcontrol2_CAN2 /end REF_MEASUREMENT /end GROUP
/begin GROUP S597_Bit_Shift1 "HANcoder_E407_TTA_Controller_v2/HANcoder STM32 Target - E407-STM32 algorithm/Global Ticks Increment/CAN Management/Matrix Cycle Manager/controller basic cycle 1/COMP Task - Rx_Output_Control2_Check/Process_Messages/Demux message CAN1 and check coherence1/Subsystem/Bit Shift1" /begin REF_MEASUREMENT Rx_mc_outcontrol2_CAN2 /end REF_MEASUREMENT /end GROUP
/begin GROUP S597_Bit_Shift2 "HANcoder_E407_TTA_Controller_v2/HANcoder STM32 Target - E407-STM32 algorithm/Global Ticks Increment/CAN Management/Matrix Cycle Manager/controller basic cycle 1/COMP Task - Rx_Output_Control2_Check/Process_Messages/Demux message CAN1 and check coherence1/Subsystem/Bit Shift2" /begin REF_MEASUREMENT Rx_id_outcontrol2_CAN2 /end REF_MEASUREMENT /end GROUP
/begin GROUP S613_Bit_Shift "HANcoder_E407_TTA_Controller_v2/HANcoder STM32 Target - E407-STM32 algorithm/Global Ticks Increment/CAN Management/Matrix Cycle Manager/controller basic cycle 1/COMP Task - Rx_Output_Emulator_Check/Process_Messages/Demux message CAN1 and check coherence/Subsystem/Bit Shift" /begin REF_MEASUREMENT Rx_bc_outemulator_CAN1 /end REF_MEASUREMENT /end GROUP
/begin GROUP S613_Bit_Shift1 "HANcoder_E407_TTA_Controller_v2/HANcoder STM32 Target - E407-STM32 algorithm/Global Ticks Increment/CAN Management/Matrix Cycle Manager/controller basic cycle 1/COMP Task - Rx_Output_Emulator_Check/Process_Messages/Demux message CAN1 and check coherence/Subsystem/Bit Shift1" /begin REF_MEASUREMENT Rx_mc_outemulator_CAN1 /end REF_MEASUREMENT /end GROUP
/begin GROUP S613_Bit_Shift2 "HANcoder_E407_TTA_Controller_v2/HANcoder STM32 Target - E407-STM32 algorithm/Global Ticks Increment/CAN Management/Matrix Cycle Manager/controller basic cycle 1/COMP Task - Rx_Output_Emulator_Check/Process_Messages/Demux message CAN1 and check coherence/Subsystem/Bit Shift2" /begin REF_MEASUREMENT Rx_id_outemulator_CAN1 /end REF_MEASUREMENT /end GROUP
/begin GROUP S625_Bit_Shift "HANcoder_E407_TTA_Controller_v2/HANcoder STM32 Target - E407-STM32 algorithm/Global Ticks Increment/CAN Management/Matrix Cycle Manager/controller basic cycle 1/COMP Task - Rx_Output_Emulator_Check/Process_Messages/Demux message CAN1 and check coherence1/Subsystem/Bit Shift" /begin REF_MEASUREMENT Rx_bc_outemulator_CAN2 /end REF_MEASUREMENT /end GROUP
/begin GROUP S625_Bit_Shift1 "HANcoder_E407_TTA_Controller_v2/HANcoder STM32 Target - E407-STM32 algorithm/Global Ticks Increment/CAN Management/Matrix Cycle Manager/controller basic cycle 1/COMP Task - Rx_Output_Emulator_Check/Process_Messages/Demux message CAN1 and check coherence1/Subsystem/Bit Shift1" /begin REF_MEASUREMENT Rx_mc_outemulator_CAN2 /end REF_MEASUREMENT /end GROUP
/begin GROUP S625_Bit_Shift2 "HANcoder_E407_TTA_Controller_v2/HANcoder STM32 Target - E407-STM32 algorithm/Global Ticks Increment/CAN Management/Matrix Cycle Manager/controller basic cycle 1/COMP Task - Rx_Output_Emulator_Check/Process_Messages/Demux message CAN1 and check coherence1/Subsystem/Bit Shift2" /begin REF_MEASUREMENT Rx_id_outemulator_CAN2 /end REF_MEASUREMENT /end GROUP
/begin GROUP S642_Bit_Shift "HANcoder_E407_TTA_Controller_v2/HANcoder STM32 Target - E407-STM32 algorithm/Global Ticks Increment/CAN Management/Matrix Cycle Manager/controller basic cycle 1/COMP Task - Rx_Sensor_Values_Check/Process_Messages/Demux message CAN1 and check coherence/Subsystem/Bit Shift" /begin REF_MEASUREMENT Rx_bc_sensorvalues_CAN1 /end REF_MEASUREMENT /end GROUP
/begin GROUP S642_Bit_Shift1 "HANcoder_E407_TTA_Controller_v2/HANcoder STM32 Target - E407-STM32 algorithm/Global Ticks Increment/CAN Management/Matrix Cycle Manager/controller basic cycle 1/COMP Task - Rx_Sensor_Values_Check/Process_Messages/Demux message CAN1 and check coherence/Subsystem/Bit Shift1" /begin REF_MEASUREMENT Rx_mc_sensorvalues_CAN1 /end REF_MEASUREMENT /end GROUP
/begin GROUP S642_Bit_Shift2 "HANcoder_E407_TTA_Controller_v2/HANcoder STM32 Target - E407-STM32 algorithm/Global Ticks Increment/CAN Management/Matrix Cycle Manager/controller basic cycle 1/COMP Task - Rx_Sensor_Values_Check/Process_Messages/Demux message CAN1 and check coherence/Subsystem/Bit Shift2" /begin REF_MEASUREMENT Rx_id_sensorvalues_CAN1 /end REF_MEASUREMENT /end GROUP
/begin GROUP S654_Bit_Shift "HANcoder_E407_TTA_Controller_v2/HANcoder STM32 Target - E407-STM32 algorithm/Global Ticks Increment/CAN Management/Matrix Cycle Manager/controller basic cycle 1/COMP Task - Rx_Sensor_Values_Check/Process_Messages/Demux message CAN1 and check coherence1/Subsystem/Bit Shift" /begin REF_MEASUREMENT Rx_bc_sensorvalues_CAN2 /end REF_MEASUREMENT /end GROUP
/begin GROUP S654_Bit_Shift1 "HANcoder_E407_TTA_Controller_v2/HANcoder STM32 Target - E407-STM32 algorithm/Global Ticks Increment/CAN Management/Matrix Cycle Manager/controller basic cycle 1/COMP Task - Rx_Sensor_Values_Check/Process_Messages/Demux message CAN1 and check coherence1/Subsystem/Bit Shift1" /begin REF_MEASUREMENT Rx_mc_sensorvalues_CAN2 /end REF_MEASUREMENT /end GROUP
/begin GROUP S654_Bit_Shift2 "HANcoder_E407_TTA_Controller_v2/HANcoder STM32 Target - E407-STM32 algorithm/Global Ticks Increment/CAN Management/Matrix Cycle Manager/controller basic cycle 1/COMP Task - Rx_Sensor_Values_Check/Process_Messages/Demux message CAN1 and check coherence1/Subsystem/Bit Shift2" /begin REF_MEASUREMENT Rx_id_sensorvalues_CAN2 /end REF_MEASUREMENT /end GROUP
/begin GROUP S695_Bit_Shift "HANcoder_E407_TTA_Controller_v2/HANcoder STM32 Target - E407-STM32 algorithm/Global Ticks Increment/CAN Management/Matrix Cycle Manager/controller basic cycle 1/COMP Task - Rx_Set_Values_Check/Process_Messages/Demux message CAN1 and check coherence/Subsystem/Bit Shift" /begin REF_MEASUREMENT Rx_bc_setvalues_CAN1 /end REF_MEASUREMENT /end GROUP
/begin GROUP S695_Bit_Shift1 "HANcoder_E407_TTA_Controller_v2/HANcoder STM32 Target - E407-STM32 algorithm/Global Ticks Increment/CAN Management/Matrix Cycle Manager/controller basic cycle 1/COMP Task - Rx_Set_Values_Check/Process_Messages/Demux message CAN1 and check coherence/Subsystem/Bit Shift1" /begin REF_MEASUREMENT Rx_mc_setvalues_CAN1 /end REF_MEASUREMENT /end GROUP
/begin GROUP S695_Bit_Shift2 "HANcoder_E407_TTA_Controller_v2/HANcoder STM32 Target - E407-STM32 algorithm/Global Ticks Increment/CAN Management/Matrix Cycle Manager/controller basic cycle 1/COMP Task - Rx_Set_Values_Check/Process_Messages/Demux message CAN1 and check coherence/Subsystem/Bit Shift2" /begin REF_MEASUREMENT Rx_id_setvalues_CAN1 /end REF_MEASUREMENT /end GROUP
/begin GROUP S707_Bit_Shift "HANcoder_E407_TTA_Controller_v2/HANcoder STM32 Target - E407-STM32 algorithm/Global Ticks Increment/CAN Management/Matrix Cycle Manager/controller basic cycle 1/COMP Task - Rx_Set_Values_Check/Process_Messages/Demux message CAN1 and check coherence1/Subsystem/Bit Shift" /begin REF_MEASUREMENT Rx_bc_setvalues_CAN2 /end REF_MEASUREMENT /end GROUP
/begin GROUP S707_Bit_Shift1 "HANcoder_E407_TTA_Controller_v2/HANcoder STM32 Target - E407-STM32 algorithm/Global Ticks Increment/CAN Management/Matrix Cycle Manager/controller basic cycle 1/COMP Task - Rx_Set_Values_Check/Process_Messages/Demux message CAN1 and check coherence1/Subsystem/Bit Shift1" /begin REF_MEASUREMENT Rx_mc_setvalues_CAN2 /end REF_MEASUREMENT /end GROUP
/begin GROUP S707_Bit_Shift2 "HANcoder_E407_TTA_Controller_v2/HANcoder STM32 Target - E407-STM32 algorithm/Global Ticks Increment/CAN Management/Matrix Cycle Manager/controller basic cycle 1/COMP Task - Rx_Set_Values_Check/Process_Messages/Demux message CAN1 and check coherence1/Subsystem/Bit Shift2" /begin REF_MEASUREMENT Rx_id_setvalues_CAN2 /end REF_MEASUREMENT /end GROUP
/begin GROUP S740_Bit_Shift "HANcoder_E407_TTA_Controller_v2/HANcoder STM32 Target - E407-STM32 algorithm/Global Ticks Increment/CAN Management/Matrix Cycle Manager/controller basic cycle 1/COMP Task - Sync bc1 check/Process_Messages/Demux message CAN1 and check coherence/Subsystem/Bit Shift" /begin REF_MEASUREMENT Rx_bc_sync1_CAN1 /end REF_MEASUREMENT /end GROUP
/begin GROUP S740_Bit_Shift1 "HANcoder_E407_TTA_Controller_v2/HANcoder STM32 Target - E407-STM32 algorithm/Global Ticks Increment/CAN Management/Matrix Cycle Manager/controller basic cycle 1/COMP Task - Sync bc1 check/Process_Messages/Demux message CAN1 and check coherence/Subsystem/Bit Shift1" /begin REF_MEASUREMENT Rx_mc_sync1_CAN1 /end REF_MEASUREMENT /end GROUP
/begin GROUP S740_Bit_Shift2 "HANcoder_E407_TTA_Controller_v2/HANcoder STM32 Target - E407-STM32 algorithm/Global Ticks Increment/CAN Management/Matrix Cycle Manager/controller basic cycle 1/COMP Task - Sync bc1 check/Process_Messages/Demux message CAN1 and check coherence/Subsystem/Bit Shift2" /begin REF_MEASUREMENT Rx_id_sync1_CAN1 /end REF_MEASUREMENT /end GROUP
/begin GROUP S752_Bit_Shift "HANcoder_E407_TTA_Controller_v2/HANcoder STM32 Target - E407-STM32 algorithm/Global Ticks Increment/CAN Management/Matrix Cycle Manager/controller basic cycle 1/COMP Task - Sync bc1 check/Process_Messages/Demux message CAN1 and check coherence1/Subsystem/Bit Shift" /begin REF_MEASUREMENT Rx_bc_sync1_CAN2 /end REF_MEASUREMENT /end GROUP
/begin GROUP S752_Bit_Shift1 "HANcoder_E407_TTA_Controller_v2/HANcoder STM32 Target - E407-STM32 algorithm/Global Ticks Increment/CAN Management/Matrix Cycle Manager/controller basic cycle 1/COMP Task - Sync bc1 check/Process_Messages/Demux message CAN1 and check coherence1/Subsystem/Bit Shift1" /begin REF_MEASUREMENT Rx_mc_sync1_CAN2 /end REF_MEASUREMENT /end GROUP
/begin GROUP S752_Bit_Shift2 "HANcoder_E407_TTA_Controller_v2/HANcoder STM32 Target - E407-STM32 algorithm/Global Ticks Increment/CAN Management/Matrix Cycle Manager/controller basic cycle 1/COMP Task - Sync bc1 check/Process_Messages/Demux message CAN1 and check coherence1/Subsystem/Bit Shift2" /begin REF_MEASUREMENT Rx_id_sync1_CAN2 /end REF_MEASUREMENT /end GROUP
/end MODULE
/end PROJECT
/* (add any file trailer comments here) */
/* EOF HANcoder_E407_TTA_Controller_v2.a2l */
