/******************************************************************************
* ASAP2 file: HANcoder_E407_GTSync.a2l
* Academic License - for use in teaching, academic research, and meeting
* course requirements at degree granting institutions only. Not for
* government, commercial, or other organizational use.
* Code generation for model "HANcoder_E407_GTSync".
* Model version : 1.160
* Simulink Coder version : 9.0 (R2018b) 24-May-2018
* C source code generated on : Fri May 28 21:44:30 2021
* Target selection: ert.tlc
* Embedded hardware selection: Generic->32-bit Embedded Processor
* Code generation objectives: Unspecified
* Validation result: Not run
* (add additional file header information here)
******************************************************************************/ ASAP2_VERSION 1 31
/* Version 1.31 */
/begin PROJECT ProjectName "HANcoder_E407_GTSync_softwareID_v1_280521_214428"
/begin HEADER "Header Comments go here" /end HEADER
/begin MODULE ModuleName "Module Comment Goes Here"
/begin MOD_PAR "MOD PAR Comment Goes Here" /end MOD_PAR
/begin MOD_COMMON "Mod Common Comment Here" BYTE_ORDER MSB_LAST /end MOD_COMMON
/begin RECORD_LAYOUT Scalar_BOOLEAN FNC_VALUES 1 UBYTE COLUMN_DIR DIRECT /end RECORD_LAYOUT
/begin RECORD_LAYOUT Scalar_UBYTE FNC_VALUES 1 UBYTE COLUMN_DIR DIRECT /end RECORD_LAYOUT
/begin RECORD_LAYOUT Scalar_BYTE FNC_VALUES 1 SBYTE COLUMN_DIR DIRECT /end RECORD_LAYOUT
/begin RECORD_LAYOUT Scalar_UWORD FNC_VALUES 1 UWORD COLUMN_DIR DIRECT /end RECORD_LAYOUT
/begin RECORD_LAYOUT Scalar_SWORD FNC_VALUES 1 SWORD COLUMN_DIR DIRECT /end RECORD_LAYOUT
/begin RECORD_LAYOUT Scalar_ULONG FNC_VALUES 1 ULONG COLUMN_DIR DIRECT /end RECORD_LAYOUT
/begin RECORD_LAYOUT Scalar_LONG FNC_VALUES 1 SLONG COLUMN_DIR DIRECT /end RECORD_LAYOUT
/begin RECORD_LAYOUT Scalar_FLOAT32_IEEE FNC_VALUES 1 FLOAT32_IEEE COLUMN_DIR DIRECT /end RECORD_LAYOUT
/begin RECORD_LAYOUT Scalar_FLOAT64_IEEE FNC_VALUES 1 FLOAT64_IEEE COLUMN_DIR DIRECT /end RECORD_LAYOUT
/begin RECORD_LAYOUT Lookup1D_BYTE FNC_VALUES 1 SBYTE COLUMN_DIR DIRECT /end RECORD_LAYOUT
/begin RECORD_LAYOUT Lookup1D_X_BYTE AXIS_PTS_X 1 SBYTE INDEX_INCR DIRECT /end RECORD_LAYOUT
/begin RECORD_LAYOUT Lookup1D_UBYTE FNC_VALUES 1 UBYTE COLUMN_DIR DIRECT /end RECORD_LAYOUT
/begin RECORD_LAYOUT Lookup1D_X_UBYTE AXIS_PTS_X 1 UBYTE INDEX_INCR DIRECT /end RECORD_LAYOUT
/begin RECORD_LAYOUT Lookup1D_UWORD FNC_VALUES 1 UWORD COLUMN_DIR DIRECT /end RECORD_LAYOUT
/begin RECORD_LAYOUT Lookup1D_X_UWORD AXIS_PTS_X 1 UWORD INDEX_INCR DIRECT /end RECORD_LAYOUT
/begin RECORD_LAYOUT Lookup1D_WORD FNC_VALUES 1 SWORD COLUMN_DIR DIRECT /end RECORD_LAYOUT
/begin RECORD_LAYOUT Lookup1D_X_WORD AXIS_PTS_X 1 SWORD INDEX_INCR DIRECT /end RECORD_LAYOUT
/begin RECORD_LAYOUT Lookup1D_ULONG FNC_VALUES 1 ULONG COLUMN_DIR DIRECT /end RECORD_LAYOUT
/begin RECORD_LAYOUT Lookup1D_X_ULONG AXIS_PTS_X 1 ULONG INDEX_INCR DIRECT /end RECORD_LAYOUT
/begin RECORD_LAYOUT Lookup1D_SLONG FNC_VALUES 1 SLONG COLUMN_DIR DIRECT /end RECORD_LAYOUT
/begin RECORD_LAYOUT Lookup1D_X_LONG AXIS_PTS_X 1 SLONG INDEX_INCR DIRECT /end RECORD_LAYOUT
/begin RECORD_LAYOUT Lookup1D_FLOAT32_IEEE FNC_VALUES 1 FLOAT32_IEEE COLUMN_DIR DIRECT /end RECORD_LAYOUT
/begin RECORD_LAYOUT Lookup1D_X_FLOAT32_IEEE AXIS_PTS_X 1 FLOAT32_IEEE INDEX_INCR DIRECT /end RECORD_LAYOUT
/begin RECORD_LAYOUT Lookup1D_FLOAT64_IEEE FNC_VALUES 1 FLOAT64_IEEE COLUMN_DIR DIRECT /end RECORD_LAYOUT
/begin RECORD_LAYOUT Lookup1D_X_FLOAT64_IEEE AXIS_PTS_X 1 FLOAT64_IEEE INDEX_INCR DIRECT /end RECORD_LAYOUT
/begin RECORD_LAYOUT Lookup2D_UBYTE FNC_VALUES 1 UBYTE COLUMN_DIR DIRECT /end RECORD_LAYOUT
/begin RECORD_LAYOUT Lookup2D_X_UBYTE AXIS_PTS_X 1 UBYTE INDEX_INCR DIRECT /end RECORD_LAYOUT
/begin RECORD_LAYOUT Lookup2D_BYTE FNC_VALUES 1 SBYTE COLUMN_DIR DIRECT /end RECORD_LAYOUT
/begin RECORD_LAYOUT Lookup2D_X_BYTE AXIS_PTS_X 1 SBYTE INDEX_INCR DIRECT /end RECORD_LAYOUT
/begin RECORD_LAYOUT Lookup2D_UWORD FNC_VALUES 1 UWORD COLUMN_DIR DIRECT /end RECORD_LAYOUT
/begin RECORD_LAYOUT Lookup2D_X_UWORD AXIS_PTS_X 1 UWORD INDEX_INCR DIRECT /end RECORD_LAYOUT
/begin RECORD_LAYOUT Lookup2D_WORD FNC_VALUES 1 SWORD COLUMN_DIR DIRECT /end RECORD_LAYOUT
/begin RECORD_LAYOUT Lookup2D_X_WORD AXIS_PTS_X 1 SWORD INDEX_INCR DIRECT /end RECORD_LAYOUT
/begin RECORD_LAYOUT Lookup2D_ULONG FNC_VALUES 1 ULONG COLUMN_DIR DIRECT /end RECORD_LAYOUT
/begin RECORD_LAYOUT Lookup2D_X_ULONG AXIS_PTS_X 1 ULONG INDEX_INCR DIRECT /end RECORD_LAYOUT
/begin RECORD_LAYOUT Lookup2D_LONG FNC_VALUES 1 SLONG COLUMN_DIR DIRECT /end RECORD_LAYOUT
/begin RECORD_LAYOUT Lookup2D_X_LONG AXIS_PTS_X 1 SLONG INDEX_INCR DIRECT /end RECORD_LAYOUT
/begin RECORD_LAYOUT Lookup2D_FLOAT32_IEEE FNC_VALUES 1 FLOAT32_IEEE COLUMN_DIR DIRECT /end RECORD_LAYOUT
/begin RECORD_LAYOUT Lookup2D_X_FLOAT32_IEEE AXIS_PTS_X 1 FLOAT32_IEEE INDEX_INCR DIRECT /end RECORD_LAYOUT
/begin RECORD_LAYOUT Lookup2D_FLOAT64_IEEE FNC_VALUES 1 FLOAT64_IEEE COLUMN_DIR DIRECT /end RECORD_LAYOUT
/begin RECORD_LAYOUT Lookup2D_X_FLOAT64_IEEE AXIS_PTS_X 1 FLOAT64_IEEE INDEX_INCR DIRECT /end RECORD_LAYOUT
/begin CHARACTERISTIC HANtuneOverride /* Long Identifier */ "" /* Type */ VALUE /* ECU Address */ 20000139 /* Record Layout */ Scalar_BOOLEAN /* Maximum Difference */ 0 /* Conversion Method */ HANcoder_E407_GTSync_CM_boolean /* Lower Limit */ 0 /* Upper Limit */ 1 /end CHARACTERISTIC
/begin MEASUREMENT LED_local_ticks_signal "" FLOAT64_IEEE HANcoder_E407_GTSync_CM_double 0 0 -1.7E+308 1.7E+308 ECU_ADDRESS 200075e0 /end MEASUREMENT
/begin MEASUREMENT simulation_time "" FLOAT64_IEEE HANcoder_E407_GTSync_CM_double 0 0 -1.7E+308 1.7E+308 ECU_ADDRESS 20007658 /end MEASUREMENT
/begin MEASUREMENT id "" FLOAT64_IEEE HANcoder_E407_GTSync_CM_double 0 0 -1.7E+308 1.7E+308 ECU_ADDRESS 20007640 /end MEASUREMENT
/begin MEASUREMENT SI_FreeHeap "" ULONG HANcoder_E407_GTSync_CM_uint32 0 0 0 4294967295 ECU_ADDRESS 20007648 /end MEASUREMENT
/begin MEASUREMENT SI_FreeStack "" ULONG HANcoder_E407_GTSync_CM_uint32 0 0 0 4294967295 ECU_ADDRESS 20007660 /end MEASUREMENT
/begin MEASUREMENT local_ticks_interrupt "" ULONG HANcoder_E407_GTSync_CM_uint32 0 0 0 4294967295 ECU_ADDRESS 2000766c /end MEASUREMENT
/begin MEASUREMENT tx_temp_counter "" ULONG HANcoder_E407_GTSync_CM_uint32 0 0 0 4294967295 ECU_ADDRESS 20007638 /end MEASUREMENT
/begin MEASUREMENT SI_CPUload "" UBYTE HANcoder_E407_GTSync_CM_uint8 0 0 0 255 ECU_ADDRESS 2000766a /end MEASUREMENT
/begin MEASUREMENT bc "" UBYTE HANcoder_E407_GTSync_CM_uint8 0 0 0 255 ECU_ADDRESS 20007669 /end MEASUREMENT
/begin MEASUREMENT LedValue "" UBYTE HANcoder_E407_GTSync_CM_boolean 0 0 0 1 ECU_ADDRESS 2000764c /end MEASUREMENT
/begin MEASUREMENT odd "" UBYTE HANcoder_E407_GTSync_CM_boolean 0 0 0 1 ECU_ADDRESS 20007653 /end MEASUREMENT
/begin MEASUREMENT even "" UBYTE HANcoder_E407_GTSync_CM_boolean 0 0 0 1 ECU_ADDRESS 20007668 /end MEASUREMENT
/begin COMPU_METHOD HANcoder_E407_GTSync_CM_boolean "Q = V" RAT_FUNC "%1.0" "" COEFFS 0 1 0 0 0 1 /end COMPU_METHOD
/begin COMPU_METHOD HANcoder_E407_GTSync_CM_double "Q = V" RAT_FUNC "%15.10" "" COEFFS 0 1 0 0 0 1 /end COMPU_METHOD
/begin COMPU_METHOD HANcoder_E407_GTSync_CM_uint32 "Q = V" RAT_FUNC "%10.0" "" COEFFS 0 1 0 0 0 1 /end COMPU_METHOD
/begin COMPU_METHOD HANcoder_E407_GTSync_CM_uint8 "Q = V" RAT_FUNC "%3.0" "" COEFFS 0 1 0 0 0 1 /end COMPU_METHOD
/begin GROUP HANcoder_E407_GTSync "HANcoder_E407_GTSync" /* Root */ ROOT /begin SUB_GROUP Root_HANcoder_STM32_Target___E407_STM32_algorithm /end SUB_GROUP /end GROUP
/begin GROUP Root_HANcoder_STM32_Target___E407_STM32_algorithm "HANcoder_E407_GTSync/HANcoder STM32 Target - E407-STM32 algorithm"
 /begin SUB_GROUP S1_Algorithm S1_Global_Ticks_Increment S1_Outputs S1_System_information /end SUB_GROUP
 /begin REF_MEASUREMENT id /end REF_MEASUREMENT
/end GROUP
/begin GROUP S1_Algorithm "HANcoder_E407_GTSync/HANcoder STM32 Target - E407-STM32 algorithm/Algorithm" /begin REF_CHARACTERISTIC HANtuneOverride /end REF_CHARACTERISTIC /begin REF_MEASUREMENT LedValue /end REF_MEASUREMENT /end GROUP
/begin GROUP S1_Global_Ticks_Increment "HANcoder_E407_GTSync/HANcoder STM32 Target - E407-STM32 algorithm/Global Ticks Increment" /begin SUB_GROUP S6_Timer_ISR_handler /end SUB_GROUP /begin REF_MEASUREMENT simulation_time /end REF_MEASUREMENT /end GROUP
/begin GROUP S1_Outputs "HANcoder_E407_GTSync/HANcoder STM32 Target - E407-STM32 algorithm/Outputs" /begin REF_MEASUREMENT LED_local_ticks_signal /end REF_MEASUREMENT /end GROUP
/begin GROUP S1_System_information "HANcoder_E407_GTSync/HANcoder STM32 Target - E407-STM32 algorithm/System information" /begin SUB_GROUP S10_Get_CPU_load S10_Get_free_Heap S10_Get_free_Stack /end SUB_GROUP /end GROUP
/begin GROUP S6_Timer_ISR_handler "HANcoder_E407_GTSync/HANcoder STM32 Target - E407-STM32 algorithm/Global Ticks Increment/Timer ISR handler"
 /begin SUB_GROUP S24_Local_time_generator S24_Matrix_control_block S24_Matrix_scheduler /end SUB_GROUP
/end GROUP
/begin GROUP S10_Get_CPU_load "HANcoder_E407_GTSync/HANcoder STM32 Target - E407-STM32 algorithm/System information/Get CPU load" /begin REF_MEASUREMENT SI_CPUload /end REF_MEASUREMENT /end GROUP
/begin GROUP S10_Get_free_Heap "HANcoder_E407_GTSync/HANcoder STM32 Target - E407-STM32 algorithm/System information/Get free Heap" /begin REF_MEASUREMENT SI_FreeHeap /end REF_MEASUREMENT /end GROUP
/begin GROUP S10_Get_free_Stack "HANcoder_E407_GTSync/HANcoder STM32 Target - E407-STM32 algorithm/System information/Get free Stack" /begin REF_MEASUREMENT SI_FreeStack /end REF_MEASUREMENT /end GROUP
/begin GROUP S24_Local_time_generator "HANcoder_E407_GTSync/HANcoder STM32 Target - E407-STM32 algorithm/Global Ticks Increment/Timer ISR handler/Local time generator" /begin REF_MEASUREMENT even local_ticks_interrupt odd /end REF_MEASUREMENT /end GROUP
/begin GROUP S24_Matrix_control_block "HANcoder_E407_GTSync/HANcoder STM32 Target - E407-STM32 algorithm/Global Ticks Increment/Timer ISR handler/Matrix control block" /begin SUB_GROUP S36_Reset_values /end SUB_GROUP /end GROUP
/begin GROUP S24_Matrix_scheduler "HANcoder_E407_GTSync/HANcoder STM32 Target - E407-STM32 algorithm/Global Ticks Increment/Timer ISR handler/Matrix scheduler" /begin SUB_GROUP S37_TX_Temperature /end SUB_GROUP /end GROUP
/begin GROUP S36_Reset_values "HANcoder_E407_GTSync/HANcoder STM32 Target - E407-STM32 algorithm/Global Ticks Increment/Timer ISR handler/Matrix control block/Reset values" /begin REF_MEASUREMENT bc /end REF_MEASUREMENT /end GROUP
/begin GROUP S37_TX_Temperature "HANcoder_E407_GTSync/HANcoder STM32 Target - E407-STM32 algorithm/Global Ticks Increment/Timer ISR handler/Matrix scheduler/TX Temperature" /begin SUB_GROUP S48_If_Action_Subsystem /end SUB_GROUP /end GROUP
/begin GROUP S48_If_Action_Subsystem "HANcoder_E407_GTSync/HANcoder STM32 Target - E407-STM32 algorithm/Global Ticks Increment/Timer ISR handler/Matrix scheduler/TX Temperature/If Action Subsystem" /begin REF_MEASUREMENT tx_temp_counter /end REF_MEASUREMENT /end GROUP
/end MODULE
/end PROJECT
/* (add any file trailer comments here) */
/* EOF HANcoder_E407_GTSync.a2l */
