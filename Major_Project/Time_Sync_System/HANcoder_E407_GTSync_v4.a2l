/******************************************************************************
* ASAP2 file: HANcoder_E407_GTSync_v4.a2l
* Academic License - for use in teaching, academic research, and meeting
* course requirements at degree granting institutions only. Not for
* government, commercial, or other organizational use.
* Code generation for model "HANcoder_E407_GTSync_v4".
* Model version : 1.369
* Simulink Coder version : 9.0 (R2018b) 24-May-2018
* C source code generated on : Mon Sep 27 21:18:37 2021
* Target selection: ert.tlc
* Embedded hardware selection: Generic->32-bit Embedded Processor
* Code generation objectives: Unspecified
* Validation result: Not run
* (add additional file header information here)
******************************************************************************/ ASAP2_VERSION 1 31
/* Version 1.31 */
/begin PROJECT ProjectName "HANcoder_E407_GTSync_v4_softwareID_v1_270921_211827"
/begin HEADER "Header Comments go here" /end HEADER
/begin MODULE ModuleName "Module Comment Goes Here"
/begin MOD_PAR "MOD PAR Comment Goes Here" /end MOD_PAR
/begin MOD_COMMON "Mod Common Comment Here" BYTE_ORDER MSB_LAST /end MOD_COMMON
/begin RECORD_LAYOUT Scalar_BOOLEAN FNC_VALUES 1 UBYTE COLUMN_DIR DIRECT /end RECORD_LAYOUT
/begin RECORD_LAYOUT Scalar_UBYTE FNC_VALUES 1 UBYTE COLUMN_DIR DIRECT /end RECORD_LAYOUT
/begin RECORD_LAYOUT Scalar_BYTE FNC_VALUES 1 SBYTE COLUMN_DIR DIRECT /end RECORD_LAYOUT
/begin RECORD_LAYOUT Scalar_UWORD FNC_VALUES 1 UWORD COLUMN_DIR DIRECT /end RECORD_LAYOUT
/begin RECORD_LAYOUT Scalar_SWORD FNC_VALUES 1 SWORD COLUMN_DIR DIRECT /end RECORD_LAYOUT
/begin RECORD_LAYOUT Scalar_ULONG FNC_VALUES 1 ULONG COLUMN_DIR DIRECT /end RECORD_LAYOUT
/begin RECORD_LAYOUT Scalar_LONG FNC_VALUES 1 SLONG COLUMN_DIR DIRECT /end RECORD_LAYOUT
/begin RECORD_LAYOUT Scalar_FLOAT32_IEEE FNC_VALUES 1 FLOAT32_IEEE COLUMN_DIR DIRECT /end RECORD_LAYOUT
/begin RECORD_LAYOUT Scalar_FLOAT64_IEEE FNC_VALUES 1 FLOAT64_IEEE COLUMN_DIR DIRECT /end RECORD_LAYOUT
/begin RECORD_LAYOUT Lookup1D_BYTE FNC_VALUES 1 SBYTE COLUMN_DIR DIRECT /end RECORD_LAYOUT
/begin RECORD_LAYOUT Lookup1D_X_BYTE AXIS_PTS_X 1 SBYTE INDEX_INCR DIRECT /end RECORD_LAYOUT
/begin RECORD_LAYOUT Lookup1D_UBYTE FNC_VALUES 1 UBYTE COLUMN_DIR DIRECT /end RECORD_LAYOUT
/begin RECORD_LAYOUT Lookup1D_X_UBYTE AXIS_PTS_X 1 UBYTE INDEX_INCR DIRECT /end RECORD_LAYOUT
/begin RECORD_LAYOUT Lookup1D_UWORD FNC_VALUES 1 UWORD COLUMN_DIR DIRECT /end RECORD_LAYOUT
/begin RECORD_LAYOUT Lookup1D_X_UWORD AXIS_PTS_X 1 UWORD INDEX_INCR DIRECT /end RECORD_LAYOUT
/begin RECORD_LAYOUT Lookup1D_WORD FNC_VALUES 1 SWORD COLUMN_DIR DIRECT /end RECORD_LAYOUT
/begin RECORD_LAYOUT Lookup1D_X_WORD AXIS_PTS_X 1 SWORD INDEX_INCR DIRECT /end RECORD_LAYOUT
/begin RECORD_LAYOUT Lookup1D_ULONG FNC_VALUES 1 ULONG COLUMN_DIR DIRECT /end RECORD_LAYOUT
/begin RECORD_LAYOUT Lookup1D_X_ULONG AXIS_PTS_X 1 ULONG INDEX_INCR DIRECT /end RECORD_LAYOUT
/begin RECORD_LAYOUT Lookup1D_SLONG FNC_VALUES 1 SLONG COLUMN_DIR DIRECT /end RECORD_LAYOUT
/begin RECORD_LAYOUT Lookup1D_X_LONG AXIS_PTS_X 1 SLONG INDEX_INCR DIRECT /end RECORD_LAYOUT
/begin RECORD_LAYOUT Lookup1D_FLOAT32_IEEE FNC_VALUES 1 FLOAT32_IEEE COLUMN_DIR DIRECT /end RECORD_LAYOUT
/begin RECORD_LAYOUT Lookup1D_X_FLOAT32_IEEE AXIS_PTS_X 1 FLOAT32_IEEE INDEX_INCR DIRECT /end RECORD_LAYOUT
/begin RECORD_LAYOUT Lookup1D_FLOAT64_IEEE FNC_VALUES 1 FLOAT64_IEEE COLUMN_DIR DIRECT /end RECORD_LAYOUT
/begin RECORD_LAYOUT Lookup1D_X_FLOAT64_IEEE AXIS_PTS_X 1 FLOAT64_IEEE INDEX_INCR DIRECT /end RECORD_LAYOUT
/begin RECORD_LAYOUT Lookup2D_UBYTE FNC_VALUES 1 UBYTE COLUMN_DIR DIRECT /end RECORD_LAYOUT
/begin RECORD_LAYOUT Lookup2D_X_UBYTE AXIS_PTS_X 1 UBYTE INDEX_INCR DIRECT /end RECORD_LAYOUT
/begin RECORD_LAYOUT Lookup2D_BYTE FNC_VALUES 1 SBYTE COLUMN_DIR DIRECT /end RECORD_LAYOUT
/begin RECORD_LAYOUT Lookup2D_X_BYTE AXIS_PTS_X 1 SBYTE INDEX_INCR DIRECT /end RECORD_LAYOUT
/begin RECORD_LAYOUT Lookup2D_UWORD FNC_VALUES 1 UWORD COLUMN_DIR DIRECT /end RECORD_LAYOUT
/begin RECORD_LAYOUT Lookup2D_X_UWORD AXIS_PTS_X 1 UWORD INDEX_INCR DIRECT /end RECORD_LAYOUT
/begin RECORD_LAYOUT Lookup2D_WORD FNC_VALUES 1 SWORD COLUMN_DIR DIRECT /end RECORD_LAYOUT
/begin RECORD_LAYOUT Lookup2D_X_WORD AXIS_PTS_X 1 SWORD INDEX_INCR DIRECT /end RECORD_LAYOUT
/begin RECORD_LAYOUT Lookup2D_ULONG FNC_VALUES 1 ULONG COLUMN_DIR DIRECT /end RECORD_LAYOUT
/begin RECORD_LAYOUT Lookup2D_X_ULONG AXIS_PTS_X 1 ULONG INDEX_INCR DIRECT /end RECORD_LAYOUT
/begin RECORD_LAYOUT Lookup2D_LONG FNC_VALUES 1 SLONG COLUMN_DIR DIRECT /end RECORD_LAYOUT
/begin RECORD_LAYOUT Lookup2D_X_LONG AXIS_PTS_X 1 SLONG INDEX_INCR DIRECT /end RECORD_LAYOUT
/begin RECORD_LAYOUT Lookup2D_FLOAT32_IEEE FNC_VALUES 1 FLOAT32_IEEE COLUMN_DIR DIRECT /end RECORD_LAYOUT
/begin RECORD_LAYOUT Lookup2D_X_FLOAT32_IEEE AXIS_PTS_X 1 FLOAT32_IEEE INDEX_INCR DIRECT /end RECORD_LAYOUT
/begin RECORD_LAYOUT Lookup2D_FLOAT64_IEEE FNC_VALUES 1 FLOAT64_IEEE COLUMN_DIR DIRECT /end RECORD_LAYOUT
/begin RECORD_LAYOUT Lookup2D_X_FLOAT64_IEEE AXIS_PTS_X 1 FLOAT64_IEEE INDEX_INCR DIRECT /end RECORD_LAYOUT
/begin CHARACTERISTIC HANtuneOverride /* Long Identifier */ "" /* Type */ VALUE /* ECU Address */ 20000154 /* Record Layout */ Scalar_BOOLEAN /* Maximum Difference */ 0 /* Conversion Method */ HANcoder_E407_GTSync_v4_CM_boolean /* Lower Limit */ 0 /* Upper Limit */ 1 /end CHARACTERISTIC
/begin MEASUREMENT simulation_time "" FLOAT64_IEEE HANcoder_E407_GTSync_v4_CM_double 0 0 -1.7E+308 1.7E+308 ECU_ADDRESS 200078b8 /end MEASUREMENT
/begin MEASUREMENT Board_ID_s "" FLOAT64_IEEE HANcoder_E407_GTSync_v4_CM_double 0 0 -1.7E+308 1.7E+308 ECU_ADDRESS 200077b8 /end MEASUREMENT
/begin MEASUREMENT SI_FreeHeap "" ULONG HANcoder_E407_GTSync_v4_CM_uint32 0 0 0 4294967295 ECU_ADDRESS 20007814 /end MEASUREMENT
/begin MEASUREMENT SI_FreeStack "" ULONG HANcoder_E407_GTSync_v4_CM_uint32 0 0 0 4294967295 ECU_ADDRESS 200078e8 /end MEASUREMENT
/begin MEASUREMENT local_ticks_interrupt "" UWORD HANcoder_E407_GTSync_v4_CM_uint16 0 0 0 65535 ECU_ADDRESS 200079e0 /end MEASUREMENT
/begin MEASUREMENT SI_CPUload "" UBYTE HANcoder_E407_GTSync_v4_CM_uint8 0 0 0 255 ECU_ADDRESS 20007988 /end MEASUREMENT
/begin MEASUREMENT LedValue "" UBYTE HANcoder_E407_GTSync_v4_CM_boolean 0 0 0 1 ECU_ADDRESS 20007830 /end MEASUREMENT
/begin MEASUREMENT odd "" UBYTE HANcoder_E407_GTSync_v4_CM_boolean 0 0 0 1 ECU_ADDRESS 200078b0 /end MEASUREMENT
/begin MEASUREMENT even "" UBYTE HANcoder_E407_GTSync_v4_CM_boolean 0 0 0 1 ECU_ADDRESS 20007959 /end MEASUREMENT
/begin MEASUREMENT Master_ID_DEBUG "" FLOAT64_IEEE HANcoder_E407_GTSync_v4_CM_double 0 0 -1.7E+308 1.7E+308 ECU_ADDRESS 20007668 /end MEASUREMENT
/begin MEASUREMENT Role_ID_DEBUG "" FLOAT64_IEEE HANcoder_E407_GTSync_v4_CM_double 0 0 -1.7E+308 1.7E+308 ECU_ADDRESS 200079c0 /end MEASUREMENT
/begin MEASUREMENT time_difference_vote_3_DEBUG "" FLOAT64_IEEE HANcoder_E407_GTSync_v4_CM_double 0 0 -1.7E+308 1.7E+308 ECU_ADDRESS 20007948 /end MEASUREMENT
/begin MEASUREMENT votes_Board_1_DEBUG "" FLOAT64_IEEE HANcoder_E407_GTSync_v4_CM_double 0 0 -1.7E+308 1.7E+308 ECU_ADDRESS 200079b0 /end MEASUREMENT
/begin MEASUREMENT votes_Board_2_DEBUG "" FLOAT64_IEEE HANcoder_E407_GTSync_v4_CM_double 0 0 -1.7E+308 1.7E+308 ECU_ADDRESS 20007990 /end MEASUREMENT
/begin MEASUREMENT votes_Board_3_DEBUG "" FLOAT64_IEEE HANcoder_E407_GTSync_v4_CM_double 0 0 -1.7E+308 1.7E+308 ECU_ADDRESS 200077d0 /end MEASUREMENT
/begin MEASUREMENT Board_1_error_counter_DEBUG "" FLOAT64_IEEE HANcoder_E407_GTSync_v4_CM_double 0 0 -1.7E+308 1.7E+308 ECU_ADDRESS 200079b8 /end MEASUREMENT
/begin MEASUREMENT Board_2_error_counter_DEBUG "" FLOAT64_IEEE HANcoder_E407_GTSync_v4_CM_double 0 0 -1.7E+308 1.7E+308 ECU_ADDRESS 20007970 /end MEASUREMENT
/begin MEASUREMENT Board_3_error_counter_DEBUG "" FLOAT64_IEEE HANcoder_E407_GTSync_v4_CM_double 0 0 -1.7E+308 1.7E+308 ECU_ADDRESS 20007660 /end MEASUREMENT
/begin MEASUREMENT time_difference_sync_DEBUG "" FLOAT64_IEEE HANcoder_E407_GTSync_v4_CM_double 0 0 -1.7E+308 1.7E+308 ECU_ADDRESS 200078c0 /end MEASUREMENT
/begin MEASUREMENT time_difference_vote_1_DEBUG "" FLOAT64_IEEE HANcoder_E407_GTSync_v4_CM_double 0 0 -1.7E+308 1.7E+308 ECU_ADDRESS 20007628 /end MEASUREMENT
/begin MEASUREMENT time_difference_vote_2_DEBUG "" FLOAT64_IEEE HANcoder_E407_GTSync_v4_CM_double 0 0 -1.7E+308 1.7E+308 ECU_ADDRESS 200077f0 /end MEASUREMENT
/begin MEASUREMENT time_difference_sync_s3 "" FLOAT64_IEEE HANcoder_E407_GTSync_v4_CM_double 0 0 -1.7E+308 1.7E+308 ECU_ADDRESS 20007980 /end MEASUREMENT
/begin MEASUREMENT time_difference_vote1_s3 "" FLOAT64_IEEE HANcoder_E407_GTSync_v4_CM_double 0 0 -1.7E+308 1.7E+308 ECU_ADDRESS 20007868 /end MEASUREMENT
/begin MEASUREMENT time_difference_vote2_s3 "" FLOAT64_IEEE HANcoder_E407_GTSync_v4_CM_double 0 0 -1.7E+308 1.7E+308 ECU_ADDRESS 200079d8 /end MEASUREMENT
/begin MEASUREMENT time_difference_vote3_s3 "" FLOAT64_IEEE HANcoder_E407_GTSync_v4_CM_double 0 0 -1.7E+308 1.7E+308 ECU_ADDRESS 20007618 /end MEASUREMENT
/begin MEASUREMENT time_difference_sync_s2 "" FLOAT64_IEEE HANcoder_E407_GTSync_v4_CM_double 0 0 -1.7E+308 1.7E+308 ECU_ADDRESS 20007898 /end MEASUREMENT
/begin MEASUREMENT time_difference_vote1_s2 "" FLOAT64_IEEE HANcoder_E407_GTSync_v4_CM_double 0 0 -1.7E+308 1.7E+308 ECU_ADDRESS 20007978 /end MEASUREMENT
/begin MEASUREMENT time_difference_vote2_s2 "" FLOAT64_IEEE HANcoder_E407_GTSync_v4_CM_double 0 0 -1.7E+308 1.7E+308 ECU_ADDRESS 20007878 /end MEASUREMENT
/begin MEASUREMENT time_difference_vote3_s2 "" FLOAT64_IEEE HANcoder_E407_GTSync_v4_CM_double 0 0 -1.7E+308 1.7E+308 ECU_ADDRESS 20007650 /end MEASUREMENT
/begin MEASUREMENT time_difference_sync_s1 "" FLOAT64_IEEE HANcoder_E407_GTSync_v4_CM_double 0 0 -1.7E+308 1.7E+308 ECU_ADDRESS 20007648 /end MEASUREMENT
/begin MEASUREMENT time_difference_vote1_s1 "" FLOAT64_IEEE HANcoder_E407_GTSync_v4_CM_double 0 0 -1.7E+308 1.7E+308 ECU_ADDRESS 200077b0 /end MEASUREMENT
/begin MEASUREMENT time_difference_vote2_s1 "" FLOAT64_IEEE HANcoder_E407_GTSync_v4_CM_double 0 0 -1.7E+308 1.7E+308 ECU_ADDRESS 20007890 /end MEASUREMENT
/begin MEASUREMENT time_difference_vote3_s1 "" FLOAT64_IEEE HANcoder_E407_GTSync_v4_CM_double 0 0 -1.7E+308 1.7E+308 ECU_ADDRESS 200078f8 /end MEASUREMENT
/begin MEASUREMENT time_difference_sync_s "" FLOAT64_IEEE HANcoder_E407_GTSync_v4_CM_double 0 0 -1.7E+308 1.7E+308 ECU_ADDRESS 20007808 /end MEASUREMENT
/begin MEASUREMENT time_difference_vote1_s "" FLOAT64_IEEE HANcoder_E407_GTSync_v4_CM_double 0 0 -1.7E+308 1.7E+308 ECU_ADDRESS 200078d8 /end MEASUREMENT
/begin MEASUREMENT time_difference_vote2_s "" FLOAT64_IEEE HANcoder_E407_GTSync_v4_CM_double 0 0 -1.7E+308 1.7E+308 ECU_ADDRESS 20007608 /end MEASUREMENT
/begin MEASUREMENT time_difference_vote3_s "" FLOAT64_IEEE HANcoder_E407_GTSync_v4_CM_double 0 0 -1.7E+308 1.7E+308 ECU_ADDRESS 200077d8 /end MEASUREMENT
/begin MEASUREMENT bc1_time_difference_sync_s "" FLOAT64_IEEE HANcoder_E407_GTSync_v4_CM_double 0 0 -1.7E+308 1.7E+308 ECU_ADDRESS 200077c8 /end MEASUREMENT
/begin MEASUREMENT bc1_time_difference_vote1_s "" FLOAT64_IEEE HANcoder_E407_GTSync_v4_CM_double 0 0 -1.7E+308 1.7E+308 ECU_ADDRESS 20007950 /end MEASUREMENT
/begin MEASUREMENT bc1_time_difference_vote2_s "" FLOAT64_IEEE HANcoder_E407_GTSync_v4_CM_double 0 0 -1.7E+308 1.7E+308 ECU_ADDRESS 20007798 /end MEASUREMENT
/begin MEASUREMENT bc1_time_difference_vote3_s "" FLOAT64_IEEE HANcoder_E407_GTSync_v4_CM_double 0 0 -1.7E+308 1.7E+308 ECU_ADDRESS 20007658 /end MEASUREMENT
/begin MEASUREMENT Master_ID_s "" FLOAT64_IEEE HANcoder_E407_GTSync_v4_CM_double 0 0 -1.7E+308 1.7E+308 ECU_ADDRESS 20007828 /end MEASUREMENT
/begin MEASUREMENT Role_ID_s "" FLOAT64_IEEE HANcoder_E407_GTSync_v4_CM_double 0 0 -1.7E+308 1.7E+308 ECU_ADDRESS 20007670 /end MEASUREMENT
/begin MEASUREMENT Timeout_Board1 "" FLOAT64_IEEE HANcoder_E407_GTSync_v4_CM_double 0 0 -1.7E+308 1.7E+308 ECU_ADDRESS 200078a8 /end MEASUREMENT
/begin MEASUREMENT TM1_timeout_counter_s "" FLOAT64_IEEE HANcoder_E407_GTSync_v4_CM_double 0 0 -1.7E+308 1.7E+308 ECU_ADDRESS 200077e0 /end MEASUREMENT
/begin MEASUREMENT Timeout_Board2 "" FLOAT64_IEEE HANcoder_E407_GTSync_v4_CM_double 0 0 -1.7E+308 1.7E+308 ECU_ADDRESS 20007850 /end MEASUREMENT
/begin MEASUREMENT TM2_timeout_counter_s "" FLOAT64_IEEE HANcoder_E407_GTSync_v4_CM_double 0 0 -1.7E+308 1.7E+308 ECU_ADDRESS 200078e0 /end MEASUREMENT
/begin MEASUREMENT Timeout_Board3 "" FLOAT64_IEEE HANcoder_E407_GTSync_v4_CM_double 0 0 -1.7E+308 1.7E+308 ECU_ADDRESS 20007998 /end MEASUREMENT
/begin MEASUREMENT TM3_timeout_counter_s "" FLOAT64_IEEE HANcoder_E407_GTSync_v4_CM_double 0 0 -1.7E+308 1.7E+308 ECU_ADDRESS 20007820 /end MEASUREMENT
/begin MEASUREMENT delay_counter_DEBUG "" FLOAT64_IEEE HANcoder_E407_GTSync_v4_CM_double 0 0 -1.7E+308 1.7E+308 ECU_ADDRESS 20007638 /end MEASUREMENT
/begin MEASUREMENT LT_Update_Counter_s "" SLONG HANcoder_E407_GTSync_v4_CM_int32 0 0 -2147483648 2147483647 ECU_ADDRESS 20007848 /end MEASUREMENT
/begin MEASUREMENT local_time_s "" UWORD HANcoder_E407_GTSync_v4_CM_uint16 0 0 0 65535 ECU_ADDRESS 2000798a /end MEASUREMENT
/begin MEASUREMENT received_LT_Board_1_DEBUG "" UWORD HANcoder_E407_GTSync_v4_CM_uint16 0 0 0 65535 ECU_ADDRESS 200078c8 /end MEASUREMENT
/begin MEASUREMENT received_LT_Board_2_DEBUG "" UWORD HANcoder_E407_GTSync_v4_CM_uint16 0 0 0 65535 ECU_ADDRESS 20007610 /end MEASUREMENT
/begin MEASUREMENT received_LT_Board_3_DEBUG "" UWORD HANcoder_E407_GTSync_v4_CM_uint16 0 0 0 65535 ECU_ADDRESS 2000796a /end MEASUREMENT
/begin MEASUREMENT RX_LT_Master_s "" UWORD HANcoder_E407_GTSync_v4_CM_uint16 0 0 0 65535 ECU_ADDRESS 2000784c /end MEASUREMENT
/begin MEASUREMENT LT_Upd_s "" UWORD HANcoder_E407_GTSync_v4_CM_uint16 0 0 0 65535 ECU_ADDRESS 20007818 /end MEASUREMENT
/begin MEASUREMENT rx_state_s "" UBYTE HANcoder_E407_GTSync_v4_CM_uint8 0 0 0 255 ECU_ADDRESS 20007811 /end MEASUREMENT
/begin MEASUREMENT Vote_s "" UBYTE HANcoder_E407_GTSync_v4_CM_uint8 0 0 0 255 ECU_ADDRESS 20007612 /end MEASUREMENT
/begin MEASUREMENT basic_cycle_DEBUG "" UBYTE HANcoder_E407_GTSync_v4_CM_uint8 0 0 0 255 ECU_ADDRESS 200077c0 /end MEASUREMENT
/begin MEASUREMENT bc "" UBYTE HANcoder_E407_GTSync_v4_CM_uint8 0 0 0 255 ECU_ADDRESS 2000795a /end MEASUREMENT
/begin MEASUREMENT Receive_New_Message_Flag_2 "" UBYTE HANcoder_E407_GTSync_v4_CM_boolean 0 0 0 1 ECU_ADDRESS 200079c8 /end MEASUREMENT
/begin MEASUREMENT Send_New_Message_Flag "" UBYTE HANcoder_E407_GTSync_v4_CM_boolean 0 0 0 1 ECU_ADDRESS 20007810 /end MEASUREMENT
/begin MEASUREMENT sync_processed_s "" UBYTE HANcoder_E407_GTSync_v4_CM_boolean 0 0 0 1 ECU_ADDRESS 20007630 /end MEASUREMENT
/begin MEASUREMENT new_msg_ready_s "" UBYTE HANcoder_E407_GTSync_v4_CM_boolean 0 0 0 1 ECU_ADDRESS 2000781a /end MEASUREMENT
/begin MEASUREMENT initialization_flag_DEBUG "" UBYTE HANcoder_E407_GTSync_v4_CM_boolean 0 0 0 1 ECU_ADDRESS 20007880 /end MEASUREMENT
/begin MEASUREMENT New_Msg_Rx_DEBUG "" UBYTE HANcoder_E407_GTSync_v4_CM_boolean 0 0 0 1 ECU_ADDRESS 200077f8 /end MEASUREMENT
/begin MEASUREMENT initialization_timeout_DEBUG "" UBYTE HANcoder_E407_GTSync_v4_CM_boolean 0 0 0 1 ECU_ADDRESS 200077e8 /end MEASUREMENT
/begin MEASUREMENT CAN_new_double "" FLOAT64_IEEE HANcoder_E407_GTSync_v4_CM_double 0 0 -1.7E+308 1.7E+308 ECU_ADDRESS 20007620 /end MEASUREMENT
/begin MEASUREMENT Message_Header_s "" FLOAT64_IEEE HANcoder_E407_GTSync_v4_CM_double 0 0 -1.7E+308 1.7E+308 ECU_ADDRESS 200077a8 /end MEASUREMENT
/begin MEASUREMENT received_local_time_1 "" FLOAT64_IEEE HANcoder_E407_GTSync_v4_CM_double 0 0 -1.7E+308 1.7E+308 ECU_ADDRESS 200078f0 /end MEASUREMENT
/begin MEASUREMENT received_local_time "" FLOAT64_IEEE HANcoder_E407_GTSync_v4_CM_double 0 0 -1.7E+308 1.7E+308 ECU_ADDRESS 20007840 /end MEASUREMENT
/begin MEASUREMENT received_local_time_2 "" FLOAT64_IEEE HANcoder_E407_GTSync_v4_CM_double 0 0 -1.7E+308 1.7E+308 ECU_ADDRESS 20007800 /end MEASUREMENT
/begin MEASUREMENT received_basic_cycle "" FLOAT64_IEEE HANcoder_E407_GTSync_v4_CM_double 0 0 -1.7E+308 1.7E+308 ECU_ADDRESS 20007858 /end MEASUREMENT
/begin MEASUREMENT received_message_1 "" FLOAT64_IEEE HANcoder_E407_GTSync_v4_CM_double 0 0 -1.7E+308 1.7E+308 ECU_ADDRESS 20007960 /end MEASUREMENT
/begin MEASUREMENT received_message_2 "" FLOAT64_IEEE HANcoder_E407_GTSync_v4_CM_double 0 0 -1.7E+308 1.7E+308 ECU_ADDRESS 20007888 /end MEASUREMENT
/begin MEASUREMENT received_message_3 "" FLOAT64_IEEE HANcoder_E407_GTSync_v4_CM_double 0 0 -1.7E+308 1.7E+308 ECU_ADDRESS 200079d0 /end MEASUREMENT
/begin MEASUREMENT received_message_4 "" FLOAT64_IEEE HANcoder_E407_GTSync_v4_CM_double 0 0 -1.7E+308 1.7E+308 ECU_ADDRESS 200078d0 /end MEASUREMENT
/begin MEASUREMENT RxID "" ULONG HANcoder_E407_GTSync_v4_CM_uint32 0 0 0 4294967295 ECU_ADDRESS 20007688 /end MEASUREMENT
/begin MEASUREMENT Rx_msg_counter_s "" ULONG HANcoder_E407_GTSync_v4_CM_uint32 0 0 0 4294967295 ECU_ADDRESS 20007640 /end MEASUREMENT
/begin MEASUREMENT Rx_msg_counter_2 "" ULONG HANcoder_E407_GTSync_v4_CM_uint32 0 0 0 4294967295 ECU_ADDRESS 200079a0 /end MEASUREMENT
/begin MEASUREMENT CAN_RX_counter_s "" ULONG HANcoder_E407_GTSync_v4_CM_uint32 0 0 0 4294967295 ECU_ADDRESS 200077a0 /end MEASUREMENT
/begin MEASUREMENT received_local_time_update "" UWORD HANcoder_E407_GTSync_v4_CM_uint16 0 0 0 65535 ECU_ADDRESS 20007870 /end MEASUREMENT
/begin MEASUREMENT CAN_new "" SBYTE HANcoder_E407_GTSync_v4_CM_int8 0 0 -128 127 ECU_ADDRESS 20007968 /end MEASUREMENT
/begin MEASUREMENT CAN_new_boolean "" UBYTE HANcoder_E407_GTSync_v4_CM_boolean 0 0 0 1 ECU_ADDRESS 20007958 /end MEASUREMENT
/begin MEASUREMENT Message_Ready_CAN_RX_s "" UBYTE HANcoder_E407_GTSync_v4_CM_boolean 0 0 0 1 ECU_ADDRESS 200078a0 /end MEASUREMENT
/begin MEASUREMENT sent_local_ticks_1 "" FLOAT64_IEEE HANcoder_E407_GTSync_v4_CM_double 0 0 -1.7E+308 1.7E+308 ECU_ADDRESS 20007838 /end MEASUREMENT
/begin MEASUREMENT sent_local_ticks_2 "" FLOAT64_IEEE HANcoder_E407_GTSync_v4_CM_double 0 0 -1.7E+308 1.7E+308 ECU_ADDRESS 20007690 /end MEASUREMENT
/begin MEASUREMENT Tx_msg_counter_s "" ULONG HANcoder_E407_GTSync_v4_CM_uint32 0 0 0 4294967295 ECU_ADDRESS 200079a4 /end MEASUREMENT
/begin MEASUREMENT TxID "" ULONG HANcoder_E407_GTSync_v4_CM_uint32 0 0 0 4294967295 ECU_ADDRESS 20007940 /end MEASUREMENT
/begin MEASUREMENT sent_local_ticks_buffer "" UWORD HANcoder_E407_GTSync_v4_CM_uint16 0 0 0 65535 ECU_ADDRESS 20007860 /end MEASUREMENT
/begin MEASUREMENT Local_Ticks_Activation_CAN_send "" UWORD HANcoder_E407_GTSync_v4_CM_uint16 0 0 0 65535 ECU_ADDRESS 20007678 /end MEASUREMENT
/begin MEASUREMENT FRC_Activation_CAN_send "" UWORD HANcoder_E407_GTSync_v4_CM_uint16 0 0 0 65535 ECU_ADDRESS 20007862 /end MEASUREMENT
/begin MEASUREMENT sent_message_header_buffer "" UBYTE HANcoder_E407_GTSync_v4_CM_uint8 0 0 0 255 ECU_ADDRESS 200077f9 /end MEASUREMENT
/begin MEASUREMENT sent_basic_cycle "" UBYTE HANcoder_E407_GTSync_v4_CM_uint8 0 0 0 255 ECU_ADDRESS 200079a8 /end MEASUREMENT
/begin COMPU_METHOD HANcoder_E407_GTSync_v4_CM_boolean "Q = V" RAT_FUNC "%1.0" "" COEFFS 0 1 0 0 0 1 /end COMPU_METHOD
/begin COMPU_METHOD HANcoder_E407_GTSync_v4_CM_double "Q = V" RAT_FUNC "%15.10" "" COEFFS 0 1 0 0 0 1 /end COMPU_METHOD
/begin COMPU_METHOD HANcoder_E407_GTSync_v4_CM_uint32 "Q = V" RAT_FUNC "%10.0" "" COEFFS 0 1 0 0 0 1 /end COMPU_METHOD
/begin COMPU_METHOD HANcoder_E407_GTSync_v4_CM_uint16 "Q = V" RAT_FUNC "%5.0" "" COEFFS 0 1 0 0 0 1 /end COMPU_METHOD
/begin COMPU_METHOD HANcoder_E407_GTSync_v4_CM_uint8 "Q = V" RAT_FUNC "%3.0" "" COEFFS 0 1 0 0 0 1 /end COMPU_METHOD
/begin COMPU_METHOD HANcoder_E407_GTSync_v4_CM_int32 "Q = V" RAT_FUNC "%10.0" "" COEFFS 0 1 0 0 0 1 /end COMPU_METHOD
/begin COMPU_METHOD HANcoder_E407_GTSync_v4_CM_int8 "Q = V" RAT_FUNC "%3.0" "" COEFFS 0 1 0 0 0 1 /end COMPU_METHOD
/begin GROUP HANcoder_E407_GTSync_v4 "HANcoder_E407_GTSync_v4" /* Root */ ROOT /begin SUB_GROUP Root_HANcoder_STM32_Target___E407_STM32_algorithm /end SUB_GROUP /end GROUP
/begin GROUP Root_HANcoder_STM32_Target___E407_STM32_algorithm "HANcoder_E407_GTSync_v4/HANcoder STM32 Target - E407-STM32 algorithm"
 /begin SUB_GROUP S1_Algorithm S1_Global_Ticks_Increment S1_System_information /end SUB_GROUP
/end GROUP
/begin GROUP S1_Algorithm "HANcoder_E407_GTSync_v4/HANcoder STM32 Target - E407-STM32 algorithm/Algorithm" /begin REF_CHARACTERISTIC HANtuneOverride /end REF_CHARACTERISTIC /begin REF_MEASUREMENT LedValue /end REF_MEASUREMENT /end GROUP
/begin GROUP S1_Global_Ticks_Increment "HANcoder_E407_GTSync_v4/HANcoder STM32 Target - E407-STM32 algorithm/Global Ticks Increment"
 /begin SUB_GROUP S6_CAN_Management S6_CAN_Recieve S6_CAN_Send S6_Function_Call_Subsystem S6_If_Action_Subsystem /end SUB_GROUP
 /begin REF_MEASUREMENT simulation_time /end REF_MEASUREMENT
/end GROUP
/begin GROUP S1_System_information "HANcoder_E407_GTSync_v4/HANcoder STM32 Target - E407-STM32 algorithm/System information" /begin SUB_GROUP S10_Get_CPU_load S10_Get_free_Heap S10_Get_free_Stack /end SUB_GROUP /end GROUP
/begin GROUP S6_CAN_Management "HANcoder_E407_GTSync_v4/HANcoder STM32 Target - E407-STM32 algorithm/Global Ticks Increment/CAN Management"
 /begin SUB_GROUP S19_Basic_Cycle_Increment S19_Initialization S19_Matrix_Cycle_Manager /end SUB_GROUP
 /begin REF_MEASUREMENT Receive_New_Message_Flag_2 /end REF_MEASUREMENT
/end GROUP
/begin GROUP S6_CAN_Recieve "HANcoder_E407_GTSync_v4/HANcoder STM32 Target - E407-STM32 algorithm/Global Ticks Increment/CAN Recieve" /begin SUB_GROUP S20_RxID_CAN S20_Update_message_buffers /end SUB_GROUP
 /begin REF_MEASUREMENT CAN_RX_counter_s CAN_new_boolean CAN_new_double Message_Ready_CAN_RX_s RxID Rx_msg_counter_2 Rx_msg_counter_s /end REF_MEASUREMENT
/end GROUP
/begin GROUP S6_CAN_Send "HANcoder_E407_GTSync_v4/HANcoder STM32 Target - E407-STM32 algorithm/Global Ticks Increment/CAN Send" /begin SUB_GROUP S21_Get_Free_Running_Counter /end SUB_GROUP
 /begin REF_MEASUREMENT Local_Ticks_Activation_CAN_send TxID Tx_msg_counter_s sent_basic_cycle sent_local_ticks_1 sent_local_ticks_2 sent_local_ticks_buffer sent_message_header_buffer /end REF_MEASUREMENT
/end GROUP
/begin GROUP S6_Function_Call_Subsystem "HANcoder_E407_GTSync_v4/HANcoder STM32 Target - E407-STM32 algorithm/Global Ticks Increment/Function-Call Subsystem" /begin REF_MEASUREMENT even local_ticks_interrupt odd /end REF_MEASUREMENT /end GROUP
/begin GROUP S6_If_Action_Subsystem "HANcoder_E407_GTSync_v4/HANcoder STM32 Target - E407-STM32 algorithm/Global Ticks Increment/If Action Subsystem" /begin REF_MEASUREMENT Board_ID_s /end REF_MEASUREMENT /end GROUP
/begin GROUP S10_Get_CPU_load "HANcoder_E407_GTSync_v4/HANcoder STM32 Target - E407-STM32 algorithm/System information/Get CPU load" /begin REF_MEASUREMENT SI_CPUload /end REF_MEASUREMENT /end GROUP
/begin GROUP S10_Get_free_Heap "HANcoder_E407_GTSync_v4/HANcoder STM32 Target - E407-STM32 algorithm/System information/Get free Heap" /begin REF_MEASUREMENT SI_FreeHeap /end REF_MEASUREMENT /end GROUP
/begin GROUP S10_Get_free_Stack "HANcoder_E407_GTSync_v4/HANcoder STM32 Target - E407-STM32 algorithm/System information/Get free Stack" /begin REF_MEASUREMENT SI_FreeStack /end REF_MEASUREMENT /end GROUP
/begin GROUP S19_Basic_Cycle_Increment "HANcoder_E407_GTSync_v4/HANcoder STM32 Target - E407-STM32 algorithm/Global Ticks Increment/CAN Management/Basic Cycle Increment" /begin REF_MEASUREMENT bc /end REF_MEASUREMENT /end GROUP
/begin GROUP S19_Initialization "HANcoder_E407_GTSync_v4/HANcoder STM32 Target - E407-STM32 algorithm/Global Ticks Increment/CAN Management/Initialization" /begin SUB_GROUP S32_Delay /end SUB_GROUP /end GROUP
/begin GROUP S19_Matrix_Cycle_Manager "HANcoder_E407_GTSync_v4/HANcoder STM32 Target - E407-STM32 algorithm/Global Ticks Increment/CAN Management/Matrix Cycle Manager"
 /begin SUB_GROUP S33_COMP_Task___Check_Timeouts S33_COMP_Task___New_Master S33_COMP_Task___Update_LT S33_COMP_Task___Update_LT1 S33_COMP_Task___Vote1_Count S33_COMP_Task___Vote2_Count S33_COMP_Task___Vote3_Count S33_COMP_Task___Vote_Decision S33_Matrix_Cycle_Observation_DEBUG /end SUB_GROUP
 /begin REF_MEASUREMENT Send_New_Message_Flag local_time_s /end REF_MEASUREMENT
/end GROUP
/begin GROUP S20_RxID_CAN "HANcoder_E407_GTSync_v4/HANcoder STM32 Target - E407-STM32 algorithm/Global Ticks Increment/CAN Recieve/RxID_CAN" /begin REF_MEASUREMENT CAN_new /end REF_MEASUREMENT /end GROUP
/begin GROUP S20_Update_message_buffers "HANcoder_E407_GTSync_v4/HANcoder STM32 Target - E407-STM32 algorithm/Global Ticks Increment/CAN Recieve/Update message buffers" /begin SUB_GROUP S104_UINT8_to_UINT16 /end SUB_GROUP
 /begin REF_MEASUREMENT Message_Header_s received_basic_cycle received_local_time received_local_time_1 received_local_time_2 received_message_1 received_message_2 received_message_3 received_message_4 /end REF_MEASUREMENT
/end GROUP
/begin GROUP S21_Get_Free_Running_Counter "HANcoder_E407_GTSync_v4/HANcoder STM32 Target - E407-STM32 algorithm/Global Ticks Increment/CAN Send/Get Free Running Counter" /begin REF_MEASUREMENT FRC_Activation_CAN_send /end REF_MEASUREMENT /end GROUP
/begin GROUP S32_Delay "HANcoder_E407_GTSync_v4/HANcoder STM32 Target - E407-STM32 algorithm/Global Ticks Increment/CAN Management/Initialization/Delay" /begin SUB_GROUP S36_Initializaton_Observation_DEBUG /end SUB_GROUP /end GROUP
/begin GROUP S33_COMP_Task___Check_Timeouts "HANcoder_E407_GTSync_v4/HANcoder STM32 Target - E407-STM32 algorithm/Global Ticks Increment/CAN Management/Matrix Cycle Manager/COMP Task - Check Timeouts" /begin SUB_GROUP S46_Timeout_and_Board_error_counter /end SUB_GROUP /end GROUP
/begin GROUP S33_COMP_Task___New_Master "HANcoder_E407_GTSync_v4/HANcoder STM32 Target - E407-STM32 algorithm/Global Ticks Increment/CAN Management/Matrix Cycle Manager/COMP Task - New Master" /begin SUB_GROUP S47_New_Master /end SUB_GROUP /end GROUP
/begin GROUP S33_COMP_Task___Update_LT "HANcoder_E407_GTSync_v4/HANcoder STM32 Target - E407-STM32 algorithm/Global Ticks Increment/CAN Management/Matrix Cycle Manager/COMP Task - Update LT" /begin SUB_GROUP S51_Local_Time_Update /end SUB_GROUP /end GROUP
/begin GROUP S33_COMP_Task___Update_LT1 "HANcoder_E407_GTSync_v4/HANcoder STM32 Target - E407-STM32 algorithm/Global Ticks Increment/CAN Management/Matrix Cycle Manager/COMP Task - Update LT1" /begin SUB_GROUP S52_Local_Time_Update /end SUB_GROUP /end GROUP
/begin GROUP S33_COMP_Task___Vote_Decision "HANcoder_E407_GTSync_v4/HANcoder STM32 Target - E407-STM32 algorithm/Global Ticks Increment/CAN Management/Matrix Cycle Manager/COMP Task - Vote Decision" /begin SUB_GROUP S53_Vote_Decision /end SUB_GROUP /end GROUP
/begin GROUP S33_COMP_Task___Vote1_Count "HANcoder_E407_GTSync_v4/HANcoder STM32 Target - E407-STM32 algorithm/Global Ticks Increment/CAN Management/Matrix Cycle Manager/COMP Task - Vote1 Count" /begin SUB_GROUP S54_Vote_Count_1 /end SUB_GROUP /end GROUP
/begin GROUP S33_COMP_Task___Vote2_Count "HANcoder_E407_GTSync_v4/HANcoder STM32 Target - E407-STM32 algorithm/Global Ticks Increment/CAN Management/Matrix Cycle Manager/COMP Task - Vote2 Count" /begin SUB_GROUP S55_Vote_Count_2 /end SUB_GROUP /end GROUP
/begin GROUP S33_COMP_Task___Vote3_Count "HANcoder_E407_GTSync_v4/HANcoder STM32 Target - E407-STM32 algorithm/Global Ticks Increment/CAN Management/Matrix Cycle Manager/COMP Task - Vote3 Count" /begin SUB_GROUP S56_Vote_Count_3 /end SUB_GROUP /end GROUP
/begin GROUP S33_Matrix_Cycle_Observation_DEBUG "HANcoder_E407_GTSync_v4/HANcoder STM32 Target - E407-STM32 algorithm/Global Ticks Increment/CAN Management/Matrix Cycle Manager/Matrix_Cycle_Observation_DEBUG"
 /begin REF_MEASUREMENT Board_1_error_counter_DEBUG Board_2_error_counter_DEBUG Board_3_error_counter_DEBUG Master_ID_DEBUG Role_ID_DEBUG new_msg_ready_s received_LT_Board_1_DEBUG received_LT_Board_2_DEBUG received_LT_Board_3_DEBUG rx_state_s sync_processed_s time_difference_sync_DEBUG time_difference_vote_1_DEBUG time_difference_vote_2_DEBUG time_difference_vote_3_DEBUG votes_Board_1_DEBUG votes_Board_2_DEBUG votes_Board_3_DEBUG /end REF_MEASUREMENT
/end GROUP
/begin GROUP S104_UINT8_to_UINT16 "HANcoder_E407_GTSync_v4/HANcoder STM32 Target - E407-STM32 algorithm/Global Ticks Increment/CAN Recieve/Update message buffers/UINT8 to UINT16" /begin REF_MEASUREMENT received_local_time_update /end REF_MEASUREMENT /end GROUP
/begin GROUP S36_Initializaton_Observation_DEBUG "HANcoder_E407_GTSync_v4/HANcoder STM32 Target - E407-STM32 algorithm/Global Ticks Increment/CAN Management/Initialization/Delay/Initializaton_Observation_DEBUG"
 /begin REF_MEASUREMENT New_Msg_Rx_DEBUG basic_cycle_DEBUG delay_counter_DEBUG initialization_flag_DEBUG initialization_timeout_DEBUG /end REF_MEASUREMENT
/end GROUP
/begin GROUP S46_Timeout_and_Board_error_counter "HANcoder_E407_GTSync_v4/HANcoder STM32 Target - E407-STM32 algorithm/Global Ticks Increment/CAN Management/Matrix Cycle Manager/COMP Task - Check Timeouts/Timeout and Board error counter"
 /begin SUB_GROUP S63_Timeout_Counter_1_DEBUG S63_Timeout_Counter_2_DEBUG S63_Timeout_Counter_3_DEBUG /end SUB_GROUP
 /begin REF_MEASUREMENT Timeout_Board1 Timeout_Board2 Timeout_Board3 /end REF_MEASUREMENT
/end GROUP
/begin GROUP S47_New_Master "HANcoder_E407_GTSync_v4/HANcoder STM32 Target - E407-STM32 algorithm/Global Ticks Increment/CAN Management/Matrix Cycle Manager/COMP Task - New Master/New Master" /begin SUB_GROUP S67_Votes_recount_to_choose_Master /end SUB_GROUP /begin REF_MEASUREMENT Role_ID_s /end REF_MEASUREMENT /end GROUP
/begin GROUP S51_Local_Time_Update "HANcoder_E407_GTSync_v4/HANcoder STM32 Target - E407-STM32 algorithm/Global Ticks Increment/CAN Management/Matrix Cycle Manager/COMP Task - Update LT/Local Time Update" /begin SUB_GROUP S73_Extra_Time S73_Time_Difference_DEBUG /end SUB_GROUP /begin REF_MEASUREMENT LT_Upd_s LT_Update_Counter_s /end REF_MEASUREMENT /end GROUP
/begin GROUP S52_Local_Time_Update "HANcoder_E407_GTSync_v4/HANcoder STM32 Target - E407-STM32 algorithm/Global Ticks Increment/CAN Management/Matrix Cycle Manager/COMP Task - Update LT1/Local Time Update" /begin SUB_GROUP S79_Time_Difference_DEBUG /end SUB_GROUP /end GROUP
/begin GROUP S53_Vote_Decision "HANcoder_E407_GTSync_v4/HANcoder STM32 Target - E407-STM32 algorithm/Global Ticks Increment/CAN Management/Matrix Cycle Manager/COMP Task - Vote Decision/Vote Decision" /begin REF_MEASUREMENT Vote_s /end REF_MEASUREMENT /end GROUP
/begin GROUP S54_Vote_Count_1 "HANcoder_E407_GTSync_v4/HANcoder STM32 Target - E407-STM32 algorithm/Global Ticks Increment/CAN Management/Matrix Cycle Manager/COMP Task - Vote1 Count/Vote Count 1" /begin SUB_GROUP S89_Time_Difference_DEBUG /end SUB_GROUP /end GROUP
/begin GROUP S55_Vote_Count_2 "HANcoder_E407_GTSync_v4/HANcoder STM32 Target - E407-STM32 algorithm/Global Ticks Increment/CAN Management/Matrix Cycle Manager/COMP Task - Vote2 Count/Vote Count 2" /begin SUB_GROUP S93_Time_Difference_DEBUG /end SUB_GROUP /end GROUP
/begin GROUP S56_Vote_Count_3 "HANcoder_E407_GTSync_v4/HANcoder STM32 Target - E407-STM32 algorithm/Global Ticks Increment/CAN Management/Matrix Cycle Manager/COMP Task - Vote3 Count/Vote Count 3" /begin SUB_GROUP S97_Time_Difference_DEBUG /end SUB_GROUP /end GROUP
/begin GROUP S63_Timeout_Counter_1_DEBUG "HANcoder_E407_GTSync_v4/HANcoder STM32 Target - E407-STM32 algorithm/Global Ticks Increment/CAN Management/Matrix Cycle Manager/COMP Task - Check Timeouts/Timeout and Board error counter/Timeout Counter 1 DEBUG" /begin REF_MEASUREMENT TM1_timeout_counter_s /end REF_MEASUREMENT /end GROUP
/begin GROUP S63_Timeout_Counter_2_DEBUG "HANcoder_E407_GTSync_v4/HANcoder STM32 Target - E407-STM32 algorithm/Global Ticks Increment/CAN Management/Matrix Cycle Manager/COMP Task - Check Timeouts/Timeout and Board error counter/Timeout Counter 2 DEBUG" /begin REF_MEASUREMENT TM2_timeout_counter_s /end REF_MEASUREMENT /end GROUP
/begin GROUP S63_Timeout_Counter_3_DEBUG "HANcoder_E407_GTSync_v4/HANcoder STM32 Target - E407-STM32 algorithm/Global Ticks Increment/CAN Management/Matrix Cycle Manager/COMP Task - Check Timeouts/Timeout and Board error counter/Timeout Counter 3 DEBUG" /begin REF_MEASUREMENT TM3_timeout_counter_s /end REF_MEASUREMENT /end GROUP
/begin GROUP S67_Votes_recount_to_choose_Master "HANcoder_E407_GTSync_v4/HANcoder STM32 Target - E407-STM32 algorithm/Global Ticks Increment/CAN Management/Matrix Cycle Manager/COMP Task - New Master/New Master/Votes recount to choose Master" /begin REF_MEASUREMENT Master_ID_s /end REF_MEASUREMENT /end GROUP
/begin GROUP S73_Extra_Time "HANcoder_E407_GTSync_v4/HANcoder STM32 Target - E407-STM32 algorithm/Global Ticks Increment/CAN Management/Matrix Cycle Manager/COMP Task - Update LT/Local Time Update/Extra_Time" /begin REF_MEASUREMENT RX_LT_Master_s /end REF_MEASUREMENT /end GROUP
/begin GROUP S73_Time_Difference_DEBUG "HANcoder_E407_GTSync_v4/HANcoder STM32 Target - E407-STM32 algorithm/Global Ticks Increment/CAN Management/Matrix Cycle Manager/COMP Task - Update LT/Local Time Update/Time_Difference_DEBUG"
 /begin REF_MEASUREMENT bc1_time_difference_sync_s bc1_time_difference_vote1_s bc1_time_difference_vote2_s bc1_time_difference_vote3_s /end REF_MEASUREMENT
/end GROUP
/begin GROUP S79_Time_Difference_DEBUG "HANcoder_E407_GTSync_v4/HANcoder STM32 Target - E407-STM32 algorithm/Global Ticks Increment/CAN Management/Matrix Cycle Manager/COMP Task - Update LT1/Local Time Update/Time_Difference_DEBUG"
 /begin REF_MEASUREMENT time_difference_sync_s time_difference_vote1_s time_difference_vote2_s time_difference_vote3_s /end REF_MEASUREMENT
/end GROUP
/begin GROUP S89_Time_Difference_DEBUG "HANcoder_E407_GTSync_v4/HANcoder STM32 Target - E407-STM32 algorithm/Global Ticks Increment/CAN Management/Matrix Cycle Manager/COMP Task - Vote1 Count/Vote Count 1/Time_Difference_DEBUG"
 /begin REF_MEASUREMENT time_difference_sync_s1 time_difference_vote1_s1 time_difference_vote2_s1 time_difference_vote3_s1 /end REF_MEASUREMENT
/end GROUP
/begin GROUP S93_Time_Difference_DEBUG "HANcoder_E407_GTSync_v4/HANcoder STM32 Target - E407-STM32 algorithm/Global Ticks Increment/CAN Management/Matrix Cycle Manager/COMP Task - Vote2 Count/Vote Count 2/Time_Difference_DEBUG"
 /begin REF_MEASUREMENT time_difference_sync_s2 time_difference_vote1_s2 time_difference_vote2_s2 time_difference_vote3_s2 /end REF_MEASUREMENT
/end GROUP
/begin GROUP S97_Time_Difference_DEBUG "HANcoder_E407_GTSync_v4/HANcoder STM32 Target - E407-STM32 algorithm/Global Ticks Increment/CAN Management/Matrix Cycle Manager/COMP Task - Vote3 Count/Vote Count 3/Time_Difference_DEBUG"
 /begin REF_MEASUREMENT time_difference_sync_s3 time_difference_vote1_s3 time_difference_vote2_s3 time_difference_vote3_s3 /end REF_MEASUREMENT
/end GROUP
/end MODULE
/end PROJECT
/* (add any file trailer comments here) */
/* EOF HANcoder_E407_GTSync_v4.a2l */
