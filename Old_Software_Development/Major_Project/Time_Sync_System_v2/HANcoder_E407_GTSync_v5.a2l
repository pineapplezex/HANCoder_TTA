/******************************************************************************
* ASAP2 file: HANcoder_E407_GTSync_v5.a2l
* Academic License - for use in teaching, academic research, and meeting
* course requirements at degree granting institutions only. Not for
* government, commercial, or other organizational use.
* Code generation for model "HANcoder_E407_GTSync_v5".
* Model version : 1.430
* Simulink Coder version : 9.0 (R2018b) 24-May-2018
* C source code generated on : Wed Dec 8 20:46:32 2021
* Target selection: ert.tlc
* Embedded hardware selection: Generic->32-bit Embedded Processor
* Code generation objectives: Unspecified
* Validation result: Not run
* (add additional file header information here)
******************************************************************************/ ASAP2_VERSION 1 31
/* Version 1.31 */
/begin PROJECT ProjectName "HANcoder_E407_GTSync_v5_softwareID_v1_081221_204543"
/begin HEADER "Header Comments go here" /end HEADER
/begin MODULE ModuleName "Module Comment Goes Here"
/begin MOD_PAR "MOD PAR Comment Goes Here" /end MOD_PAR
/begin MOD_COMMON "Mod Common Comment Here" BYTE_ORDER MSB_LAST /end MOD_COMMON
/begin RECORD_LAYOUT Scalar_BOOLEAN FNC_VALUES 1 UBYTE COLUMN_DIR DIRECT /end RECORD_LAYOUT
/begin RECORD_LAYOUT Scalar_UBYTE FNC_VALUES 1 UBYTE COLUMN_DIR DIRECT /end RECORD_LAYOUT
/begin RECORD_LAYOUT Scalar_BYTE FNC_VALUES 1 SBYTE COLUMN_DIR DIRECT /end RECORD_LAYOUT
/begin RECORD_LAYOUT Scalar_UWORD FNC_VALUES 1 UWORD COLUMN_DIR DIRECT /end RECORD_LAYOUT
/begin RECORD_LAYOUT Scalar_SWORD FNC_VALUES 1 SWORD COLUMN_DIR DIRECT /end RECORD_LAYOUT
/begin RECORD_LAYOUT Scalar_ULONG FNC_VALUES 1 ULONG COLUMN_DIR DIRECT /end RECORD_LAYOUT
/begin RECORD_LAYOUT Scalar_LONG FNC_VALUES 1 SLONG COLUMN_DIR DIRECT /end RECORD_LAYOUT
/begin RECORD_LAYOUT Scalar_FLOAT32_IEEE FNC_VALUES 1 FLOAT32_IEEE COLUMN_DIR DIRECT /end RECORD_LAYOUT
/begin RECORD_LAYOUT Scalar_FLOAT64_IEEE FNC_VALUES 1 FLOAT64_IEEE COLUMN_DIR DIRECT /end RECORD_LAYOUT
/begin RECORD_LAYOUT Lookup1D_BYTE FNC_VALUES 1 SBYTE COLUMN_DIR DIRECT /end RECORD_LAYOUT
/begin RECORD_LAYOUT Lookup1D_X_BYTE AXIS_PTS_X 1 SBYTE INDEX_INCR DIRECT /end RECORD_LAYOUT
/begin RECORD_LAYOUT Lookup1D_UBYTE FNC_VALUES 1 UBYTE COLUMN_DIR DIRECT /end RECORD_LAYOUT
/begin RECORD_LAYOUT Lookup1D_X_UBYTE AXIS_PTS_X 1 UBYTE INDEX_INCR DIRECT /end RECORD_LAYOUT
/begin RECORD_LAYOUT Lookup1D_UWORD FNC_VALUES 1 UWORD COLUMN_DIR DIRECT /end RECORD_LAYOUT
/begin RECORD_LAYOUT Lookup1D_X_UWORD AXIS_PTS_X 1 UWORD INDEX_INCR DIRECT /end RECORD_LAYOUT
/begin RECORD_LAYOUT Lookup1D_WORD FNC_VALUES 1 SWORD COLUMN_DIR DIRECT /end RECORD_LAYOUT
/begin RECORD_LAYOUT Lookup1D_X_WORD AXIS_PTS_X 1 SWORD INDEX_INCR DIRECT /end RECORD_LAYOUT
/begin RECORD_LAYOUT Lookup1D_ULONG FNC_VALUES 1 ULONG COLUMN_DIR DIRECT /end RECORD_LAYOUT
/begin RECORD_LAYOUT Lookup1D_X_ULONG AXIS_PTS_X 1 ULONG INDEX_INCR DIRECT /end RECORD_LAYOUT
/begin RECORD_LAYOUT Lookup1D_SLONG FNC_VALUES 1 SLONG COLUMN_DIR DIRECT /end RECORD_LAYOUT
/begin RECORD_LAYOUT Lookup1D_X_LONG AXIS_PTS_X 1 SLONG INDEX_INCR DIRECT /end RECORD_LAYOUT
/begin RECORD_LAYOUT Lookup1D_FLOAT32_IEEE FNC_VALUES 1 FLOAT32_IEEE COLUMN_DIR DIRECT /end RECORD_LAYOUT
/begin RECORD_LAYOUT Lookup1D_X_FLOAT32_IEEE AXIS_PTS_X 1 FLOAT32_IEEE INDEX_INCR DIRECT /end RECORD_LAYOUT
/begin RECORD_LAYOUT Lookup1D_FLOAT64_IEEE FNC_VALUES 1 FLOAT64_IEEE COLUMN_DIR DIRECT /end RECORD_LAYOUT
/begin RECORD_LAYOUT Lookup1D_X_FLOAT64_IEEE AXIS_PTS_X 1 FLOAT64_IEEE INDEX_INCR DIRECT /end RECORD_LAYOUT
/begin RECORD_LAYOUT Lookup2D_UBYTE FNC_VALUES 1 UBYTE COLUMN_DIR DIRECT /end RECORD_LAYOUT
/begin RECORD_LAYOUT Lookup2D_X_UBYTE AXIS_PTS_X 1 UBYTE INDEX_INCR DIRECT /end RECORD_LAYOUT
/begin RECORD_LAYOUT Lookup2D_BYTE FNC_VALUES 1 SBYTE COLUMN_DIR DIRECT /end RECORD_LAYOUT
/begin RECORD_LAYOUT Lookup2D_X_BYTE AXIS_PTS_X 1 SBYTE INDEX_INCR DIRECT /end RECORD_LAYOUT
/begin RECORD_LAYOUT Lookup2D_UWORD FNC_VALUES 1 UWORD COLUMN_DIR DIRECT /end RECORD_LAYOUT
/begin RECORD_LAYOUT Lookup2D_X_UWORD AXIS_PTS_X 1 UWORD INDEX_INCR DIRECT /end RECORD_LAYOUT
/begin RECORD_LAYOUT Lookup2D_WORD FNC_VALUES 1 SWORD COLUMN_DIR DIRECT /end RECORD_LAYOUT
/begin RECORD_LAYOUT Lookup2D_X_WORD AXIS_PTS_X 1 SWORD INDEX_INCR DIRECT /end RECORD_LAYOUT
/begin RECORD_LAYOUT Lookup2D_ULONG FNC_VALUES 1 ULONG COLUMN_DIR DIRECT /end RECORD_LAYOUT
/begin RECORD_LAYOUT Lookup2D_X_ULONG AXIS_PTS_X 1 ULONG INDEX_INCR DIRECT /end RECORD_LAYOUT
/begin RECORD_LAYOUT Lookup2D_LONG FNC_VALUES 1 SLONG COLUMN_DIR DIRECT /end RECORD_LAYOUT
/begin RECORD_LAYOUT Lookup2D_X_LONG AXIS_PTS_X 1 SLONG INDEX_INCR DIRECT /end RECORD_LAYOUT
/begin RECORD_LAYOUT Lookup2D_FLOAT32_IEEE FNC_VALUES 1 FLOAT32_IEEE COLUMN_DIR DIRECT /end RECORD_LAYOUT
/begin RECORD_LAYOUT Lookup2D_X_FLOAT32_IEEE AXIS_PTS_X 1 FLOAT32_IEEE INDEX_INCR DIRECT /end RECORD_LAYOUT
/begin RECORD_LAYOUT Lookup2D_FLOAT64_IEEE FNC_VALUES 1 FLOAT64_IEEE COLUMN_DIR DIRECT /end RECORD_LAYOUT
/begin RECORD_LAYOUT Lookup2D_X_FLOAT64_IEEE AXIS_PTS_X 1 FLOAT64_IEEE INDEX_INCR DIRECT /end RECORD_LAYOUT
/begin CHARACTERISTIC HANtuneOverride /* Long Identifier */ "" /* Type */ VALUE /* ECU Address */ 20000174 /* Record Layout */ Scalar_BOOLEAN /* Maximum Difference */ 0 /* Conversion Method */ HANcoder_E407_GTSync_v5_CM_boolean /* Lower Limit */ 0 /* Upper Limit */ 1 /end CHARACTERISTIC
/begin MEASUREMENT simulation_time "" FLOAT64_IEEE HANcoder_E407_GTSync_v5_CM_double 0 0 -1.7E+308 1.7E+308 ECU_ADDRESS 200079f8 /end MEASUREMENT
/begin MEASUREMENT Board_ID_s "" FLOAT64_IEEE HANcoder_E407_GTSync_v5_CM_double 0 0 -1.7E+308 1.7E+308 ECU_ADDRESS 20007878 /end MEASUREMENT
/begin MEASUREMENT SI_FreeHeap "" ULONG HANcoder_E407_GTSync_v5_CM_uint32 0 0 0 4294967295 ECU_ADDRESS 20007918 /end MEASUREMENT
/begin MEASUREMENT SI_FreeStack "" ULONG HANcoder_E407_GTSync_v5_CM_uint32 0 0 0 4294967295 ECU_ADDRESS 20007a18 /end MEASUREMENT
/begin MEASUREMENT local_ticks_interrupt "" UWORD HANcoder_E407_GTSync_v5_CM_uint16 0 0 0 65535 ECU_ADDRESS 20007be0 /end MEASUREMENT
/begin MEASUREMENT rx_state_can1_s "" UBYTE HANcoder_E407_GTSync_v5_CM_uint8 0 0 0 255 ECU_ADDRESS 200079da /end MEASUREMENT
/begin MEASUREMENT rx_state_can2_s "" UBYTE HANcoder_E407_GTSync_v5_CM_uint8 0 0 0 255 ECU_ADDRESS 20007b70 /end MEASUREMENT
/begin MEASUREMENT SI_CPUload "" UBYTE HANcoder_E407_GTSync_v5_CM_uint8 0 0 0 255 ECU_ADDRESS 20007b79 /end MEASUREMENT
/begin MEASUREMENT new_msg_ready_can1_s "" UBYTE HANcoder_E407_GTSync_v5_CM_boolean 0 0 0 1 ECU_ADDRESS 200078d8 /end MEASUREMENT
/begin MEASUREMENT new_msg_ready_can2_s "" UBYTE HANcoder_E407_GTSync_v5_CM_boolean 0 0 0 1 ECU_ADDRESS 20007bf0 /end MEASUREMENT
/begin MEASUREMENT LedValue "" UBYTE HANcoder_E407_GTSync_v5_CM_boolean 0 0 0 1 ECU_ADDRESS 20007958 /end MEASUREMENT
/begin MEASUREMENT Master_ID_DEBUG "" FLOAT64_IEEE HANcoder_E407_GTSync_v5_CM_double 0 0 -1.7E+308 1.7E+308 ECU_ADDRESS 20007678 /end MEASUREMENT
/begin MEASUREMENT Role_ID_DEBUG "" FLOAT64_IEEE HANcoder_E407_GTSync_v5_CM_double 0 0 -1.7E+308 1.7E+308 ECU_ADDRESS 20007bd8 /end MEASUREMENT
/begin MEASUREMENT time_difference_vote_3_DEBUG "" FLOAT64_IEEE HANcoder_E407_GTSync_v5_CM_double 0 0 -1.7E+308 1.7E+308 ECU_ADDRESS 20007b28 /end MEASUREMENT
/begin MEASUREMENT votes_Board_1_DEBUG "" FLOAT64_IEEE HANcoder_E407_GTSync_v5_CM_double 0 0 -1.7E+308 1.7E+308 ECU_ADDRESS 20007bc8 /end MEASUREMENT
/begin MEASUREMENT votes_Board_2_DEBUG "" FLOAT64_IEEE HANcoder_E407_GTSync_v5_CM_double 0 0 -1.7E+308 1.7E+308 ECU_ADDRESS 20007b90 /end MEASUREMENT
/begin MEASUREMENT votes_Board_3_DEBUG "" FLOAT64_IEEE HANcoder_E407_GTSync_v5_CM_double 0 0 -1.7E+308 1.7E+308 ECU_ADDRESS 20007888 /end MEASUREMENT
/begin MEASUREMENT Board_1_error_counter_DEBUG "" FLOAT64_IEEE HANcoder_E407_GTSync_v5_CM_double 0 0 -1.7E+308 1.7E+308 ECU_ADDRESS 20007bd0 /end MEASUREMENT
/begin MEASUREMENT Board_2_error_counter_DEBUG "" FLOAT64_IEEE HANcoder_E407_GTSync_v5_CM_double 0 0 -1.7E+308 1.7E+308 ECU_ADDRESS 20007b68 /end MEASUREMENT
/begin MEASUREMENT Board_3_error_counter_DEBUG "" FLOAT64_IEEE HANcoder_E407_GTSync_v5_CM_double 0 0 -1.7E+308 1.7E+308 ECU_ADDRESS 20007670 /end MEASUREMENT
/begin MEASUREMENT time_difference_sync_DEBUG "" FLOAT64_IEEE HANcoder_E407_GTSync_v5_CM_double 0 0 -1.7E+308 1.7E+308 ECU_ADDRESS 20007a00 /end MEASUREMENT
/begin MEASUREMENT time_difference_vote_1_DEBUG "" FLOAT64_IEEE HANcoder_E407_GTSync_v5_CM_double 0 0 -1.7E+308 1.7E+308 ECU_ADDRESS 20007650 /end MEASUREMENT
/begin MEASUREMENT time_difference_vote_2_DEBUG "" FLOAT64_IEEE HANcoder_E407_GTSync_v5_CM_double 0 0 -1.7E+308 1.7E+308 ECU_ADDRESS 200078a8 /end MEASUREMENT
/begin MEASUREMENT RX_LT_Master_bc1_s "" FLOAT64_IEEE HANcoder_E407_GTSync_v5_CM_double 0 0 -1.7E+308 1.7E+308 ECU_ADDRESS 20007708 /end MEASUREMENT
/begin MEASUREMENT RX_LT_Master_bc0_s "" FLOAT64_IEEE HANcoder_E407_GTSync_v5_CM_double 0 0 -1.7E+308 1.7E+308 ECU_ADDRESS 200076a0 /end MEASUREMENT
/begin MEASUREMENT Desync_Vote3_s "" FLOAT64_IEEE HANcoder_E407_GTSync_v5_CM_double 0 0 -1.7E+308 1.7E+308 ECU_ADDRESS 200076a8 /end MEASUREMENT
/begin MEASUREMENT Desync_Vote2_s "" FLOAT64_IEEE HANcoder_E407_GTSync_v5_CM_double 0 0 -1.7E+308 1.7E+308 ECU_ADDRESS 20007688 /end MEASUREMENT
/begin MEASUREMENT Desync_Vote1_s "" FLOAT64_IEEE HANcoder_E407_GTSync_v5_CM_double 0 0 -1.7E+308 1.7E+308 ECU_ADDRESS 20007b50 /end MEASUREMENT
/begin MEASUREMENT Desync_Sync_bc1_s "" FLOAT64_IEEE HANcoder_E407_GTSync_v5_CM_double 0 0 -1.7E+308 1.7E+308 ECU_ADDRESS 200079c8 /end MEASUREMENT
/begin MEASUREMENT RX_SYNC_LT1_CAN2_s "" FLOAT64_IEEE HANcoder_E407_GTSync_v5_CM_double 0 0 -1.7E+308 1.7E+308 ECU_ADDRESS 200079e0 /end MEASUREMENT
/begin MEASUREMENT RX_SYNC_BC1_CAN2_s "" FLOAT64_IEEE HANcoder_E407_GTSync_v5_CM_double 0 0 -1.7E+308 1.7E+308 ECU_ADDRESS 20007a20 /end MEASUREMENT
/begin MEASUREMENT RX_SYNC_HDR1_CAN2_s "" FLOAT64_IEEE HANcoder_E407_GTSync_v5_CM_double 0 0 -1.7E+308 1.7E+308 ECU_ADDRESS 20007990 /end MEASUREMENT
/begin MEASUREMENT RX_SYNC_LT1_CAN1_s "" FLOAT64_IEEE HANcoder_E407_GTSync_v5_CM_double 0 0 -1.7E+308 1.7E+308 ECU_ADDRESS 20007b80 /end MEASUREMENT
/begin MEASUREMENT RX_SYNC_BC1_CAN1_s "" FLOAT64_IEEE HANcoder_E407_GTSync_v5_CM_double 0 0 -1.7E+308 1.7E+308 ECU_ADDRESS 20007910 /end MEASUREMENT
/begin MEASUREMENT RX_SYNC_HDR1_CAN1_s "" FLOAT64_IEEE HANcoder_E407_GTSync_v5_CM_double 0 0 -1.7E+308 1.7E+308 ECU_ADDRESS 200079c0 /end MEASUREMENT
/begin MEASUREMENT Desync_Sync_bc0_s "" FLOAT64_IEEE HANcoder_E407_GTSync_v5_CM_double 0 0 -1.7E+308 1.7E+308 ECU_ADDRESS 200076c0 /end MEASUREMENT
/begin MEASUREMENT RX_SYNC_LT_CAN2_s "" FLOAT64_IEEE HANcoder_E407_GTSync_v5_CM_double 0 0 -1.7E+308 1.7E+308 ECU_ADDRESS 20007a38 /end MEASUREMENT
/begin MEASUREMENT RX_SYNC_HDR_CAN2_s "" FLOAT64_IEEE HANcoder_E407_GTSync_v5_CM_double 0 0 -1.7E+308 1.7E+308 ECU_ADDRESS 20007b40 /end MEASUREMENT
/begin MEASUREMENT RX_SYNC_BC_CAN2_s "" FLOAT64_IEEE HANcoder_E407_GTSync_v5_CM_double 0 0 -1.7E+308 1.7E+308 ECU_ADDRESS 20007be8 /end MEASUREMENT
/begin MEASUREMENT RX_SYNC_LT_CAN1_s "" FLOAT64_IEEE HANcoder_E407_GTSync_v5_CM_double 0 0 -1.7E+308 1.7E+308 ECU_ADDRESS 20007a40 /end MEASUREMENT
/begin MEASUREMENT RX_SYNC_BC_CAN1_s "" FLOAT64_IEEE HANcoder_E407_GTSync_v5_CM_double 0 0 -1.7E+308 1.7E+308 ECU_ADDRESS 20007b20 /end MEASUREMENT
/begin MEASUREMENT RX_SYNC_HDR_CAN1_s "" FLOAT64_IEEE HANcoder_E407_GTSync_v5_CM_double 0 0 -1.7E+308 1.7E+308 ECU_ADDRESS 20007988 /end MEASUREMENT
/begin MEASUREMENT votes_board1_s "" FLOAT64_IEEE HANcoder_E407_GTSync_v5_CM_double 0 0 -1.7E+308 1.7E+308 ECU_ADDRESS 20007938 /end MEASUREMENT
/begin MEASUREMENT votes_board2_s "" FLOAT64_IEEE HANcoder_E407_GTSync_v5_CM_double 0 0 -1.7E+308 1.7E+308 ECU_ADDRESS 20007948 /end MEASUREMENT
/begin MEASUREMENT votes_board3_s "" FLOAT64_IEEE HANcoder_E407_GTSync_v5_CM_double 0 0 -1.7E+308 1.7E+308 ECU_ADDRESS 20007a30 /end MEASUREMENT
/begin MEASUREMENT Master_ID_s "" FLOAT64_IEEE HANcoder_E407_GTSync_v5_CM_double 0 0 -1.7E+308 1.7E+308 ECU_ADDRESS 20007950 /end MEASUREMENT
/begin MEASUREMENT Role_ID_s "" FLOAT64_IEEE HANcoder_E407_GTSync_v5_CM_double 0 0 -1.7E+308 1.7E+308 ECU_ADDRESS 20007680 /end MEASUREMENT
/begin MEASUREMENT Timeout_Board1 "" FLOAT64_IEEE HANcoder_E407_GTSync_v5_CM_double 0 0 -1.7E+308 1.7E+308 ECU_ADDRESS 200079f0 /end MEASUREMENT
/begin MEASUREMENT Timeout_Board2 "" FLOAT64_IEEE HANcoder_E407_GTSync_v5_CM_double 0 0 -1.7E+308 1.7E+308 ECU_ADDRESS 200079a0 /end MEASUREMENT
/begin MEASUREMENT Timeout_Board3 "" FLOAT64_IEEE HANcoder_E407_GTSync_v5_CM_double 0 0 -1.7E+308 1.7E+308 ECU_ADDRESS 20007ba8 /end MEASUREMENT
/begin MEASUREMENT Timeout_Master3 "" FLOAT64_IEEE HANcoder_E407_GTSync_v5_CM_double 0 0 -1.7E+308 1.7E+308 ECU_ADDRESS 200079d0 /end MEASUREMENT
/begin MEASUREMENT Timeout_Master2 "" FLOAT64_IEEE HANcoder_E407_GTSync_v5_CM_double 0 0 -1.7E+308 1.7E+308 ECU_ADDRESS 20007690 /end MEASUREMENT
/begin MEASUREMENT Timeout_Master1 "" FLOAT64_IEEE HANcoder_E407_GTSync_v5_CM_double 0 0 -1.7E+308 1.7E+308 ECU_ADDRESS 200078c0 /end MEASUREMENT
/begin MEASUREMENT TM1_timeout_counter_s "" FLOAT64_IEEE HANcoder_E407_GTSync_v5_CM_double 0 0 -1.7E+308 1.7E+308 ECU_ADDRESS 20007898 /end MEASUREMENT
/begin MEASUREMENT TM2_timeout_counter_s "" FLOAT64_IEEE HANcoder_E407_GTSync_v5_CM_double 0 0 -1.7E+308 1.7E+308 ECU_ADDRESS 20007a10 /end MEASUREMENT
/begin MEASUREMENT TM3_timeout_counter_s "" FLOAT64_IEEE HANcoder_E407_GTSync_v5_CM_double 0 0 -1.7E+308 1.7E+308 ECU_ADDRESS 20007928 /end MEASUREMENT
/begin MEASUREMENT TX_SYNC_HDR1_CAN2_s "" FLOAT64_IEEE HANcoder_E407_GTSync_v5_CM_double 0 0 -1.7E+308 1.7E+308 ECU_ADDRESS 20007ba0 /end MEASUREMENT
/begin MEASUREMENT TX_SYNC_LT1_CAN2_s "" FLOAT64_IEEE HANcoder_E407_GTSync_v5_CM_double 0 0 -1.7E+308 1.7E+308 ECU_ADDRESS 20007700 /end MEASUREMENT
/begin MEASUREMENT TX_SYNC_HDR1_CAN1_s "" FLOAT64_IEEE HANcoder_E407_GTSync_v5_CM_double 0 0 -1.7E+308 1.7E+308 ECU_ADDRESS 200079b0 /end MEASUREMENT
/begin MEASUREMENT TX_SYNC_LT1_CAN1_s "" FLOAT64_IEEE HANcoder_E407_GTSync_v5_CM_double 0 0 -1.7E+308 1.7E+308 ECU_ADDRESS 200076b0 /end MEASUREMENT
/begin MEASUREMENT TX_SYNC_HDR_CAN1_s "" FLOAT64_IEEE HANcoder_E407_GTSync_v5_CM_double 0 0 -1.7E+308 1.7E+308 ECU_ADDRESS 20007998 /end MEASUREMENT
/begin MEASUREMENT TX_SYNC_LT_CAN1_s "" FLOAT64_IEEE HANcoder_E407_GTSync_v5_CM_double 0 0 -1.7E+308 1.7E+308 ECU_ADDRESS 200078d0 /end MEASUREMENT
/begin MEASUREMENT delay_counter_DEBUG "" FLOAT64_IEEE HANcoder_E407_GTSync_v5_CM_double 0 0 -1.7E+308 1.7E+308 ECU_ADDRESS 20007660 /end MEASUREMENT
/begin MEASUREMENT CAN1_Message_Header_s "" FLOAT64_IEEE HANcoder_E407_GTSync_v5_CM_double 0 0 -1.7E+308 1.7E+308 ECU_ADDRESS 20007978 /end MEASUREMENT
/begin MEASUREMENT CAN1_received_local_time_1 "" FLOAT64_IEEE HANcoder_E407_GTSync_v5_CM_double 0 0 -1.7E+308 1.7E+308 ECU_ADDRESS 20007858 /end MEASUREMENT
/begin MEASUREMENT CAN1_received_local_time "" FLOAT64_IEEE HANcoder_E407_GTSync_v5_CM_double 0 0 -1.7E+308 1.7E+308 ECU_ADDRESS 20007640 /end MEASUREMENT
/begin MEASUREMENT CAN1_received_local_time_2 "" FLOAT64_IEEE HANcoder_E407_GTSync_v5_CM_double 0 0 -1.7E+308 1.7E+308 ECU_ADDRESS 20007b58 /end MEASUREMENT
/begin MEASUREMENT CAN1_received_basic_cycle "" FLOAT64_IEEE HANcoder_E407_GTSync_v5_CM_double 0 0 -1.7E+308 1.7E+308 ECU_ADDRESS 20007b38 /end MEASUREMENT
/begin MEASUREMENT CAN1_received_message_1 "" FLOAT64_IEEE HANcoder_E407_GTSync_v5_CM_double 0 0 -1.7E+308 1.7E+308 ECU_ADDRESS 200076f8 /end MEASUREMENT
/begin MEASUREMENT CAN1_received_message_2 "" FLOAT64_IEEE HANcoder_E407_GTSync_v5_CM_double 0 0 -1.7E+308 1.7E+308 ECU_ADDRESS 20007868 /end MEASUREMENT
/begin MEASUREMENT CAN1_received_message_3 "" FLOAT64_IEEE HANcoder_E407_GTSync_v5_CM_double 0 0 -1.7E+308 1.7E+308 ECU_ADDRESS 20007970 /end MEASUREMENT
/begin MEASUREMENT CAN1_received_message_4 "" FLOAT64_IEEE HANcoder_E407_GTSync_v5_CM_double 0 0 -1.7E+308 1.7E+308 ECU_ADDRESS 200078e0 /end MEASUREMENT
/begin MEASUREMENT LT_Update_Counter_bc1_s "" SLONG HANcoder_E407_GTSync_v5_CM_int32 0 0 -2147483648 2147483647 ECU_ADDRESS 20007890 /end MEASUREMENT
/begin MEASUREMENT LT_Update_Counter_bc0_s "" SLONG HANcoder_E407_GTSync_v5_CM_int32 0 0 -2147483648 2147483647 ECU_ADDRESS 20007b74 /end MEASUREMENT
/begin MEASUREMENT local_time_s "" UWORD HANcoder_E407_GTSync_v5_CM_uint16 0 0 0 65535 ECU_ADDRESS 20007b88 /end MEASUREMENT
/begin MEASUREMENT received_LT_Board_1_DEBUG "" UWORD HANcoder_E407_GTSync_v5_CM_uint16 0 0 0 65535 ECU_ADDRESS 20007a08 /end MEASUREMENT
/begin MEASUREMENT received_LT_Board_2_DEBUG "" UWORD HANcoder_E407_GTSync_v5_CM_uint16 0 0 0 65535 ECU_ADDRESS 20007632 /end MEASUREMENT
/begin MEASUREMENT received_LT_Board_3_DEBUG "" UWORD HANcoder_E407_GTSync_v5_CM_uint16 0 0 0 65535 ECU_ADDRESS 20007b4a /end MEASUREMENT
/begin MEASUREMENT CAN1_received_local_time_update "" UWORD HANcoder_E407_GTSync_v5_CM_uint16 0 0 0 65535 ECU_ADDRESS 200078f0 /end MEASUREMENT
/begin MEASUREMENT rx_state_s "" UBYTE HANcoder_E407_GTSync_v5_CM_uint8 0 0 0 255 ECU_ADDRESS 20007908 /end MEASUREMENT
/begin MEASUREMENT Vote_s "" UBYTE HANcoder_E407_GTSync_v5_CM_uint8 0 0 0 255 ECU_ADDRESS 20007638 /end MEASUREMENT
/begin MEASUREMENT TX_SYNC_BC1_CAN2_s "" UBYTE HANcoder_E407_GTSync_v5_CM_uint8 0 0 0 255 ECU_ADDRESS 20007b78 /end MEASUREMENT
/begin MEASUREMENT TX_SYNC_BC1_CAN1_s "" UBYTE HANcoder_E407_GTSync_v5_CM_uint8 0 0 0 255 ECU_ADDRESS 20007b99 /end MEASUREMENT
/begin MEASUREMENT TX_SYNC_BC_CAN1_s "" UBYTE HANcoder_E407_GTSync_v5_CM_uint8 0 0 0 255 ECU_ADDRESS 20007b98 /end MEASUREMENT
/begin MEASUREMENT basic_cycle_DEBUG "" UBYTE HANcoder_E407_GTSync_v5_CM_uint8 0 0 0 255 ECU_ADDRESS 20007880 /end MEASUREMENT
/begin MEASUREMENT bc "" UBYTE HANcoder_E407_GTSync_v5_CM_uint8 0 0 0 255 ECU_ADDRESS 20007b48 /end MEASUREMENT
/begin MEASUREMENT Receive_New_Message_CAN1_Flag "" UBYTE HANcoder_E407_GTSync_v5_CM_boolean 0 0 0 1 ECU_ADDRESS 200076c8 /end MEASUREMENT
/begin MEASUREMENT Receive_New_Message_CAN2_Flag "" UBYTE HANcoder_E407_GTSync_v5_CM_boolean 0 0 0 1 ECU_ADDRESS 20007be2 /end MEASUREMENT
/begin MEASUREMENT reset_s "" UBYTE HANcoder_E407_GTSync_v5_CM_boolean 0 0 0 1 ECU_ADDRESS 200079d8 /end MEASUREMENT
/begin MEASUREMENT Send_New_Message_CAN1_Flag "" UBYTE HANcoder_E407_GTSync_v5_CM_boolean 0 0 0 1 ECU_ADDRESS 2000763a /end MEASUREMENT
/begin MEASUREMENT Send_New_Message_CAN2_Flag "" UBYTE HANcoder_E407_GTSync_v5_CM_boolean 0 0 0 1 ECU_ADDRESS 20007668 /end MEASUREMENT
/begin MEASUREMENT sync_processed_s "" UBYTE HANcoder_E407_GTSync_v5_CM_boolean 0 0 0 1 ECU_ADDRESS 20007658 /end MEASUREMENT
/begin MEASUREMENT new_msg_ready_s "" UBYTE HANcoder_E407_GTSync_v5_CM_boolean 0 0 0 1 ECU_ADDRESS 20007920 /end MEASUREMENT
/begin MEASUREMENT new_msg_Rx_Vote3_s "" UBYTE HANcoder_E407_GTSync_v5_CM_boolean 0 0 0 1 ECU_ADDRESS 200078b8 /end MEASUREMENT
/begin MEASUREMENT expected_lt_Vote3_CAN2_s "" UBYTE HANcoder_E407_GTSync_v5_CM_boolean 0 0 0 1 ECU_ADDRESS 20007a28 /end MEASUREMENT
/begin MEASUREMENT expected_bc_Vote3_CAN2_s "" UBYTE HANcoder_E407_GTSync_v5_CM_boolean 0 0 0 1 ECU_ADDRESS 20007860 /end MEASUREMENT
/begin MEASUREMENT new_msg_Rx_Vote2_s "" UBYTE HANcoder_E407_GTSync_v5_CM_boolean 0 0 0 1 ECU_ADDRESS 20007698 /end MEASUREMENT
/begin MEASUREMENT expected_lt_Vote2_CAN2_s "" UBYTE HANcoder_E407_GTSync_v5_CM_boolean 0 0 0 1 ECU_ADDRESS 20007639 /end MEASUREMENT
/begin MEASUREMENT expected_bc_Vote2_CAN2_s "" UBYTE HANcoder_E407_GTSync_v5_CM_boolean 0 0 0 1 ECU_ADDRESS 20007b7a /end MEASUREMENT
/begin MEASUREMENT new_msg_Rx_Vote1_s "" UBYTE HANcoder_E407_GTSync_v5_CM_boolean 0 0 0 1 ECU_ADDRESS 20007985 /end MEASUREMENT
/begin MEASUREMENT expected_lt_Vote1_CAN2_s "" UBYTE HANcoder_E407_GTSync_v5_CM_boolean 0 0 0 1 ECU_ADDRESS 20007959 /end MEASUREMENT
/begin MEASUREMENT expected_bc_Vote1_CAN2_s "" UBYTE HANcoder_E407_GTSync_v5_CM_boolean 0 0 0 1 ECU_ADDRESS 200076b8 /end MEASUREMENT
/begin MEASUREMENT expected_hdr1_Sync_CAN2_s "" UBYTE HANcoder_E407_GTSync_v5_CM_boolean 0 0 0 1 ECU_ADDRESS 200079d9 /end MEASUREMENT
/begin MEASUREMENT expected_lt1_Sync_CAN2_s "" UBYTE HANcoder_E407_GTSync_v5_CM_boolean 0 0 0 1 ECU_ADDRESS 20007930 /end MEASUREMENT
/begin MEASUREMENT expected_bc1_Sync_CAN2_s "" UBYTE HANcoder_E407_GTSync_v5_CM_boolean 0 0 0 1 ECU_ADDRESS 200079db /end MEASUREMENT
/begin MEASUREMENT expected_hdr1_Sync_CAN1_s "" UBYTE HANcoder_E407_GTSync_v5_CM_boolean 0 0 0 1 ECU_ADDRESS 20007bc0 /end MEASUREMENT
/begin MEASUREMENT expected_lt1_Sync_CAN1_s "" UBYTE HANcoder_E407_GTSync_v5_CM_boolean 0 0 0 1 ECU_ADDRESS 20007bb9 /end MEASUREMENT
/begin MEASUREMENT expected_bc1_Sync_CAN1_s "" UBYTE HANcoder_E407_GTSync_v5_CM_boolean 0 0 0 1 ECU_ADDRESS 2000796d /end MEASUREMENT
/begin MEASUREMENT new_msg_Rx_Sync_s "" UBYTE HANcoder_E407_GTSync_v5_CM_boolean 0 0 0 1 ECU_ADDRESS 20007648 /end MEASUREMENT
/begin MEASUREMENT expected_hdr_Sync_CAN2_s "" UBYTE HANcoder_E407_GTSync_v5_CM_boolean 0 0 0 1 ECU_ADDRESS 200078f2 /end MEASUREMENT
/begin MEASUREMENT expected_lt_Sync_CAN2_s "" UBYTE HANcoder_E407_GTSync_v5_CM_boolean 0 0 0 1 ECU_ADDRESS 20007bb8 /end MEASUREMENT
/begin MEASUREMENT expected_bc_Syn_CAN2_s "" UBYTE HANcoder_E407_GTSync_v5_CM_boolean 0 0 0 1 ECU_ADDRESS 200076f0 /end MEASUREMENT
/begin MEASUREMENT expected_hdr_Sync_CAN1_s "" UBYTE HANcoder_E407_GTSync_v5_CM_boolean 0 0 0 1 ECU_ADDRESS 200079e8 /end MEASUREMENT
/begin MEASUREMENT expected_lt_Sync_CAN1_s "" UBYTE HANcoder_E407_GTSync_v5_CM_boolean 0 0 0 1 ECU_ADDRESS 20007984 /end MEASUREMENT
/begin MEASUREMENT expected_bc_Sync_CAN1_s "" UBYTE HANcoder_E407_GTSync_v5_CM_boolean 0 0 0 1 ECU_ADDRESS 20007a0a /end MEASUREMENT
/begin MEASUREMENT initialization_flag_DEBUG "" UBYTE HANcoder_E407_GTSync_v5_CM_boolean 0 0 0 1 ECU_ADDRESS 200079dc /end MEASUREMENT
/begin MEASUREMENT New_Msg_Rx_DEBUG "" UBYTE HANcoder_E407_GTSync_v5_CM_boolean 0 0 0 1 ECU_ADDRESS 200078c8 /end MEASUREMENT
/begin MEASUREMENT initialization_timeout_DEBUG "" UBYTE HANcoder_E407_GTSync_v5_CM_boolean 0 0 0 1 ECU_ADDRESS 200078a0 /end MEASUREMENT
/begin MEASUREMENT Tx2_msg_counter_s "" ULONG HANcoder_E407_GTSync_v5_CM_uint32 0 0 0 4294967295 ECU_ADDRESS 200079b8 /end MEASUREMENT
/begin MEASUREMENT TxID_CAN2_s "" ULONG HANcoder_E407_GTSync_v5_CM_uint32 0 0 0 4294967295 ECU_ADDRESS 200076e0 /end MEASUREMENT
/begin MEASUREMENT Local_Ticks_Activation_CAN2_send "" UWORD HANcoder_E407_GTSync_v5_CM_uint16 0 0 0 65535 ECU_ADDRESS 2000795a /end MEASUREMENT
/begin MEASUREMENT FRC_Activation_CAN2_send "" UWORD HANcoder_E407_GTSync_v5_CM_uint16 0 0 0 65535 ECU_ADDRESS 200079bc /end MEASUREMENT
/begin MEASUREMENT CAN2_new_double "" FLOAT64_IEEE HANcoder_E407_GTSync_v5_CM_double 0 0 -1.7E+308 1.7E+308 ECU_ADDRESS 20007628 /end MEASUREMENT
/begin MEASUREMENT CAN2_RX_counter_s "" ULONG HANcoder_E407_GTSync_v5_CM_uint32 0 0 0 4294967295 ECU_ADDRESS 20007634 /end MEASUREMENT
/begin MEASUREMENT RxID_CAN2_s "" ULONG HANcoder_E407_GTSync_v5_CM_uint32 0 0 0 4294967295 ECU_ADDRESS 20007bbc /end MEASUREMENT
/begin MEASUREMENT CAN2_new "" SBYTE HANcoder_E407_GTSync_v5_CM_int8 0 0 -128 127 ECU_ADDRESS 200079dd /end MEASUREMENT
/begin MEASUREMENT Message_Ready_CAN2_RX_s "" UBYTE HANcoder_E407_GTSync_v5_CM_boolean 0 0 0 1 ECU_ADDRESS 20007630 /end MEASUREMENT
/begin MEASUREMENT CAN1_new_double "" FLOAT64_IEEE HANcoder_E407_GTSync_v5_CM_double 0 0 -1.7E+308 1.7E+308 ECU_ADDRESS 200078e8 /end MEASUREMENT
/begin MEASUREMENT RX_HDR_CAN1_s "" FLOAT64_IEEE HANcoder_E407_GTSync_v5_CM_double 0 0 -1.7E+308 1.7E+308 ECU_ADDRESS 20007bb0 /end MEASUREMENT
/begin MEASUREMENT RX_LT1_CAN1_s "" FLOAT64_IEEE HANcoder_E407_GTSync_v5_CM_double 0 0 -1.7E+308 1.7E+308 ECU_ADDRESS 200078b0 /end MEASUREMENT
/begin MEASUREMENT RX_LT2_CAN1_s "" FLOAT64_IEEE HANcoder_E407_GTSync_v5_CM_double 0 0 -1.7E+308 1.7E+308 ECU_ADDRESS 20007900 /end MEASUREMENT
/begin MEASUREMENT RX_BC_CAN1_s "" FLOAT64_IEEE HANcoder_E407_GTSync_v5_CM_double 0 0 -1.7E+308 1.7E+308 ECU_ADDRESS 20007b30 /end MEASUREMENT
/begin MEASUREMENT RxID_CAN1_s "" ULONG HANcoder_E407_GTSync_v5_CM_uint32 0 0 0 4294967295 ECU_ADDRESS 20007940 /end MEASUREMENT
/begin MEASUREMENT Rx1_msg_counter_s "" ULONG HANcoder_E407_GTSync_v5_CM_uint32 0 0 0 4294967295 ECU_ADDRESS 200078cc /end MEASUREMENT
/begin MEASUREMENT Rx1_msg_counter_2 "" ULONG HANcoder_E407_GTSync_v5_CM_uint32 0 0 0 4294967295 ECU_ADDRESS 20007b60 /end MEASUREMENT
/begin MEASUREMENT CAN1_RX_counter_s "" ULONG HANcoder_E407_GTSync_v5_CM_uint32 0 0 0 4294967295 ECU_ADDRESS 20007870 /end MEASUREMENT
/begin MEASUREMENT CAN1_new "" SBYTE HANcoder_E407_GTSync_v5_CM_int8 0 0 -128 127 ECU_ADDRESS 200079de /end MEASUREMENT
/begin MEASUREMENT CAN1_new_boolean "" UBYTE HANcoder_E407_GTSync_v5_CM_boolean 0 0 0 1 ECU_ADDRESS 200079a8 /end MEASUREMENT
/begin MEASUREMENT Message_Ready_CAN1_RX_s "" UBYTE HANcoder_E407_GTSync_v5_CM_boolean 0 0 0 1 ECU_ADDRESS 20007659 /end MEASUREMENT
/begin MEASUREMENT TX_HDR_CAN1_s "" FLOAT64_IEEE HANcoder_E407_GTSync_v5_CM_double 0 0 -1.7E+308 1.7E+308 ECU_ADDRESS 20007960 /end MEASUREMENT
/begin MEASUREMENT TX_LT1_CAN1_s "" FLOAT64_IEEE HANcoder_E407_GTSync_v5_CM_double 0 0 -1.7E+308 1.7E+308 ECU_ADDRESS 200076e8 /end MEASUREMENT
/begin MEASUREMENT TX_LT2_CAN1_s "" FLOAT64_IEEE HANcoder_E407_GTSync_v5_CM_double 0 0 -1.7E+308 1.7E+308 ECU_ADDRESS 200076d8 /end MEASUREMENT
/begin MEASUREMENT TX_BC_CAN1_s "" FLOAT64_IEEE HANcoder_E407_GTSync_v5_CM_double 0 0 -1.7E+308 1.7E+308 ECU_ADDRESS 200078f8 /end MEASUREMENT
/begin MEASUREMENT Tx1_msg_counter_s "" ULONG HANcoder_E407_GTSync_v5_CM_uint32 0 0 0 4294967295 ECU_ADDRESS 20007980 /end MEASUREMENT
/begin MEASUREMENT TxID_CAN1_s "" ULONG HANcoder_E407_GTSync_v5_CM_uint32 0 0 0 4294967295 ECU_ADDRESS 2000791c /end MEASUREMENT
/begin MEASUREMENT Local_Ticks_Activation_CAN1_send "" UWORD HANcoder_E407_GTSync_v5_CM_uint16 0 0 0 65535 ECU_ADDRESS 20007862 /end MEASUREMENT
/begin MEASUREMENT FRC_Activation_CAN1_send "" UWORD HANcoder_E407_GTSync_v5_CM_uint16 0 0 0 65535 ECU_ADDRESS 20007968 /end MEASUREMENT
/begin COMPU_METHOD HANcoder_E407_GTSync_v5_CM_boolean "Q = V" RAT_FUNC "%1.0" "" COEFFS 0 1 0 0 0 1 /end COMPU_METHOD
/begin COMPU_METHOD HANcoder_E407_GTSync_v5_CM_double "Q = V" RAT_FUNC "%15.10" "" COEFFS 0 1 0 0 0 1 /end COMPU_METHOD
/begin COMPU_METHOD HANcoder_E407_GTSync_v5_CM_uint32 "Q = V" RAT_FUNC "%10.0" "" COEFFS 0 1 0 0 0 1 /end COMPU_METHOD
/begin COMPU_METHOD HANcoder_E407_GTSync_v5_CM_uint16 "Q = V" RAT_FUNC "%5.0" "" COEFFS 0 1 0 0 0 1 /end COMPU_METHOD
/begin COMPU_METHOD HANcoder_E407_GTSync_v5_CM_uint8 "Q = V" RAT_FUNC "%3.0" "" COEFFS 0 1 0 0 0 1 /end COMPU_METHOD
/begin COMPU_METHOD HANcoder_E407_GTSync_v5_CM_int32 "Q = V" RAT_FUNC "%10.0" "" COEFFS 0 1 0 0 0 1 /end COMPU_METHOD
/begin COMPU_METHOD HANcoder_E407_GTSync_v5_CM_int8 "Q = V" RAT_FUNC "%3.0" "" COEFFS 0 1 0 0 0 1 /end COMPU_METHOD
/begin GROUP HANcoder_E407_GTSync_v5 "HANcoder_E407_GTSync_v5" /* Root */ ROOT /begin SUB_GROUP Root_HANcoder_STM32_Target___E407_STM32_algorithm /end SUB_GROUP /end GROUP
/begin GROUP Root_HANcoder_STM32_Target___E407_STM32_algorithm "HANcoder_E407_GTSync_v5/HANcoder STM32 Target - E407-STM32 algorithm"
 /begin SUB_GROUP S1_Algorithm S1_Global_Ticks_Increment S1_System_information /end SUB_GROUP
/end GROUP
/begin GROUP S1_Algorithm "HANcoder_E407_GTSync_v5/HANcoder STM32 Target - E407-STM32 algorithm/Algorithm" /begin REF_CHARACTERISTIC HANtuneOverride /end REF_CHARACTERISTIC /begin REF_MEASUREMENT LedValue /end REF_MEASUREMENT /end GROUP
/begin GROUP S1_Global_Ticks_Increment "HANcoder_E407_GTSync_v5/HANcoder STM32 Target - E407-STM32 algorithm/Global Ticks Increment"
 /begin SUB_GROUP S6_CAN1_Recieve S6_CAN1_Send S6_CAN2_Recieve S6_CAN2_Send S6_CAN_Management S6_DEBUG___CAN_observer S6_If_Action_Subsystem S6_Local_Time_generation /end SUB_GROUP
 /begin REF_MEASUREMENT simulation_time /end REF_MEASUREMENT
/end GROUP
/begin GROUP S1_System_information "HANcoder_E407_GTSync_v5/HANcoder STM32 Target - E407-STM32 algorithm/System information" /begin SUB_GROUP S10_Get_CPU_load S10_Get_free_Heap S10_Get_free_Stack /end SUB_GROUP /end GROUP
/begin GROUP S6_CAN_Management "HANcoder_E407_GTSync_v5/HANcoder STM32 Target - E407-STM32 algorithm/Global Ticks Increment/CAN Management"
 /begin SUB_GROUP S19_Basic_Cycle_Increment S19_Initialization S19_Matrix_Cycle_Manager /end SUB_GROUP
 /begin REF_MEASUREMENT Receive_New_Message_CAN1_Flag Receive_New_Message_CAN2_Flag /end REF_MEASUREMENT
/end GROUP
/begin GROUP S6_CAN1_Recieve "HANcoder_E407_GTSync_v5/HANcoder STM32 Target - E407-STM32 algorithm/Global Ticks Increment/CAN1 Recieve" /begin SUB_GROUP S20_RxID_CAN /end SUB_GROUP
 /begin REF_MEASUREMENT CAN1_RX_counter_s CAN1_new_boolean CAN1_new_double Message_Ready_CAN1_RX_s Rx1_msg_counter_2 Rx1_msg_counter_s RxID_CAN1_s /end REF_MEASUREMENT
/end GROUP
/begin GROUP S6_CAN1_Send "HANcoder_E407_GTSync_v5/HANcoder STM32 Target - E407-STM32 algorithm/Global Ticks Increment/CAN1 Send" /begin SUB_GROUP S21_Get_Free_Running_Counter /end SUB_GROUP
 /begin REF_MEASUREMENT Local_Ticks_Activation_CAN1_send TX_BC_CAN1_s TX_HDR_CAN1_s TX_LT1_CAN1_s TX_LT2_CAN1_s Tx1_msg_counter_s TxID_CAN1_s /end REF_MEASUREMENT
/end GROUP
/begin GROUP S6_CAN2_Recieve "HANcoder_E407_GTSync_v5/HANcoder STM32 Target - E407-STM32 algorithm/Global Ticks Increment/CAN2 Recieve" /begin SUB_GROUP S22_RxID_CAN /end SUB_GROUP
 /begin REF_MEASUREMENT CAN2_RX_counter_s CAN2_new_double Message_Ready_CAN2_RX_s RxID_CAN2_s /end REF_MEASUREMENT
/end GROUP
/begin GROUP S6_CAN2_Send "HANcoder_E407_GTSync_v5/HANcoder STM32 Target - E407-STM32 algorithm/Global Ticks Increment/CAN2 Send" /begin SUB_GROUP S23_Get_Free_Running_Counter /end SUB_GROUP
 /begin REF_MEASUREMENT Local_Ticks_Activation_CAN2_send Tx2_msg_counter_s TxID_CAN2_s /end REF_MEASUREMENT
/end GROUP
/begin GROUP S6_DEBUG___CAN_observer "HANcoder_E407_GTSync_v5/HANcoder STM32 Target - E407-STM32 algorithm/Global Ticks Increment/DEBUG - CAN observer"
 /begin REF_MEASUREMENT new_msg_ready_can1_s new_msg_ready_can2_s rx_state_can1_s rx_state_can2_s /end REF_MEASUREMENT
/end GROUP
/begin GROUP S6_If_Action_Subsystem "HANcoder_E407_GTSync_v5/HANcoder STM32 Target - E407-STM32 algorithm/Global Ticks Increment/If Action Subsystem" /begin REF_MEASUREMENT Board_ID_s /end REF_MEASUREMENT /end GROUP
/begin GROUP S6_Local_Time_generation "HANcoder_E407_GTSync_v5/HANcoder STM32 Target - E407-STM32 algorithm/Global Ticks Increment/Local Time generation" /begin REF_MEASUREMENT local_ticks_interrupt /end REF_MEASUREMENT /end GROUP
/begin GROUP S10_Get_CPU_load "HANcoder_E407_GTSync_v5/HANcoder STM32 Target - E407-STM32 algorithm/System information/Get CPU load" /begin REF_MEASUREMENT SI_CPUload /end REF_MEASUREMENT /end GROUP
/begin GROUP S10_Get_free_Heap "HANcoder_E407_GTSync_v5/HANcoder STM32 Target - E407-STM32 algorithm/System information/Get free Heap" /begin REF_MEASUREMENT SI_FreeHeap /end REF_MEASUREMENT /end GROUP
/begin GROUP S10_Get_free_Stack "HANcoder_E407_GTSync_v5/HANcoder STM32 Target - E407-STM32 algorithm/System information/Get free Stack" /begin REF_MEASUREMENT SI_FreeStack /end REF_MEASUREMENT /end GROUP
/begin GROUP S19_Basic_Cycle_Increment "HANcoder_E407_GTSync_v5/HANcoder STM32 Target - E407-STM32 algorithm/Global Ticks Increment/CAN Management/Basic Cycle Increment" /begin REF_MEASUREMENT bc /end REF_MEASUREMENT /end GROUP
/begin GROUP S19_Initialization "HANcoder_E407_GTSync_v5/HANcoder STM32 Target - E407-STM32 algorithm/Global Ticks Increment/CAN Management/Initialization" /begin SUB_GROUP S40_Delay S40_RoleID_and_Global_Time_init /end SUB_GROUP /end GROUP
/begin GROUP S19_Matrix_Cycle_Manager "HANcoder_E407_GTSync_v5/HANcoder STM32 Target - E407-STM32 algorithm/Global Ticks Increment/CAN Management/Matrix Cycle Manager"
 /begin SUB_GROUP S41_COMM_Task___Sync_BC0 S41_COMM_Task___Sync_BC1 S41_COMP_Task___Check_Timeouts S41_COMP_Task___New_Master S41_COMP_Task___Reset_Board S41_COMP_Task___Rx_Sync_Check S41_COMP_Task___Rx_Sync_Check___bc1 S41_COMP_Task___Rx_Vote1_Check S41_COMP_Task___Rx_Vote2_Check S41_COMP_Task___Rx_Vote3_Check S41_COMP_Task___Update_LT S41_COMP_Task___Update_LT___bc1 S41_COMP_Task___Vote_Decision S41_Matrix_Cycle_Observation_DEBUG /end SUB_GROUP
 /begin REF_MEASUREMENT Send_New_Message_CAN1_Flag Send_New_Message_CAN2_Flag local_time_s /end REF_MEASUREMENT
/end GROUP
/begin GROUP S20_RxID_CAN "HANcoder_E407_GTSync_v5/HANcoder STM32 Target - E407-STM32 algorithm/Global Ticks Increment/CAN1 Recieve/RxID_CAN"
 /begin REF_MEASUREMENT CAN1_new RX_BC_CAN1_s RX_HDR_CAN1_s RX_LT1_CAN1_s RX_LT2_CAN1_s /end REF_MEASUREMENT
/end GROUP
/begin GROUP S21_Get_Free_Running_Counter "HANcoder_E407_GTSync_v5/HANcoder STM32 Target - E407-STM32 algorithm/Global Ticks Increment/CAN1 Send/Get Free Running Counter" /begin REF_MEASUREMENT FRC_Activation_CAN1_send /end REF_MEASUREMENT /end GROUP
/begin GROUP S22_RxID_CAN "HANcoder_E407_GTSync_v5/HANcoder STM32 Target - E407-STM32 algorithm/Global Ticks Increment/CAN2 Recieve/RxID_CAN" /begin REF_MEASUREMENT CAN2_new /end REF_MEASUREMENT /end GROUP
/begin GROUP S23_Get_Free_Running_Counter "HANcoder_E407_GTSync_v5/HANcoder STM32 Target - E407-STM32 algorithm/Global Ticks Increment/CAN2 Send/Get Free Running Counter" /begin REF_MEASUREMENT FRC_Activation_CAN2_send /end REF_MEASUREMENT /end GROUP
/begin GROUP S40_Delay "HANcoder_E407_GTSync_v5/HANcoder STM32 Target - E407-STM32 algorithm/Global Ticks Increment/CAN Management/Initialization/Delay" /begin SUB_GROUP S45_Initializaton_Observation_DEBUG /end SUB_GROUP /end GROUP
/begin GROUP S40_RoleID_and_Global_Time_init "HANcoder_E407_GTSync_v5/HANcoder STM32 Target - E407-STM32 algorithm/Global Ticks Increment/CAN Management/Initialization/RoleID and Global Time init" /begin SUB_GROUP S46_Global_Time_Initialization_Slave /end SUB_GROUP /end GROUP
/begin GROUP S41_COMM_Task___Sync_BC0 "HANcoder_E407_GTSync_v5/HANcoder STM32 Target - E407-STM32 algorithm/Global Ticks Increment/CAN Management/Matrix Cycle Manager/COMM Task - Sync BC0" /begin SUB_GROUP S53_Sync_Msg /end SUB_GROUP /end GROUP
/begin GROUP S41_COMM_Task___Sync_BC1 "HANcoder_E407_GTSync_v5/HANcoder STM32 Target - E407-STM32 algorithm/Global Ticks Increment/CAN Management/Matrix Cycle Manager/COMM Task - Sync BC1" /begin SUB_GROUP S54_Sync_Msg /end SUB_GROUP /end GROUP
/begin GROUP S41_COMP_Task___Check_Timeouts "HANcoder_E407_GTSync_v5/HANcoder STM32 Target - E407-STM32 algorithm/Global Ticks Increment/CAN Management/Matrix Cycle Manager/COMP Task - Check Timeouts" /begin SUB_GROUP S58_Timeout_and_Board_error_counter /end SUB_GROUP /end GROUP
/begin GROUP S41_COMP_Task___New_Master "HANcoder_E407_GTSync_v5/HANcoder STM32 Target - E407-STM32 algorithm/Global Ticks Increment/CAN Management/Matrix Cycle Manager/COMP Task - New Master" /begin SUB_GROUP S59_New_Master /end SUB_GROUP /end GROUP
/begin GROUP S41_COMP_Task___Reset_Board "HANcoder_E407_GTSync_v5/HANcoder STM32 Target - E407-STM32 algorithm/Global Ticks Increment/CAN Management/Matrix Cycle Manager/COMP Task - Reset Board" /begin REF_MEASUREMENT reset_s /end REF_MEASUREMENT /end GROUP
/begin GROUP S41_COMP_Task___Rx_Sync_Check "HANcoder_E407_GTSync_v5/HANcoder STM32 Target - E407-STM32 algorithm/Global Ticks Increment/CAN Management/Matrix Cycle Manager/COMP Task - Rx_Sync_Check" /begin SUB_GROUP S63_Process_Messages /end SUB_GROUP /end GROUP
/begin GROUP S41_COMP_Task___Rx_Sync_Check___bc1 "HANcoder_E407_GTSync_v5/HANcoder STM32 Target - E407-STM32 algorithm/Global Ticks Increment/CAN Management/Matrix Cycle Manager/COMP Task - Rx_Sync_Check - bc1" /begin SUB_GROUP S64_Process_Messages /end SUB_GROUP /end GROUP
/begin GROUP S41_COMP_Task___Rx_Vote1_Check "HANcoder_E407_GTSync_v5/HANcoder STM32 Target - E407-STM32 algorithm/Global Ticks Increment/CAN Management/Matrix Cycle Manager/COMP Task - Rx_Vote1_Check" /begin SUB_GROUP S65_Process_Messages1 /end SUB_GROUP /end GROUP
/begin GROUP S41_COMP_Task___Rx_Vote2_Check "HANcoder_E407_GTSync_v5/HANcoder STM32 Target - E407-STM32 algorithm/Global Ticks Increment/CAN Management/Matrix Cycle Manager/COMP Task - Rx_Vote2_Check" /begin SUB_GROUP S66_Process_Messages1 /end SUB_GROUP /end GROUP
/begin GROUP S41_COMP_Task___Rx_Vote3_Check "HANcoder_E407_GTSync_v5/HANcoder STM32 Target - E407-STM32 algorithm/Global Ticks Increment/CAN Management/Matrix Cycle Manager/COMP Task - Rx_Vote3_Check" /begin SUB_GROUP S67_Process_Messages1 /end SUB_GROUP /end GROUP
/begin GROUP S41_COMP_Task___Update_LT "HANcoder_E407_GTSync_v5/HANcoder STM32 Target - E407-STM32 algorithm/Global Ticks Increment/CAN Management/Matrix Cycle Manager/COMP Task - Update LT" /begin SUB_GROUP S68_Local_Time_Update /end SUB_GROUP /end GROUP
/begin GROUP S41_COMP_Task___Update_LT___bc1 "HANcoder_E407_GTSync_v5/HANcoder STM32 Target - E407-STM32 algorithm/Global Ticks Increment/CAN Management/Matrix Cycle Manager/COMP Task - Update LT - bc1" /begin SUB_GROUP S69_Local_Time_Update /end SUB_GROUP /end GROUP
/begin GROUP S41_COMP_Task___Vote_Decision "HANcoder_E407_GTSync_v5/HANcoder STM32 Target - E407-STM32 algorithm/Global Ticks Increment/CAN Management/Matrix Cycle Manager/COMP Task - Vote Decision" /begin SUB_GROUP S70_Vote_Decision /end SUB_GROUP /end GROUP
/begin GROUP S41_Matrix_Cycle_Observation_DEBUG "HANcoder_E407_GTSync_v5/HANcoder STM32 Target - E407-STM32 algorithm/Global Ticks Increment/CAN Management/Matrix Cycle Manager/Matrix_Cycle_Observation_DEBUG"
 /begin REF_MEASUREMENT Board_1_error_counter_DEBUG Board_2_error_counter_DEBUG Board_3_error_counter_DEBUG Master_ID_DEBUG Role_ID_DEBUG new_msg_ready_s received_LT_Board_1_DEBUG received_LT_Board_2_DEBUG received_LT_Board_3_DEBUG rx_state_s sync_processed_s time_difference_sync_DEBUG time_difference_vote_1_DEBUG time_difference_vote_2_DEBUG time_difference_vote_3_DEBUG votes_Board_1_DEBUG votes_Board_2_DEBUG votes_Board_3_DEBUG /end REF_MEASUREMENT
/end GROUP
/begin GROUP S45_Initializaton_Observation_DEBUG "HANcoder_E407_GTSync_v5/HANcoder STM32 Target - E407-STM32 algorithm/Global Ticks Increment/CAN Management/Initialization/Delay/Initializaton_Observation_DEBUG"
 /begin REF_MEASUREMENT New_Msg_Rx_DEBUG basic_cycle_DEBUG delay_counter_DEBUG initialization_flag_DEBUG initialization_timeout_DEBUG /end REF_MEASUREMENT
/end GROUP
/begin GROUP S46_Global_Time_Initialization_Slave "HANcoder_E407_GTSync_v5/HANcoder STM32 Target - E407-STM32 algorithm/Global Ticks Increment/CAN Management/Initialization/RoleID and Global Time init/Global Time Initialization Slave" /begin SUB_GROUP S49_UINT8_to_UINT16 /end SUB_GROUP
 /begin REF_MEASUREMENT CAN1_Message_Header_s CAN1_received_basic_cycle CAN1_received_local_time CAN1_received_local_time_1 CAN1_received_local_time_2 CAN1_received_message_1 CAN1_received_message_2 CAN1_received_message_3 CAN1_received_message_4 /end REF_MEASUREMENT
/end GROUP
/begin GROUP S53_Sync_Msg "HANcoder_E407_GTSync_v5/HANcoder STM32 Target - E407-STM32 algorithm/Global Ticks Increment/CAN Management/Matrix Cycle Manager/COMM Task - Sync BC0/Sync Msg" /begin REF_MEASUREMENT TX_SYNC_BC_CAN1_s TX_SYNC_HDR_CAN1_s TX_SYNC_LT_CAN1_s /end REF_MEASUREMENT /end GROUP
/begin GROUP S54_Sync_Msg "HANcoder_E407_GTSync_v5/HANcoder STM32 Target - E407-STM32 algorithm/Global Ticks Increment/CAN Management/Matrix Cycle Manager/COMM Task - Sync BC1/Sync Msg"
 /begin REF_MEASUREMENT TX_SYNC_BC1_CAN1_s TX_SYNC_BC1_CAN2_s TX_SYNC_HDR1_CAN1_s TX_SYNC_HDR1_CAN2_s TX_SYNC_LT1_CAN1_s TX_SYNC_LT1_CAN2_s /end REF_MEASUREMENT
/end GROUP
/begin GROUP S58_Timeout_and_Board_error_counter "HANcoder_E407_GTSync_v5/HANcoder STM32 Target - E407-STM32 algorithm/Global Ticks Increment/CAN Management/Matrix Cycle Manager/COMP Task - Check Timeouts/Timeout and Board error counter"
 /begin SUB_GROUP S111_Timeout_Counter_1_DEBUG S111_Timeout_Counter_2_DEBUG S111_Timeout_Counter_3_DEBUG /end SUB_GROUP
 /begin REF_MEASUREMENT Timeout_Board1 Timeout_Board2 Timeout_Board3 Timeout_Master1 Timeout_Master2 Timeout_Master3 /end REF_MEASUREMENT
/end GROUP
/begin GROUP S59_New_Master "HANcoder_E407_GTSync_v5/HANcoder STM32 Target - E407-STM32 algorithm/Global Ticks Increment/CAN Management/Matrix Cycle Manager/COMP Task - New Master/New Master" /begin SUB_GROUP S115_Votes_recount_to_choose_Master /end SUB_GROUP /begin REF_MEASUREMENT Role_ID_s /end REF_MEASUREMENT /end GROUP
/begin GROUP S63_Process_Messages "HANcoder_E407_GTSync_v5/HANcoder STM32 Target - E407-STM32 algorithm/Global Ticks Increment/CAN Management/Matrix Cycle Manager/COMP Task - Rx_Sync_Check/Process_Messages"
 /begin SUB_GROUP S121_Demux_message_CAN1_and_check_coherence S121_Demux_message_CAN2_and_check_coherence /end SUB_GROUP
 /begin REF_MEASUREMENT Desync_Sync_bc0_s new_msg_Rx_Sync_s /end REF_MEASUREMENT
/end GROUP
/begin GROUP S64_Process_Messages "HANcoder_E407_GTSync_v5/HANcoder STM32 Target - E407-STM32 algorithm/Global Ticks Increment/CAN Management/Matrix Cycle Manager/COMP Task - Rx_Sync_Check - bc1/Process_Messages"
 /begin SUB_GROUP S130_Demux_message_CAN1_and_check_coherence S130_Demux_message_CAN2_and_check_coherence /end SUB_GROUP
 /begin REF_MEASUREMENT Desync_Sync_bc1_s /end REF_MEASUREMENT
/end GROUP
/begin GROUP S65_Process_Messages1 "HANcoder_E407_GTSync_v5/HANcoder STM32 Target - E407-STM32 algorithm/Global Ticks Increment/CAN Management/Matrix Cycle Manager/COMP Task - Rx_Vote1_Check/Process_Messages1" /begin SUB_GROUP S139_Demux_message_CAN2_and_check_coherence /end SUB_GROUP /begin REF_MEASUREMENT Desync_Vote1_s new_msg_Rx_Vote1_s /end REF_MEASUREMENT /end GROUP
/begin GROUP S66_Process_Messages1 "HANcoder_E407_GTSync_v5/HANcoder STM32 Target - E407-STM32 algorithm/Global Ticks Increment/CAN Management/Matrix Cycle Manager/COMP Task - Rx_Vote2_Check/Process_Messages1" /begin SUB_GROUP S148_Demux_message_CAN2_and_check_coherence /end SUB_GROUP /begin REF_MEASUREMENT Desync_Vote2_s new_msg_Rx_Vote2_s /end REF_MEASUREMENT /end GROUP
/begin GROUP S67_Process_Messages1 "HANcoder_E407_GTSync_v5/HANcoder STM32 Target - E407-STM32 algorithm/Global Ticks Increment/CAN Management/Matrix Cycle Manager/COMP Task - Rx_Vote3_Check/Process_Messages1" /begin SUB_GROUP S157_Demux_message_CAN2_and_check_coherence /end SUB_GROUP /begin REF_MEASUREMENT Desync_Vote3_s new_msg_Rx_Vote3_s /end REF_MEASUREMENT /end GROUP
/begin GROUP S68_Local_Time_Update "HANcoder_E407_GTSync_v5/HANcoder STM32 Target - E407-STM32 algorithm/Global Ticks Increment/CAN Management/Matrix Cycle Manager/COMP Task - Update LT/Local Time Update" /begin SUB_GROUP S166_Desync_Negative /end SUB_GROUP /begin REF_MEASUREMENT LT_Update_Counter_bc0_s /end REF_MEASUREMENT /end GROUP
/begin GROUP S69_Local_Time_Update "HANcoder_E407_GTSync_v5/HANcoder STM32 Target - E407-STM32 algorithm/Global Ticks Increment/CAN Management/Matrix Cycle Manager/COMP Task - Update LT - bc1/Local Time Update" /begin REF_MEASUREMENT LT_Update_Counter_bc1_s RX_LT_Master_bc1_s /end REF_MEASUREMENT /end GROUP
/begin GROUP S70_Vote_Decision "HANcoder_E407_GTSync_v5/HANcoder STM32 Target - E407-STM32 algorithm/Global Ticks Increment/CAN Management/Matrix Cycle Manager/COMP Task - Vote Decision/Vote Decision" /begin REF_MEASUREMENT Vote_s /end REF_MEASUREMENT /end GROUP
/begin GROUP S49_UINT8_to_UINT16 "HANcoder_E407_GTSync_v5/HANcoder STM32 Target - E407-STM32 algorithm/Global Ticks Increment/CAN Management/Initialization/RoleID and Global Time init/Global Time Initialization Slave/UINT8 to UINT16" /begin REF_MEASUREMENT CAN1_received_local_time_update /end REF_MEASUREMENT /end GROUP
/begin GROUP S111_Timeout_Counter_1_DEBUG "HANcoder_E407_GTSync_v5/HANcoder STM32 Target - E407-STM32 algorithm/Global Ticks Increment/CAN Management/Matrix Cycle Manager/COMP Task - Check Timeouts/Timeout and Board error counter/Timeout Counter 1 DEBUG" /begin REF_MEASUREMENT TM1_timeout_counter_s /end REF_MEASUREMENT /end GROUP
/begin GROUP S111_Timeout_Counter_2_DEBUG "HANcoder_E407_GTSync_v5/HANcoder STM32 Target - E407-STM32 algorithm/Global Ticks Increment/CAN Management/Matrix Cycle Manager/COMP Task - Check Timeouts/Timeout and Board error counter/Timeout Counter 2 DEBUG" /begin REF_MEASUREMENT TM2_timeout_counter_s /end REF_MEASUREMENT /end GROUP
/begin GROUP S111_Timeout_Counter_3_DEBUG "HANcoder_E407_GTSync_v5/HANcoder STM32 Target - E407-STM32 algorithm/Global Ticks Increment/CAN Management/Matrix Cycle Manager/COMP Task - Check Timeouts/Timeout and Board error counter/Timeout Counter 3 DEBUG" /begin REF_MEASUREMENT TM3_timeout_counter_s /end REF_MEASUREMENT /end GROUP
/begin GROUP S115_Votes_recount_to_choose_Master "HANcoder_E407_GTSync_v5/HANcoder STM32 Target - E407-STM32 algorithm/Global Ticks Increment/CAN Management/Matrix Cycle Manager/COMP Task - New Master/New Master/Votes recount to choose Master" /begin REF_MEASUREMENT Master_ID_s votes_board1_s votes_board2_s votes_board3_s /end REF_MEASUREMENT /end GROUP
/begin GROUP S121_Demux_message_CAN1_and_check_coherence "HANcoder_E407_GTSync_v5/HANcoder STM32 Target - E407-STM32 algorithm/Global Ticks Increment/CAN Management/Matrix Cycle Manager/COMP Task - Rx_Sync_Check/Process_Messages/Demux message CAN1 and check coherence"
 /begin REF_MEASUREMENT RX_SYNC_BC_CAN1_s RX_SYNC_HDR_CAN1_s RX_SYNC_LT_CAN1_s expected_bc_Sync_CAN1_s expected_hdr_Sync_CAN1_s expected_lt_Sync_CAN1_s /end REF_MEASUREMENT
/end GROUP
/begin GROUP S121_Demux_message_CAN2_and_check_coherence "HANcoder_E407_GTSync_v5/HANcoder STM32 Target - E407-STM32 algorithm/Global Ticks Increment/CAN Management/Matrix Cycle Manager/COMP Task - Rx_Sync_Check/Process_Messages/Demux message CAN2 and check coherence"
 /begin REF_MEASUREMENT RX_SYNC_BC_CAN2_s RX_SYNC_HDR_CAN2_s RX_SYNC_LT_CAN2_s expected_bc_Syn_CAN2_s expected_hdr_Sync_CAN2_s expected_lt_Sync_CAN2_s /end REF_MEASUREMENT
/end GROUP
/begin GROUP S130_Demux_message_CAN1_and_check_coherence "HANcoder_E407_GTSync_v5/HANcoder STM32 Target - E407-STM32 algorithm/Global Ticks Increment/CAN Management/Matrix Cycle Manager/COMP Task - Rx_Sync_Check - bc1/Process_Messages/Demux message CAN1 and check coherence"
 /begin REF_MEASUREMENT RX_SYNC_BC1_CAN1_s RX_SYNC_HDR1_CAN1_s RX_SYNC_LT1_CAN1_s expected_bc1_Sync_CAN1_s expected_hdr1_Sync_CAN1_s expected_lt1_Sync_CAN1_s /end REF_MEASUREMENT
/end GROUP
/begin GROUP S130_Demux_message_CAN2_and_check_coherence "HANcoder_E407_GTSync_v5/HANcoder STM32 Target - E407-STM32 algorithm/Global Ticks Increment/CAN Management/Matrix Cycle Manager/COMP Task - Rx_Sync_Check - bc1/Process_Messages/Demux message CAN2 and check coherence"
 /begin REF_MEASUREMENT RX_SYNC_BC1_CAN2_s RX_SYNC_HDR1_CAN2_s RX_SYNC_LT1_CAN2_s expected_bc1_Sync_CAN2_s expected_hdr1_Sync_CAN2_s expected_lt1_Sync_CAN2_s /end REF_MEASUREMENT
/end GROUP
/begin GROUP S139_Demux_message_CAN2_and_check_coherence "HANcoder_E407_GTSync_v5/HANcoder STM32 Target - E407-STM32 algorithm/Global Ticks Increment/CAN Management/Matrix Cycle Manager/COMP Task - Rx_Vote1_Check/Process_Messages1/Demux message CAN2 and check coherence" /begin REF_MEASUREMENT expected_bc_Vote1_CAN2_s expected_lt_Vote1_CAN2_s /end REF_MEASUREMENT /end GROUP
/begin GROUP S148_Demux_message_CAN2_and_check_coherence "HANcoder_E407_GTSync_v5/HANcoder STM32 Target - E407-STM32 algorithm/Global Ticks Increment/CAN Management/Matrix Cycle Manager/COMP Task - Rx_Vote2_Check/Process_Messages1/Demux message CAN2 and check coherence" /begin REF_MEASUREMENT expected_bc_Vote2_CAN2_s expected_lt_Vote2_CAN2_s /end REF_MEASUREMENT /end GROUP
/begin GROUP S157_Demux_message_CAN2_and_check_coherence "HANcoder_E407_GTSync_v5/HANcoder STM32 Target - E407-STM32 algorithm/Global Ticks Increment/CAN Management/Matrix Cycle Manager/COMP Task - Rx_Vote3_Check/Process_Messages1/Demux message CAN2 and check coherence" /begin REF_MEASUREMENT expected_bc_Vote3_CAN2_s expected_lt_Vote3_CAN2_s /end REF_MEASUREMENT /end GROUP
/begin GROUP S166_Desync_Negative "HANcoder_E407_GTSync_v5/HANcoder STM32 Target - E407-STM32 algorithm/Global Ticks Increment/CAN Management/Matrix Cycle Manager/COMP Task - Update LT/Local Time Update/Desync_Negative" /begin REF_MEASUREMENT RX_LT_Master_bc0_s /end REF_MEASUREMENT /end GROUP
/end MODULE
/end PROJECT
/* (add any file trailer comments here) */
/* EOF HANcoder_E407_GTSync_v5.a2l */
