/******************************************************************************
* ASAP2 file: HANcoder_E407_GTSync_v6.a2l
* Academic License - for use in teaching, academic research, and meeting
* course requirements at degree granting institutions only. Not for
* government, commercial, or other organizational use.
* Code generation for model "HANcoder_E407_GTSync_v6".
* Model version : 1.462
* Simulink Coder version : 9.0 (R2018b) 24-May-2018
* C source code generated on : Fri Dec 17 08:14:28 2021
* Target selection: ert.tlc
* Embedded hardware selection: Generic->32-bit Embedded Processor
* Code generation objectives: Unspecified
* Validation result: Not run
* (add additional file header information here)
******************************************************************************/ ASAP2_VERSION 1 31
/* Version 1.31 */
/begin PROJECT ProjectName "HANcoder_E407_GTSync_v6_softwareID_v1_171221_081402"
/begin HEADER "Header Comments go here" /end HEADER
/begin MODULE ModuleName "Module Comment Goes Here"
/begin MOD_PAR "MOD PAR Comment Goes Here" /end MOD_PAR
/begin MOD_COMMON "Mod Common Comment Here" BYTE_ORDER MSB_LAST /end MOD_COMMON
/begin RECORD_LAYOUT Scalar_BOOLEAN FNC_VALUES 1 UBYTE COLUMN_DIR DIRECT /end RECORD_LAYOUT
/begin RECORD_LAYOUT Scalar_UBYTE FNC_VALUES 1 UBYTE COLUMN_DIR DIRECT /end RECORD_LAYOUT
/begin RECORD_LAYOUT Scalar_BYTE FNC_VALUES 1 SBYTE COLUMN_DIR DIRECT /end RECORD_LAYOUT
/begin RECORD_LAYOUT Scalar_UWORD FNC_VALUES 1 UWORD COLUMN_DIR DIRECT /end RECORD_LAYOUT
/begin RECORD_LAYOUT Scalar_SWORD FNC_VALUES 1 SWORD COLUMN_DIR DIRECT /end RECORD_LAYOUT
/begin RECORD_LAYOUT Scalar_ULONG FNC_VALUES 1 ULONG COLUMN_DIR DIRECT /end RECORD_LAYOUT
/begin RECORD_LAYOUT Scalar_LONG FNC_VALUES 1 SLONG COLUMN_DIR DIRECT /end RECORD_LAYOUT
/begin RECORD_LAYOUT Scalar_FLOAT32_IEEE FNC_VALUES 1 FLOAT32_IEEE COLUMN_DIR DIRECT /end RECORD_LAYOUT
/begin RECORD_LAYOUT Scalar_FLOAT64_IEEE FNC_VALUES 1 FLOAT64_IEEE COLUMN_DIR DIRECT /end RECORD_LAYOUT
/begin RECORD_LAYOUT Lookup1D_BYTE FNC_VALUES 1 SBYTE COLUMN_DIR DIRECT /end RECORD_LAYOUT
/begin RECORD_LAYOUT Lookup1D_X_BYTE AXIS_PTS_X 1 SBYTE INDEX_INCR DIRECT /end RECORD_LAYOUT
/begin RECORD_LAYOUT Lookup1D_UBYTE FNC_VALUES 1 UBYTE COLUMN_DIR DIRECT /end RECORD_LAYOUT
/begin RECORD_LAYOUT Lookup1D_X_UBYTE AXIS_PTS_X 1 UBYTE INDEX_INCR DIRECT /end RECORD_LAYOUT
/begin RECORD_LAYOUT Lookup1D_UWORD FNC_VALUES 1 UWORD COLUMN_DIR DIRECT /end RECORD_LAYOUT
/begin RECORD_LAYOUT Lookup1D_X_UWORD AXIS_PTS_X 1 UWORD INDEX_INCR DIRECT /end RECORD_LAYOUT
/begin RECORD_LAYOUT Lookup1D_WORD FNC_VALUES 1 SWORD COLUMN_DIR DIRECT /end RECORD_LAYOUT
/begin RECORD_LAYOUT Lookup1D_X_WORD AXIS_PTS_X 1 SWORD INDEX_INCR DIRECT /end RECORD_LAYOUT
/begin RECORD_LAYOUT Lookup1D_ULONG FNC_VALUES 1 ULONG COLUMN_DIR DIRECT /end RECORD_LAYOUT
/begin RECORD_LAYOUT Lookup1D_X_ULONG AXIS_PTS_X 1 ULONG INDEX_INCR DIRECT /end RECORD_LAYOUT
/begin RECORD_LAYOUT Lookup1D_SLONG FNC_VALUES 1 SLONG COLUMN_DIR DIRECT /end RECORD_LAYOUT
/begin RECORD_LAYOUT Lookup1D_X_LONG AXIS_PTS_X 1 SLONG INDEX_INCR DIRECT /end RECORD_LAYOUT
/begin RECORD_LAYOUT Lookup1D_FLOAT32_IEEE FNC_VALUES 1 FLOAT32_IEEE COLUMN_DIR DIRECT /end RECORD_LAYOUT
/begin RECORD_LAYOUT Lookup1D_X_FLOAT32_IEEE AXIS_PTS_X 1 FLOAT32_IEEE INDEX_INCR DIRECT /end RECORD_LAYOUT
/begin RECORD_LAYOUT Lookup1D_FLOAT64_IEEE FNC_VALUES 1 FLOAT64_IEEE COLUMN_DIR DIRECT /end RECORD_LAYOUT
/begin RECORD_LAYOUT Lookup1D_X_FLOAT64_IEEE AXIS_PTS_X 1 FLOAT64_IEEE INDEX_INCR DIRECT /end RECORD_LAYOUT
/begin RECORD_LAYOUT Lookup2D_UBYTE FNC_VALUES 1 UBYTE COLUMN_DIR DIRECT /end RECORD_LAYOUT
/begin RECORD_LAYOUT Lookup2D_X_UBYTE AXIS_PTS_X 1 UBYTE INDEX_INCR DIRECT /end RECORD_LAYOUT
/begin RECORD_LAYOUT Lookup2D_BYTE FNC_VALUES 1 SBYTE COLUMN_DIR DIRECT /end RECORD_LAYOUT
/begin RECORD_LAYOUT Lookup2D_X_BYTE AXIS_PTS_X 1 SBYTE INDEX_INCR DIRECT /end RECORD_LAYOUT
/begin RECORD_LAYOUT Lookup2D_UWORD FNC_VALUES 1 UWORD COLUMN_DIR DIRECT /end RECORD_LAYOUT
/begin RECORD_LAYOUT Lookup2D_X_UWORD AXIS_PTS_X 1 UWORD INDEX_INCR DIRECT /end RECORD_LAYOUT
/begin RECORD_LAYOUT Lookup2D_WORD FNC_VALUES 1 SWORD COLUMN_DIR DIRECT /end RECORD_LAYOUT
/begin RECORD_LAYOUT Lookup2D_X_WORD AXIS_PTS_X 1 SWORD INDEX_INCR DIRECT /end RECORD_LAYOUT
/begin RECORD_LAYOUT Lookup2D_ULONG FNC_VALUES 1 ULONG COLUMN_DIR DIRECT /end RECORD_LAYOUT
/begin RECORD_LAYOUT Lookup2D_X_ULONG AXIS_PTS_X 1 ULONG INDEX_INCR DIRECT /end RECORD_LAYOUT
/begin RECORD_LAYOUT Lookup2D_LONG FNC_VALUES 1 SLONG COLUMN_DIR DIRECT /end RECORD_LAYOUT
/begin RECORD_LAYOUT Lookup2D_X_LONG AXIS_PTS_X 1 SLONG INDEX_INCR DIRECT /end RECORD_LAYOUT
/begin RECORD_LAYOUT Lookup2D_FLOAT32_IEEE FNC_VALUES 1 FLOAT32_IEEE COLUMN_DIR DIRECT /end RECORD_LAYOUT
/begin RECORD_LAYOUT Lookup2D_X_FLOAT32_IEEE AXIS_PTS_X 1 FLOAT32_IEEE INDEX_INCR DIRECT /end RECORD_LAYOUT
/begin RECORD_LAYOUT Lookup2D_FLOAT64_IEEE FNC_VALUES 1 FLOAT64_IEEE COLUMN_DIR DIRECT /end RECORD_LAYOUT
/begin RECORD_LAYOUT Lookup2D_X_FLOAT64_IEEE AXIS_PTS_X 1 FLOAT64_IEEE INDEX_INCR DIRECT /end RECORD_LAYOUT
/begin CHARACTERISTIC HANtuneOverride /* Long Identifier */ "" /* Type */ VALUE /* ECU Address */ 200005b4 /* Record Layout */ Scalar_BOOLEAN /* Maximum Difference */ 0 /* Conversion Method */ HANcoder_E407_GTSync_v6_CM_boolean /* Lower Limit */ 0 /* Upper Limit */ 1 /end CHARACTERISTIC
/begin MEASUREMENT simulation_time "" FLOAT64_IEEE HANcoder_E407_GTSync_v6_CM_double 0 0 -1.7E+308 1.7E+308 ECU_ADDRESS 20007cd0 /end MEASUREMENT
/begin MEASUREMENT Board_ID_s "" FLOAT64_IEEE HANcoder_E407_GTSync_v6_CM_double 0 0 -1.7E+308 1.7E+308 ECU_ADDRESS 20007be0 /end MEASUREMENT
/begin MEASUREMENT SI_FreeHeap "" ULONG HANcoder_E407_GTSync_v6_CM_uint32 0 0 0 4294967295 ECU_ADDRESS 20007c34 /end MEASUREMENT
/begin MEASUREMENT SI_FreeStack "" ULONG HANcoder_E407_GTSync_v6_CM_uint32 0 0 0 4294967295 ECU_ADDRESS 20007cf8 /end MEASUREMENT
/begin MEASUREMENT local_ticks_interrupt "" UWORD HANcoder_E407_GTSync_v6_CM_uint16 0 0 0 65535 ECU_ADDRESS 20007e86 /end MEASUREMENT
/begin MEASUREMENT SI_CPUload "" UBYTE HANcoder_E407_GTSync_v6_CM_uint8 0 0 0 255 ECU_ADDRESS 20007e2a /end MEASUREMENT
/begin MEASUREMENT LedValue "" UBYTE HANcoder_E407_GTSync_v6_CM_boolean 0 0 0 1 ECU_ADDRESS 20007c58 /end MEASUREMENT
/begin MEASUREMENT Master_ID_s "" FLOAT64_IEEE HANcoder_E407_GTSync_v6_CM_double 0 0 -1.7E+308 1.7E+308 ECU_ADDRESS 20007c50 /end MEASUREMENT
/begin MEASUREMENT Role_ID_s "" FLOAT64_IEEE HANcoder_E407_GTSync_v6_CM_double 0 0 -1.7E+308 1.7E+308 ECU_ADDRESS 20007a60 /end MEASUREMENT
/begin MEASUREMENT votes_Board_1_DEBUG "" FLOAT64_IEEE HANcoder_E407_GTSync_v6_CM_double 0 0 -1.7E+308 1.7E+308 ECU_ADDRESS 20007e70 /end MEASUREMENT
/begin MEASUREMENT votes_Board_2_DEBUG "" FLOAT64_IEEE HANcoder_E407_GTSync_v6_CM_double 0 0 -1.7E+308 1.7E+308 ECU_ADDRESS 20007e30 /end MEASUREMENT
/begin MEASUREMENT votes_Board_3_DEBUG "" FLOAT64_IEEE HANcoder_E407_GTSync_v6_CM_double 0 0 -1.7E+308 1.7E+308 ECU_ADDRESS 20007bf0 /end MEASUREMENT
/begin MEASUREMENT Board_1_error_counter_s "" FLOAT64_IEEE HANcoder_E407_GTSync_v6_CM_double 0 0 -1.7E+308 1.7E+308 ECU_ADDRESS 20007c28 /end MEASUREMENT
/begin MEASUREMENT Board_2_error_counter_s "" FLOAT64_IEEE HANcoder_E407_GTSync_v6_CM_double 0 0 -1.7E+308 1.7E+308 ECU_ADDRESS 20007a80 /end MEASUREMENT
/begin MEASUREMENT Board_3_error_counter_s "" FLOAT64_IEEE HANcoder_E407_GTSync_v6_CM_double 0 0 -1.7E+308 1.7E+308 ECU_ADDRESS 20007e08 /end MEASUREMENT
/begin MEASUREMENT msg_count_DEBUG_s "" FLOAT64_IEEE HANcoder_E407_GTSync_v6_CM_double 0 0 -1.7E+308 1.7E+308 ECU_ADDRESS 20007c08 /end MEASUREMENT
/begin MEASUREMENT expected_LT_vote3_CAN1_s "" FLOAT64_IEEE HANcoder_E407_GTSync_v6_CM_double 0 0 -1.7E+308 1.7E+308 ECU_ADDRESS 20007e50 /end MEASUREMENT
/begin MEASUREMENT expected_LT_vote3_CAN2_s "" FLOAT64_IEEE HANcoder_E407_GTSync_v6_CM_double 0 0 -1.7E+308 1.7E+308 ECU_ADDRESS 20007c70 /end MEASUREMENT
/begin MEASUREMENT Desync_Vote3_s "" FLOAT64_IEEE HANcoder_E407_GTSync_v6_CM_double 0 0 -1.7E+308 1.7E+308 ECU_ADDRESS 20007a70 /end MEASUREMENT
/begin MEASUREMENT Rx_temporal_vote3_CAN2 "" FLOAT64_IEEE HANcoder_E407_GTSync_v6_CM_double 0 0 -1.7E+308 1.7E+308 ECU_ADDRESS 20007ca8 /end MEASUREMENT
/begin MEASUREMENT Rx_temporal_vote3_CAN1 "" FLOAT64_IEEE HANcoder_E407_GTSync_v6_CM_double 0 0 -1.7E+308 1.7E+308 ECU_ADDRESS 20007e40 /end MEASUREMENT
/begin MEASUREMENT expected_LT_vote2_CAN1_s "" FLOAT64_IEEE HANcoder_E407_GTSync_v6_CM_double 0 0 -1.7E+308 1.7E+308 ECU_ADDRESS 20007be8 /end MEASUREMENT
/begin MEASUREMENT expected_LT_vote2_CAN2_s "" FLOAT64_IEEE HANcoder_E407_GTSync_v6_CM_double 0 0 -1.7E+308 1.7E+308 ECU_ADDRESS 20007aa8 /end MEASUREMENT
/begin MEASUREMENT Desync_Vote2_s "" FLOAT64_IEEE HANcoder_E407_GTSync_v6_CM_double 0 0 -1.7E+308 1.7E+308 ECU_ADDRESS 20007a68 /end MEASUREMENT
/begin MEASUREMENT Rx_temporal_vote2_CAN2 "" FLOAT64_IEEE HANcoder_E407_GTSync_v6_CM_double 0 0 -1.7E+308 1.7E+308 ECU_ADDRESS 20007cb0 /end MEASUREMENT
/begin MEASUREMENT Rx_temporal_vote2_CAN1 "" FLOAT64_IEEE HANcoder_E407_GTSync_v6_CM_double 0 0 -1.7E+308 1.7E+308 ECU_ADDRESS 20007e68 /end MEASUREMENT
/begin MEASUREMENT expected_LT_vote1_CAN1_s "" FLOAT64_IEEE HANcoder_E407_GTSync_v6_CM_double 0 0 -1.7E+308 1.7E+308 ECU_ADDRESS 20007ce0 /end MEASUREMENT
/begin MEASUREMENT expected_LT_vote1_CAN2_s "" FLOAT64_IEEE HANcoder_E407_GTSync_v6_CM_double 0 0 -1.7E+308 1.7E+308 ECU_ADDRESS 20007cc0 /end MEASUREMENT
/begin MEASUREMENT Desync_Vote1_s "" FLOAT64_IEEE HANcoder_E407_GTSync_v6_CM_double 0 0 -1.7E+308 1.7E+308 ECU_ADDRESS 20007e18 /end MEASUREMENT
/begin MEASUREMENT Rx_temporal_vote1_CAN2 "" FLOAT64_IEEE HANcoder_E407_GTSync_v6_CM_double 0 0 -1.7E+308 1.7E+308 ECU_ADDRESS 20007c60 /end MEASUREMENT
/begin MEASUREMENT Rx_temporal_vote1_CAN1 "" FLOAT64_IEEE HANcoder_E407_GTSync_v6_CM_double 0 0 -1.7E+308 1.7E+308 ECU_ADDRESS 20007c18 /end MEASUREMENT
/begin MEASUREMENT Desync_Sync_bc1_s "" FLOAT64_IEEE HANcoder_E407_GTSync_v6_CM_double 0 0 -1.7E+308 1.7E+308 ECU_ADDRESS 20007c98 /end MEASUREMENT
/begin MEASUREMENT Desync_Sync_bc0_s "" FLOAT64_IEEE HANcoder_E407_GTSync_v6_CM_double 0 0 -1.7E+308 1.7E+308 ECU_ADDRESS 20007a88 /end MEASUREMENT
/begin MEASUREMENT TM1_timeout_counter_s "" FLOAT64_IEEE HANcoder_E407_GTSync_v6_CM_double 0 0 -1.7E+308 1.7E+308 ECU_ADDRESS 20007bf8 /end MEASUREMENT
/begin MEASUREMENT TM2_timeout_counter_s "" FLOAT64_IEEE HANcoder_E407_GTSync_v6_CM_double 0 0 -1.7E+308 1.7E+308 ECU_ADDRESS 20007cf0 /end MEASUREMENT
/begin MEASUREMENT TM3_timeout_counter_s "" FLOAT64_IEEE HANcoder_E407_GTSync_v6_CM_double 0 0 -1.7E+308 1.7E+308 ECU_ADDRESS 20007c40 /end MEASUREMENT
/begin MEASUREMENT local_time_s "" UWORD HANcoder_E407_GTSync_v6_CM_uint16 0 0 0 65535 ECU_ADDRESS 20007e2c /end MEASUREMENT
/begin MEASUREMENT Rx_msg_ticks_vote3_CAN1_s "" UWORD HANcoder_E407_GTSync_v6_CM_uint16 0 0 0 65535 ECU_ADDRESS 20007e80 /end MEASUREMENT
/begin MEASUREMENT Rx_msg_ticks_vote3_CAN2_s "" UWORD HANcoder_E407_GTSync_v6_CM_uint16 0 0 0 65535 ECU_ADDRESS 20007cc8 /end MEASUREMENT
/begin MEASUREMENT Rx_msg_ticks_vote2_CAN1_s "" UWORD HANcoder_E407_GTSync_v6_CM_uint16 0 0 0 65535 ECU_ADDRESS 20007a5c /end MEASUREMENT
/begin MEASUREMENT Rx_msg_ticks_vote2_CAN2_s "" UWORD HANcoder_E407_GTSync_v6_CM_uint16 0 0 0 65535 ECU_ADDRESS 20007c8c /end MEASUREMENT
/begin MEASUREMENT Rx_msg_ticks_vote1_CAN1_s "" UWORD HANcoder_E407_GTSync_v6_CM_uint16 0 0 0 65535 ECU_ADDRESS 20007ce8 /end MEASUREMENT
/begin MEASUREMENT Rx_msg_ticks_vote1_CAN2_s "" UWORD HANcoder_E407_GTSync_v6_CM_uint16 0 0 0 65535 ECU_ADDRESS 20007c5e /end MEASUREMENT
/begin MEASUREMENT Rx_init_LT "" UWORD HANcoder_E407_GTSync_v6_CM_uint16 0 0 0 65535 ECU_ADDRESS 20007ca6 /end MEASUREMENT
/begin MEASUREMENT bacic_cycle_s "" UBYTE HANcoder_E407_GTSync_v6_CM_uint8 0 0 0 255 ECU_ADDRESS 20007c20 /end MEASUREMENT
/begin MEASUREMENT Vote_s "" UBYTE HANcoder_E407_GTSync_v6_CM_uint8 0 0 0 255 ECU_ADDRESS 20007a58 /end MEASUREMENT
/begin MEASUREMENT Rx_id_vote3_CAN2 "" UBYTE HANcoder_E407_GTSync_v6_CM_uint8 0 0 0 255 ECU_ADDRESS 20007e89 /end MEASUREMENT
/begin MEASUREMENT Rx_mc_vote3_CAN2 "" UBYTE HANcoder_E407_GTSync_v6_CM_uint8 0 0 0 255 ECU_ADDRESS 20007aa0 /end MEASUREMENT
/begin MEASUREMENT Rx_bc_vote3_CAN2 "" UBYTE HANcoder_E407_GTSync_v6_CM_uint8 0 0 0 255 ECU_ADDRESS 20007e20 /end MEASUREMENT
/begin MEASUREMENT Rx_id_vote3_CAN1 "" UBYTE HANcoder_E407_GTSync_v6_CM_uint8 0 0 0 255 ECU_ADDRESS 20007e60 /end MEASUREMENT
/begin MEASUREMENT Rx_mc_vote3_CAN1 "" UBYTE HANcoder_E407_GTSync_v6_CM_uint8 0 0 0 255 ECU_ADDRESS 20007e39 /end MEASUREMENT
/begin MEASUREMENT Rx_bc_vote3_CAN1 "" UBYTE HANcoder_E407_GTSync_v6_CM_uint8 0 0 0 255 ECU_ADDRESS 20007a7a /end MEASUREMENT
/begin MEASUREMENT Rx_id_vote2_CAN2 "" UBYTE HANcoder_E407_GTSync_v6_CM_uint8 0 0 0 255 ECU_ADDRESS 20007e00 /end MEASUREMENT
/begin MEASUREMENT Rx_mc_vote2_CAN2 "" UBYTE HANcoder_E407_GTSync_v6_CM_uint8 0 0 0 255 ECU_ADDRESS 20007a5f /end MEASUREMENT
/begin MEASUREMENT Rx_bc_vote2_CAN2 "" UBYTE HANcoder_E407_GTSync_v6_CM_uint8 0 0 0 255 ECU_ADDRESS 20007cca /end MEASUREMENT
/begin MEASUREMENT Rx_id_vote2_CAN1 "" UBYTE HANcoder_E407_GTSync_v6_CM_uint8 0 0 0 255 ECU_ADDRESS 20007a79 /end MEASUREMENT
/begin MEASUREMENT Rx_mc_vote2_CAN1 "" UBYTE HANcoder_E407_GTSync_v6_CM_uint8 0 0 0 255 ECU_ADDRESS 20007c48 /end MEASUREMENT
/begin MEASUREMENT Rx_bc_vote2_CAN1 "" UBYTE HANcoder_E407_GTSync_v6_CM_uint8 0 0 0 255 ECU_ADDRESS 20007e8a /end MEASUREMENT
/begin MEASUREMENT Rx_id_vote1_CAN2 "" UBYTE HANcoder_E407_GTSync_v6_CM_uint8 0 0 0 255 ECU_ADDRESS 20007cd9 /end MEASUREMENT
/begin MEASUREMENT Rx_mc_vote1_CAN2 "" UBYTE HANcoder_E407_GTSync_v6_CM_uint8 0 0 0 255 ECU_ADDRESS 20007c6d /end MEASUREMENT
/begin MEASUREMENT Rx_bc_vote1_CAN2 "" UBYTE HANcoder_E407_GTSync_v6_CM_uint8 0 0 0 255 ECU_ADDRESS 20007c10 /end MEASUREMENT
/begin MEASUREMENT Rx_id_vote1_CAN1 "" UBYTE HANcoder_E407_GTSync_v6_CM_uint8 0 0 0 255 ECU_ADDRESS 20007a59 /end MEASUREMENT
/begin MEASUREMENT Rx_mc_vote1_CAN1 "" UBYTE HANcoder_E407_GTSync_v6_CM_uint8 0 0 0 255 ECU_ADDRESS 20007c89 /end MEASUREMENT
/begin MEASUREMENT Rx_bc_vote1_CAN1 "" UBYTE HANcoder_E407_GTSync_v6_CM_uint8 0 0 0 255 ECU_ADDRESS 20007e84 /end MEASUREMENT
/begin MEASUREMENT Rx_id_sync1_CAN2 "" UBYTE HANcoder_E407_GTSync_v6_CM_uint8 0 0 0 255 ECU_ADDRESS 20007c78 /end MEASUREMENT
/begin MEASUREMENT Rx_mc_sync1_CAN2 "" UBYTE HANcoder_E407_GTSync_v6_CM_uint8 0 0 0 255 ECU_ADDRESS 20007c11 /end MEASUREMENT
/begin MEASUREMENT Rx_bc_sync1_CAN2 "" UBYTE HANcoder_E407_GTSync_v6_CM_uint8 0 0 0 255 ECU_ADDRESS 20007e38 /end MEASUREMENT
/begin MEASUREMENT Rx_id_sync1_CAN1 "" UBYTE HANcoder_E407_GTSync_v6_CM_uint8 0 0 0 255 ECU_ADDRESS 20007cd8 /end MEASUREMENT
/begin MEASUREMENT Rx_mc_sync1_CAN1 "" UBYTE HANcoder_E407_GTSync_v6_CM_uint8 0 0 0 255 ECU_ADDRESS 20007e88 /end MEASUREMENT
/begin MEASUREMENT Rx_bc_sync1_CAN1 "" UBYTE HANcoder_E407_GTSync_v6_CM_uint8 0 0 0 255 ECU_ADDRESS 20007bdc /end MEASUREMENT
/begin MEASUREMENT Rx_id_sync0_CAN2 "" UBYTE HANcoder_E407_GTSync_v6_CM_uint8 0 0 0 255 ECU_ADDRESS 20007a78 /end MEASUREMENT
/begin MEASUREMENT Rx_mc_sync0_CAN2 "" UBYTE HANcoder_E407_GTSync_v6_CM_uint8 0 0 0 255 ECU_ADDRESS 20007c68 /end MEASUREMENT
/begin MEASUREMENT Rx_bc_sync0_CAN2 "" UBYTE HANcoder_E407_GTSync_v6_CM_uint8 0 0 0 255 ECU_ADDRESS 20007cb9 /end MEASUREMENT
/begin MEASUREMENT Rx_id_sync0_CAN1 "" UBYTE HANcoder_E407_GTSync_v6_CM_uint8 0 0 0 255 ECU_ADDRESS 20007c59 /end MEASUREMENT
/begin MEASUREMENT Rx_mc_sync0_CAN1 "" UBYTE HANcoder_E407_GTSync_v6_CM_uint8 0 0 0 255 ECU_ADDRESS 20007a5e /end MEASUREMENT
/begin MEASUREMENT Rx_bc_sync0_CAN1 "" UBYTE HANcoder_E407_GTSync_v6_CM_uint8 0 0 0 255 ECU_ADDRESS 20007cb8 /end MEASUREMENT
/begin MEASUREMENT Rx_init_id "" UBYTE HANcoder_E407_GTSync_v6_CM_uint8 0 0 0 255 ECU_ADDRESS 20007e10 /end MEASUREMENT
/begin MEASUREMENT Rx_init_mc "" UBYTE HANcoder_E407_GTSync_v6_CM_uint8 0 0 0 255 ECU_ADDRESS 20007e29 /end MEASUREMENT
/begin MEASUREMENT Rx_init_bc "" UBYTE HANcoder_E407_GTSync_v6_CM_uint8 0 0 0 255 ECU_ADDRESS 20007c30 /end MEASUREMENT
/begin MEASUREMENT reset_s "" UBYTE HANcoder_E407_GTSync_v6_CM_boolean 0 0 0 1 ECU_ADDRESS 20007ca4 /end MEASUREMENT
/begin MEASUREMENT BC1_sync_processed_s "" UBYTE HANcoder_E407_GTSync_v6_CM_boolean 0 0 0 1 ECU_ADDRESS 20007e28 /end MEASUREMENT
/begin MEASUREMENT BC0_sync_processed_s "" UBYTE HANcoder_E407_GTSync_v6_CM_boolean 0 0 0 1 ECU_ADDRESS 20007a5a /end MEASUREMENT
/begin MEASUREMENT BC0_vote1_processed_s "" UBYTE HANcoder_E407_GTSync_v6_CM_boolean 0 0 0 1 ECU_ADDRESS 20007c79 /end MEASUREMENT
/begin MEASUREMENT BC0_vote2_processed_s "" UBYTE HANcoder_E407_GTSync_v6_CM_boolean 0 0 0 1 ECU_ADDRESS 20007cfc /end MEASUREMENT
/begin MEASUREMENT BC0_vote3_processed_s "" UBYTE HANcoder_E407_GTSync_v6_CM_boolean 0 0 0 1 ECU_ADDRESS 20007c88 /end MEASUREMENT
/begin MEASUREMENT Tx_temporal_msg_CAN2 "" FLOAT64_IEEE HANcoder_E407_GTSync_v6_CM_double 0 0 -1.7E+308 1.7E+308 ECU_ADDRESS 20007c00 /end MEASUREMENT
/begin MEASUREMENT TxCAN2_counter_s "" ULONG HANcoder_E407_GTSync_v6_CM_uint32 0 0 0 4294967295 ECU_ADDRESS 20007ca0 /end MEASUREMENT
/begin MEASUREMENT TxID_CAN2_s "" ULONG HANcoder_E407_GTSync_v6_CM_uint32 0 0 0 4294967295 ECU_ADDRESS 20007a9c /end MEASUREMENT
/begin MEASUREMENT Local_Ticks_Activation_CAN2_send "" UWORD HANcoder_E407_GTSync_v6_CM_uint16 0 0 0 65535 ECU_ADDRESS 20007c5a /end MEASUREMENT
/begin MEASUREMENT FRC_Activation_CAN2_send "" UWORD HANcoder_E407_GTSync_v6_CM_uint16 0 0 0 65535 ECU_ADDRESS 20007c8a /end MEASUREMENT
/begin MEASUREMENT Rx_temporal_msg_CAN2 "" FLOAT64_IEEE HANcoder_E407_GTSync_v6_CM_double 0 0 -1.7E+308 1.7E+308 ECU_ADDRESS 20007e58 /end MEASUREMENT
/begin MEASUREMENT RxCAN2_counter_s "" ULONG HANcoder_E407_GTSync_v6_CM_uint32 0 0 0 4294967295 ECU_ADDRESS 20007c90 /end MEASUREMENT
/begin MEASUREMENT RxID_CAN2_s "" ULONG HANcoder_E407_GTSync_v6_CM_uint32 0 0 0 4294967295 ECU_ADDRESS 20007e48 /end MEASUREMENT
/begin MEASUREMENT Rx_msg_ticks_CAN2 "" UWORD HANcoder_E407_GTSync_v6_CM_uint16 0 0 0 65535 ECU_ADDRESS 20007e82 /end MEASUREMENT
/begin MEASUREMENT Rx_temporal_msg_CAN1 "" FLOAT64_IEEE HANcoder_E407_GTSync_v6_CM_double 0 0 -1.7E+308 1.7E+308 ECU_ADDRESS 20007c80 /end MEASUREMENT
/begin MEASUREMENT RxCAN1_counter_s "" ULONG HANcoder_E407_GTSync_v6_CM_uint32 0 0 0 4294967295 ECU_ADDRESS 20007bd8 /end MEASUREMENT
/begin MEASUREMENT RxID_CAN1_s "" ULONG HANcoder_E407_GTSync_v6_CM_uint32 0 0 0 4294967295 ECU_ADDRESS 20007c4c /end MEASUREMENT
/begin MEASUREMENT Rx_msg_ticks_CAN1 "" UWORD HANcoder_E407_GTSync_v6_CM_uint16 0 0 0 65535 ECU_ADDRESS 20007c4a /end MEASUREMENT
/begin MEASUREMENT Tx_temporal_msg_CAN1 "" FLOAT64_IEEE HANcoder_E407_GTSync_v6_CM_double 0 0 -1.7E+308 1.7E+308 ECU_ADDRESS 20007e78 /end MEASUREMENT
/begin MEASUREMENT TxCAN1_counter_s "" ULONG HANcoder_E407_GTSync_v6_CM_uint32 0 0 0 4294967295 ECU_ADDRESS 20007e24 /end MEASUREMENT
/begin MEASUREMENT TxID_CAN1_s "" ULONG HANcoder_E407_GTSync_v6_CM_uint32 0 0 0 4294967295 ECU_ADDRESS 20007c38 /end MEASUREMENT
/begin MEASUREMENT Local_Ticks_Activation_CAN1_send "" UWORD HANcoder_E407_GTSync_v6_CM_uint16 0 0 0 65535 ECU_ADDRESS 20007bde /end MEASUREMENT
/begin MEASUREMENT FRC_Activation_CAN1_send "" UWORD HANcoder_E407_GTSync_v6_CM_uint16 0 0 0 65535 ECU_ADDRESS 20007c5c /end MEASUREMENT
/begin COMPU_METHOD HANcoder_E407_GTSync_v6_CM_boolean "Q = V" RAT_FUNC "%1.0" "" COEFFS 0 1 0 0 0 1 /end COMPU_METHOD
/begin COMPU_METHOD HANcoder_E407_GTSync_v6_CM_double "Q = V" RAT_FUNC "%15.10" "" COEFFS 0 1 0 0 0 1 /end COMPU_METHOD
/begin COMPU_METHOD HANcoder_E407_GTSync_v6_CM_uint32 "Q = V" RAT_FUNC "%10.0" "" COEFFS 0 1 0 0 0 1 /end COMPU_METHOD
/begin COMPU_METHOD HANcoder_E407_GTSync_v6_CM_uint16 "Q = V" RAT_FUNC "%5.0" "" COEFFS 0 1 0 0 0 1 /end COMPU_METHOD
/begin COMPU_METHOD HANcoder_E407_GTSync_v6_CM_uint8 "Q = V" RAT_FUNC "%3.0" "" COEFFS 0 1 0 0 0 1 /end COMPU_METHOD
/begin GROUP HANcoder_E407_GTSync_v6 "HANcoder_E407_GTSync_v6" /* Root */ ROOT /begin SUB_GROUP Root_HANcoder_STM32_Target___E407_STM32_algorithm /end SUB_GROUP /end GROUP
/begin GROUP Root_HANcoder_STM32_Target___E407_STM32_algorithm "HANcoder_E407_GTSync_v6/HANcoder STM32 Target - E407-STM32 algorithm"
 /begin SUB_GROUP S1_Algorithm S1_Global_Ticks_Increment S1_System_information /end SUB_GROUP
/end GROUP
/begin GROUP S1_Algorithm "HANcoder_E407_GTSync_v6/HANcoder STM32 Target - E407-STM32 algorithm/Algorithm" /begin REF_CHARACTERISTIC HANtuneOverride /end REF_CHARACTERISTIC /begin REF_MEASUREMENT LedValue /end REF_MEASUREMENT /end GROUP
/begin GROUP S1_Global_Ticks_Increment "HANcoder_E407_GTSync_v6/HANcoder STM32 Target - E407-STM32 algorithm/Global Ticks Increment"
 /begin SUB_GROUP S6_CAN1_Recieve S6_CAN1_Send S6_CAN2_Recieve S6_CAN2_Send S6_CAN_Management S6_If_Action_Subsystem S6_Local_Time_generation /end SUB_GROUP
 /begin REF_MEASUREMENT simulation_time /end REF_MEASUREMENT
/end GROUP
/begin GROUP S1_System_information "HANcoder_E407_GTSync_v6/HANcoder STM32 Target - E407-STM32 algorithm/System information" /begin SUB_GROUP S10_Get_CPU_load S10_Get_free_Heap S10_Get_free_Stack /end SUB_GROUP /end GROUP
/begin GROUP S6_CAN_Management "HANcoder_E407_GTSync_v6/HANcoder STM32 Target - E407-STM32 algorithm/Global Ticks Increment/CAN Management" /begin SUB_GROUP S19_Initialization S19_Matrix_Cycle_Manager /end SUB_GROUP /end GROUP
/begin GROUP S6_CAN1_Recieve "HANcoder_E407_GTSync_v6/HANcoder STM32 Target - E407-STM32 algorithm/Global Ticks Increment/CAN1 Recieve" /begin SUB_GROUP S20_Update_message_buffers /end SUB_GROUP /begin REF_MEASUREMENT RxCAN1_counter_s RxID_CAN1_s /end REF_MEASUREMENT /end GROUP
/begin GROUP S6_CAN1_Send "HANcoder_E407_GTSync_v6/HANcoder STM32 Target - E407-STM32 algorithm/Global Ticks Increment/CAN1 Send" /begin SUB_GROUP S21_Get_Free_Running_Counter /end SUB_GROUP
 /begin REF_MEASUREMENT Local_Ticks_Activation_CAN1_send TxCAN1_counter_s TxID_CAN1_s Tx_temporal_msg_CAN1 /end REF_MEASUREMENT
/end GROUP
/begin GROUP S6_CAN2_Recieve "HANcoder_E407_GTSync_v6/HANcoder STM32 Target - E407-STM32 algorithm/Global Ticks Increment/CAN2 Recieve" /begin SUB_GROUP S22_Update_message_buffers /end SUB_GROUP /begin REF_MEASUREMENT RxCAN2_counter_s RxID_CAN2_s /end REF_MEASUREMENT /end GROUP
/begin GROUP S6_CAN2_Send "HANcoder_E407_GTSync_v6/HANcoder STM32 Target - E407-STM32 algorithm/Global Ticks Increment/CAN2 Send" /begin SUB_GROUP S23_Get_Free_Running_Counter /end SUB_GROUP
 /begin REF_MEASUREMENT Local_Ticks_Activation_CAN2_send TxCAN2_counter_s TxID_CAN2_s Tx_temporal_msg_CAN2 /end REF_MEASUREMENT
/end GROUP
/begin GROUP S6_If_Action_Subsystem "HANcoder_E407_GTSync_v6/HANcoder STM32 Target - E407-STM32 algorithm/Global Ticks Increment/If Action Subsystem" /begin REF_MEASUREMENT Board_ID_s /end REF_MEASUREMENT /end GROUP
/begin GROUP S6_Local_Time_generation "HANcoder_E407_GTSync_v6/HANcoder STM32 Target - E407-STM32 algorithm/Global Ticks Increment/Local Time generation" /begin REF_MEASUREMENT local_ticks_interrupt /end REF_MEASUREMENT /end GROUP
/begin GROUP S10_Get_CPU_load "HANcoder_E407_GTSync_v6/HANcoder STM32 Target - E407-STM32 algorithm/System information/Get CPU load" /begin REF_MEASUREMENT SI_CPUload /end REF_MEASUREMENT /end GROUP
/begin GROUP S10_Get_free_Heap "HANcoder_E407_GTSync_v6/HANcoder STM32 Target - E407-STM32 algorithm/System information/Get free Heap" /begin REF_MEASUREMENT SI_FreeHeap /end REF_MEASUREMENT /end GROUP
/begin GROUP S10_Get_free_Stack "HANcoder_E407_GTSync_v6/HANcoder STM32 Target - E407-STM32 algorithm/System information/Get free Stack" /begin REF_MEASUREMENT SI_FreeStack /end REF_MEASUREMENT /end GROUP
/begin GROUP S19_Initialization "HANcoder_E407_GTSync_v6/HANcoder STM32 Target - E407-STM32 algorithm/Global Ticks Increment/CAN Management/Initialization" /begin SUB_GROUP S39_RoleID_and_Global_Time_init /end SUB_GROUP /end GROUP
/begin GROUP S19_Matrix_Cycle_Manager "HANcoder_E407_GTSync_v6/HANcoder STM32 Target - E407-STM32 algorithm/Global Ticks Increment/CAN Management/Matrix Cycle Manager"
 /begin SUB_GROUP S41_COMP_Task___Check_Timeouts S41_COMP_Task___Reset_Board S41_COMP_Task___Rx_Sync_bc0_Check S41_COMP_Task___Rx_Sync_bc1_Check S41_COMP_Task___Rx_Vote1_Check S41_COMP_Task___Rx_Vote2_Check S41_COMP_Task___Rx_Vote3_Check S41_COMP_Task___Vote_Decision S41_Matrix_Cycle_Observation_DEBUG S41_msg_count_DEBUG_observer /end SUB_GROUP
 /begin REF_MEASUREMENT bacic_cycle_s local_time_s /end REF_MEASUREMENT
/end GROUP
/begin GROUP S20_Update_message_buffers "HANcoder_E407_GTSync_v6/HANcoder STM32 Target - E407-STM32 algorithm/Global Ticks Increment/CAN1 Recieve/Update message buffers" /begin REF_MEASUREMENT Rx_msg_ticks_CAN1 Rx_temporal_msg_CAN1 /end REF_MEASUREMENT /end GROUP
/begin GROUP S21_Get_Free_Running_Counter "HANcoder_E407_GTSync_v6/HANcoder STM32 Target - E407-STM32 algorithm/Global Ticks Increment/CAN1 Send/Get Free Running Counter" /begin REF_MEASUREMENT FRC_Activation_CAN1_send /end REF_MEASUREMENT /end GROUP
/begin GROUP S22_Update_message_buffers "HANcoder_E407_GTSync_v6/HANcoder STM32 Target - E407-STM32 algorithm/Global Ticks Increment/CAN2 Recieve/Update message buffers" /begin REF_MEASUREMENT Rx_msg_ticks_CAN2 Rx_temporal_msg_CAN2 /end REF_MEASUREMENT /end GROUP
/begin GROUP S23_Get_Free_Running_Counter "HANcoder_E407_GTSync_v6/HANcoder STM32 Target - E407-STM32 algorithm/Global Ticks Increment/CAN2 Send/Get Free Running Counter" /begin REF_MEASUREMENT FRC_Activation_CAN2_send /end REF_MEASUREMENT /end GROUP
/begin GROUP S39_RoleID_and_Global_Time_init "HANcoder_E407_GTSync_v6/HANcoder STM32 Target - E407-STM32 algorithm/Global Ticks Increment/CAN Management/Initialization/RoleID and Global Time init" /begin SUB_GROUP S46_Global_Time_Initialization_Slave /end SUB_GROUP /end GROUP
/begin GROUP S41_COMP_Task___Check_Timeouts "HANcoder_E407_GTSync_v6/HANcoder STM32 Target - E407-STM32 algorithm/Global Ticks Increment/CAN Management/Matrix Cycle Manager/COMP Task - Check Timeouts" /begin SUB_GROUP S67_Timeout_and_Board_error_counter /end SUB_GROUP /end GROUP
/begin GROUP S41_COMP_Task___Reset_Board "HANcoder_E407_GTSync_v6/HANcoder STM32 Target - E407-STM32 algorithm/Global Ticks Increment/CAN Management/Matrix Cycle Manager/COMP Task - Reset Board" /begin REF_MEASUREMENT reset_s /end REF_MEASUREMENT /end GROUP
/begin GROUP S41_COMP_Task___Rx_Sync_bc0_Check "HANcoder_E407_GTSync_v6/HANcoder STM32 Target - E407-STM32 algorithm/Global Ticks Increment/CAN Management/Matrix Cycle Manager/COMP Task - Rx_Sync_bc0_Check" /begin SUB_GROUP S72_Process_Messages /end SUB_GROUP /end GROUP
/begin GROUP S41_COMP_Task___Rx_Sync_bc1_Check "HANcoder_E407_GTSync_v6/HANcoder STM32 Target - E407-STM32 algorithm/Global Ticks Increment/CAN Management/Matrix Cycle Manager/COMP Task - Rx_Sync_bc1_Check" /begin SUB_GROUP S73_Process_Messages /end SUB_GROUP /end GROUP
/begin GROUP S41_COMP_Task___Rx_Vote1_Check "HANcoder_E407_GTSync_v6/HANcoder STM32 Target - E407-STM32 algorithm/Global Ticks Increment/CAN Management/Matrix Cycle Manager/COMP Task - Rx_Vote1_Check" /begin SUB_GROUP S74_Process_Messages /end SUB_GROUP /end GROUP
/begin GROUP S41_COMP_Task___Rx_Vote2_Check "HANcoder_E407_GTSync_v6/HANcoder STM32 Target - E407-STM32 algorithm/Global Ticks Increment/CAN Management/Matrix Cycle Manager/COMP Task - Rx_Vote2_Check" /begin SUB_GROUP S75_Process_Messages /end SUB_GROUP /end GROUP
/begin GROUP S41_COMP_Task___Rx_Vote3_Check "HANcoder_E407_GTSync_v6/HANcoder STM32 Target - E407-STM32 algorithm/Global Ticks Increment/CAN Management/Matrix Cycle Manager/COMP Task - Rx_Vote3_Check" /begin SUB_GROUP S76_Process_Messages /end SUB_GROUP /end GROUP
/begin GROUP S41_COMP_Task___Vote_Decision "HANcoder_E407_GTSync_v6/HANcoder STM32 Target - E407-STM32 algorithm/Global Ticks Increment/CAN Management/Matrix Cycle Manager/COMP Task - Vote Decision" /begin SUB_GROUP S79_Vote_Decision /end SUB_GROUP /end GROUP
/begin GROUP S41_Matrix_Cycle_Observation_DEBUG "HANcoder_E407_GTSync_v6/HANcoder STM32 Target - E407-STM32 algorithm/Global Ticks Increment/CAN Management/Matrix Cycle Manager/Matrix_Cycle_Observation_DEBUG"
 /begin REF_MEASUREMENT BC0_sync_processed_s BC0_vote1_processed_s BC0_vote2_processed_s BC0_vote3_processed_s BC1_sync_processed_s Board_1_error_counter_s Board_2_error_counter_s Board_3_error_counter_s Master_ID_s Role_ID_s votes_Board_1_DEBUG votes_Board_2_DEBUG votes_Board_3_DEBUG /end REF_MEASUREMENT
/end GROUP
/begin GROUP S41_msg_count_DEBUG_observer "HANcoder_E407_GTSync_v6/HANcoder STM32 Target - E407-STM32 algorithm/Global Ticks Increment/CAN Management/Matrix Cycle Manager/msg_count_DEBUG observer" /begin REF_MEASUREMENT msg_count_DEBUG_s /end REF_MEASUREMENT /end GROUP
/begin GROUP S46_Global_Time_Initialization_Slave "HANcoder_E407_GTSync_v6/HANcoder STM32 Target - E407-STM32 algorithm/Global Ticks Increment/CAN Management/Initialization/RoleID and Global Time init/Global Time Initialization Slave" /begin SUB_GROUP S48_msg_decoding /end SUB_GROUP /begin REF_MEASUREMENT Rx_init_LT /end REF_MEASUREMENT /end GROUP
/begin GROUP S67_Timeout_and_Board_error_counter "HANcoder_E407_GTSync_v6/HANcoder STM32 Target - E407-STM32 algorithm/Global Ticks Increment/CAN Management/Matrix Cycle Manager/COMP Task - Check Timeouts/Timeout and Board error counter"
 /begin SUB_GROUP S155_Timeout_Counter_1_DEBUG S155_Timeout_Counter_2_DEBUG S155_Timeout_Counter_3_DEBUG /end SUB_GROUP
/end GROUP
/begin GROUP S72_Process_Messages "HANcoder_E407_GTSync_v6/HANcoder STM32 Target - E407-STM32 algorithm/Global Ticks Increment/CAN Management/Matrix Cycle Manager/COMP Task - Rx_Sync_bc0_Check/Process_Messages"
 /begin SUB_GROUP S165_Demux_message_CAN1_and_check_coherence S165_Demux_message_CAN1_and_check_coherence1 /end SUB_GROUP
 /begin REF_MEASUREMENT Desync_Sync_bc0_s /end REF_MEASUREMENT
/end GROUP
/begin GROUP S73_Process_Messages "HANcoder_E407_GTSync_v6/HANcoder STM32 Target - E407-STM32 algorithm/Global Ticks Increment/CAN Management/Matrix Cycle Manager/COMP Task - Rx_Sync_bc1_Check/Process_Messages"
 /begin SUB_GROUP S193_Demux_message_CAN1_and_check_coherence S193_Demux_message_CAN1_and_check_coherence1 /end SUB_GROUP
 /begin REF_MEASUREMENT Desync_Sync_bc1_s /end REF_MEASUREMENT
/end GROUP
/begin GROUP S74_Process_Messages "HANcoder_E407_GTSync_v6/HANcoder STM32 Target - E407-STM32 algorithm/Global Ticks Increment/CAN Management/Matrix Cycle Manager/COMP Task - Rx_Vote1_Check/Process_Messages"
 /begin SUB_GROUP S221_Demux_message_CAN1_and_check_coherence S221_Demux_message_CAN1_and_check_coherence1 /end SUB_GROUP
 /begin REF_MEASUREMENT Desync_Vote1_s Rx_msg_ticks_vote1_CAN1_s Rx_msg_ticks_vote1_CAN2_s expected_LT_vote1_CAN1_s expected_LT_vote1_CAN2_s /end REF_MEASUREMENT
/end GROUP
/begin GROUP S75_Process_Messages "HANcoder_E407_GTSync_v6/HANcoder STM32 Target - E407-STM32 algorithm/Global Ticks Increment/CAN Management/Matrix Cycle Manager/COMP Task - Rx_Vote2_Check/Process_Messages"
 /begin SUB_GROUP S249_Demux_message_CAN1_and_check_coherence S249_Demux_message_CAN1_and_check_coherence1 /end SUB_GROUP
 /begin REF_MEASUREMENT Desync_Vote2_s Rx_msg_ticks_vote2_CAN1_s Rx_msg_ticks_vote2_CAN2_s expected_LT_vote2_CAN1_s expected_LT_vote2_CAN2_s /end REF_MEASUREMENT
/end GROUP
/begin GROUP S76_Process_Messages "HANcoder_E407_GTSync_v6/HANcoder STM32 Target - E407-STM32 algorithm/Global Ticks Increment/CAN Management/Matrix Cycle Manager/COMP Task - Rx_Vote3_Check/Process_Messages"
 /begin SUB_GROUP S277_Demux_message_CAN1_and_check_coherence S277_Demux_message_CAN1_and_check_coherence1 /end SUB_GROUP
 /begin REF_MEASUREMENT Desync_Vote3_s Rx_msg_ticks_vote3_CAN1_s Rx_msg_ticks_vote3_CAN2_s expected_LT_vote3_CAN1_s expected_LT_vote3_CAN2_s /end REF_MEASUREMENT
/end GROUP
/begin GROUP S79_Vote_Decision "HANcoder_E407_GTSync_v6/HANcoder STM32 Target - E407-STM32 algorithm/Global Ticks Increment/CAN Management/Matrix Cycle Manager/COMP Task - Vote Decision/Vote Decision" /begin REF_MEASUREMENT Vote_s /end REF_MEASUREMENT /end GROUP
/begin GROUP S48_msg_decoding "HANcoder_E407_GTSync_v6/HANcoder STM32 Target - E407-STM32 algorithm/Global Ticks Increment/CAN Management/Initialization/RoleID and Global Time init/Global Time Initialization Slave/msg_decoding" /begin SUB_GROUP S49_Bit_Shift S49_Bit_Shift1 S49_Bit_Shift2 /end SUB_GROUP /end GROUP
/begin GROUP S155_Timeout_Counter_1_DEBUG "HANcoder_E407_GTSync_v6/HANcoder STM32 Target - E407-STM32 algorithm/Global Ticks Increment/CAN Management/Matrix Cycle Manager/COMP Task - Check Timeouts/Timeout and Board error counter/Timeout Counter 1 DEBUG" /begin REF_MEASUREMENT TM1_timeout_counter_s /end REF_MEASUREMENT /end GROUP
/begin GROUP S155_Timeout_Counter_2_DEBUG "HANcoder_E407_GTSync_v6/HANcoder STM32 Target - E407-STM32 algorithm/Global Ticks Increment/CAN Management/Matrix Cycle Manager/COMP Task - Check Timeouts/Timeout and Board error counter/Timeout Counter 2 DEBUG" /begin REF_MEASUREMENT TM2_timeout_counter_s /end REF_MEASUREMENT /end GROUP
/begin GROUP S155_Timeout_Counter_3_DEBUG "HANcoder_E407_GTSync_v6/HANcoder STM32 Target - E407-STM32 algorithm/Global Ticks Increment/CAN Management/Matrix Cycle Manager/COMP Task - Check Timeouts/Timeout and Board error counter/Timeout Counter 3 DEBUG" /begin REF_MEASUREMENT TM3_timeout_counter_s /end REF_MEASUREMENT /end GROUP
/begin GROUP S165_Demux_message_CAN1_and_check_coherence "HANcoder_E407_GTSync_v6/HANcoder STM32 Target - E407-STM32 algorithm/Global Ticks Increment/CAN Management/Matrix Cycle Manager/COMP Task - Rx_Sync_bc0_Check/Process_Messages/Demux message CAN1 and check coherence" /begin SUB_GROUP S167_Subsystem /end SUB_GROUP /end GROUP
/begin GROUP S165_Demux_message_CAN1_and_check_coherence1 "HANcoder_E407_GTSync_v6/HANcoder STM32 Target - E407-STM32 algorithm/Global Ticks Increment/CAN Management/Matrix Cycle Manager/COMP Task - Rx_Sync_bc0_Check/Process_Messages/Demux message CAN1 and check coherence1" /begin SUB_GROUP S168_Subsystem /end SUB_GROUP /end GROUP
/begin GROUP S193_Demux_message_CAN1_and_check_coherence "HANcoder_E407_GTSync_v6/HANcoder STM32 Target - E407-STM32 algorithm/Global Ticks Increment/CAN Management/Matrix Cycle Manager/COMP Task - Rx_Sync_bc1_Check/Process_Messages/Demux message CAN1 and check coherence" /begin SUB_GROUP S195_Subsystem /end SUB_GROUP /end GROUP
/begin GROUP S193_Demux_message_CAN1_and_check_coherence1 "HANcoder_E407_GTSync_v6/HANcoder STM32 Target - E407-STM32 algorithm/Global Ticks Increment/CAN Management/Matrix Cycle Manager/COMP Task - Rx_Sync_bc1_Check/Process_Messages/Demux message CAN1 and check coherence1" /begin SUB_GROUP S196_Subsystem /end SUB_GROUP /end GROUP
/begin GROUP S221_Demux_message_CAN1_and_check_coherence "HANcoder_E407_GTSync_v6/HANcoder STM32 Target - E407-STM32 algorithm/Global Ticks Increment/CAN Management/Matrix Cycle Manager/COMP Task - Rx_Vote1_Check/Process_Messages/Demux message CAN1 and check coherence" /begin SUB_GROUP S223_Subsystem /end SUB_GROUP /begin REF_MEASUREMENT Rx_temporal_vote1_CAN1 /end REF_MEASUREMENT /end GROUP
/begin GROUP S221_Demux_message_CAN1_and_check_coherence1 "HANcoder_E407_GTSync_v6/HANcoder STM32 Target - E407-STM32 algorithm/Global Ticks Increment/CAN Management/Matrix Cycle Manager/COMP Task - Rx_Vote1_Check/Process_Messages/Demux message CAN1 and check coherence1" /begin SUB_GROUP S224_Subsystem /end SUB_GROUP /begin REF_MEASUREMENT Rx_temporal_vote1_CAN2 /end REF_MEASUREMENT /end GROUP
/begin GROUP S249_Demux_message_CAN1_and_check_coherence "HANcoder_E407_GTSync_v6/HANcoder STM32 Target - E407-STM32 algorithm/Global Ticks Increment/CAN Management/Matrix Cycle Manager/COMP Task - Rx_Vote2_Check/Process_Messages/Demux message CAN1 and check coherence" /begin SUB_GROUP S251_Subsystem /end SUB_GROUP /begin REF_MEASUREMENT Rx_temporal_vote2_CAN1 /end REF_MEASUREMENT /end GROUP
/begin GROUP S249_Demux_message_CAN1_and_check_coherence1 "HANcoder_E407_GTSync_v6/HANcoder STM32 Target - E407-STM32 algorithm/Global Ticks Increment/CAN Management/Matrix Cycle Manager/COMP Task - Rx_Vote2_Check/Process_Messages/Demux message CAN1 and check coherence1" /begin SUB_GROUP S252_Subsystem /end SUB_GROUP /begin REF_MEASUREMENT Rx_temporal_vote2_CAN2 /end REF_MEASUREMENT /end GROUP
/begin GROUP S277_Demux_message_CAN1_and_check_coherence "HANcoder_E407_GTSync_v6/HANcoder STM32 Target - E407-STM32 algorithm/Global Ticks Increment/CAN Management/Matrix Cycle Manager/COMP Task - Rx_Vote3_Check/Process_Messages/Demux message CAN1 and check coherence" /begin SUB_GROUP S279_Subsystem /end SUB_GROUP /begin REF_MEASUREMENT Rx_temporal_vote3_CAN1 /end REF_MEASUREMENT /end GROUP
/begin GROUP S277_Demux_message_CAN1_and_check_coherence1 "HANcoder_E407_GTSync_v6/HANcoder STM32 Target - E407-STM32 algorithm/Global Ticks Increment/CAN Management/Matrix Cycle Manager/COMP Task - Rx_Vote3_Check/Process_Messages/Demux message CAN1 and check coherence1" /begin SUB_GROUP S280_Subsystem /end SUB_GROUP /begin REF_MEASUREMENT Rx_temporal_vote3_CAN2 /end REF_MEASUREMENT /end GROUP
/begin GROUP S49_Bit_Shift "HANcoder_E407_GTSync_v6/HANcoder STM32 Target - E407-STM32 algorithm/Global Ticks Increment/CAN Management/Initialization/RoleID and Global Time init/Global Time Initialization Slave/msg_decoding/Bit Shift" /begin REF_MEASUREMENT Rx_init_bc /end REF_MEASUREMENT /end GROUP
/begin GROUP S49_Bit_Shift1 "HANcoder_E407_GTSync_v6/HANcoder STM32 Target - E407-STM32 algorithm/Global Ticks Increment/CAN Management/Initialization/RoleID and Global Time init/Global Time Initialization Slave/msg_decoding/Bit Shift1" /begin REF_MEASUREMENT Rx_init_mc /end REF_MEASUREMENT /end GROUP
/begin GROUP S49_Bit_Shift2 "HANcoder_E407_GTSync_v6/HANcoder STM32 Target - E407-STM32 algorithm/Global Ticks Increment/CAN Management/Initialization/RoleID and Global Time init/Global Time Initialization Slave/msg_decoding/Bit Shift2" /begin REF_MEASUREMENT Rx_init_id /end REF_MEASUREMENT /end GROUP
/begin GROUP S167_Subsystem "HANcoder_E407_GTSync_v6/HANcoder STM32 Target - E407-STM32 algorithm/Global Ticks Increment/CAN Management/Matrix Cycle Manager/COMP Task - Rx_Sync_bc0_Check/Process_Messages/Demux message CAN1 and check coherence/Subsystem" /begin SUB_GROUP S169_Bit_Shift S169_Bit_Shift1 S169_Bit_Shift2 /end SUB_GROUP /end GROUP
/begin GROUP S168_Subsystem "HANcoder_E407_GTSync_v6/HANcoder STM32 Target - E407-STM32 algorithm/Global Ticks Increment/CAN Management/Matrix Cycle Manager/COMP Task - Rx_Sync_bc0_Check/Process_Messages/Demux message CAN1 and check coherence1/Subsystem" /begin SUB_GROUP S181_Bit_Shift S181_Bit_Shift1 S181_Bit_Shift2 /end SUB_GROUP /end GROUP
/begin GROUP S195_Subsystem "HANcoder_E407_GTSync_v6/HANcoder STM32 Target - E407-STM32 algorithm/Global Ticks Increment/CAN Management/Matrix Cycle Manager/COMP Task - Rx_Sync_bc1_Check/Process_Messages/Demux message CAN1 and check coherence/Subsystem" /begin SUB_GROUP S197_Bit_Shift S197_Bit_Shift1 S197_Bit_Shift2 /end SUB_GROUP /end GROUP
/begin GROUP S196_Subsystem "HANcoder_E407_GTSync_v6/HANcoder STM32 Target - E407-STM32 algorithm/Global Ticks Increment/CAN Management/Matrix Cycle Manager/COMP Task - Rx_Sync_bc1_Check/Process_Messages/Demux message CAN1 and check coherence1/Subsystem" /begin SUB_GROUP S209_Bit_Shift S209_Bit_Shift1 S209_Bit_Shift2 /end SUB_GROUP /end GROUP
/begin GROUP S223_Subsystem "HANcoder_E407_GTSync_v6/HANcoder STM32 Target - E407-STM32 algorithm/Global Ticks Increment/CAN Management/Matrix Cycle Manager/COMP Task - Rx_Vote1_Check/Process_Messages/Demux message CAN1 and check coherence/Subsystem" /begin SUB_GROUP S225_Bit_Shift S225_Bit_Shift1 S225_Bit_Shift2 /end SUB_GROUP /end GROUP
/begin GROUP S224_Subsystem "HANcoder_E407_GTSync_v6/HANcoder STM32 Target - E407-STM32 algorithm/Global Ticks Increment/CAN Management/Matrix Cycle Manager/COMP Task - Rx_Vote1_Check/Process_Messages/Demux message CAN1 and check coherence1/Subsystem" /begin SUB_GROUP S237_Bit_Shift S237_Bit_Shift1 S237_Bit_Shift2 /end SUB_GROUP /end GROUP
/begin GROUP S251_Subsystem "HANcoder_E407_GTSync_v6/HANcoder STM32 Target - E407-STM32 algorithm/Global Ticks Increment/CAN Management/Matrix Cycle Manager/COMP Task - Rx_Vote2_Check/Process_Messages/Demux message CAN1 and check coherence/Subsystem" /begin SUB_GROUP S253_Bit_Shift S253_Bit_Shift1 S253_Bit_Shift2 /end SUB_GROUP /end GROUP
/begin GROUP S252_Subsystem "HANcoder_E407_GTSync_v6/HANcoder STM32 Target - E407-STM32 algorithm/Global Ticks Increment/CAN Management/Matrix Cycle Manager/COMP Task - Rx_Vote2_Check/Process_Messages/Demux message CAN1 and check coherence1/Subsystem" /begin SUB_GROUP S265_Bit_Shift S265_Bit_Shift1 S265_Bit_Shift2 /end SUB_GROUP /end GROUP
/begin GROUP S279_Subsystem "HANcoder_E407_GTSync_v6/HANcoder STM32 Target - E407-STM32 algorithm/Global Ticks Increment/CAN Management/Matrix Cycle Manager/COMP Task - Rx_Vote3_Check/Process_Messages/Demux message CAN1 and check coherence/Subsystem" /begin SUB_GROUP S281_Bit_Shift S281_Bit_Shift1 S281_Bit_Shift2 /end SUB_GROUP /end GROUP
/begin GROUP S280_Subsystem "HANcoder_E407_GTSync_v6/HANcoder STM32 Target - E407-STM32 algorithm/Global Ticks Increment/CAN Management/Matrix Cycle Manager/COMP Task - Rx_Vote3_Check/Process_Messages/Demux message CAN1 and check coherence1/Subsystem" /begin SUB_GROUP S293_Bit_Shift S293_Bit_Shift1 S293_Bit_Shift2 /end SUB_GROUP /end GROUP
/begin GROUP S169_Bit_Shift "HANcoder_E407_GTSync_v6/HANcoder STM32 Target - E407-STM32 algorithm/Global Ticks Increment/CAN Management/Matrix Cycle Manager/COMP Task - Rx_Sync_bc0_Check/Process_Messages/Demux message CAN1 and check coherence/Subsystem/Bit Shift" /begin REF_MEASUREMENT Rx_bc_sync0_CAN1 /end REF_MEASUREMENT /end GROUP
/begin GROUP S169_Bit_Shift1 "HANcoder_E407_GTSync_v6/HANcoder STM32 Target - E407-STM32 algorithm/Global Ticks Increment/CAN Management/Matrix Cycle Manager/COMP Task - Rx_Sync_bc0_Check/Process_Messages/Demux message CAN1 and check coherence/Subsystem/Bit Shift1" /begin REF_MEASUREMENT Rx_mc_sync0_CAN1 /end REF_MEASUREMENT /end GROUP
/begin GROUP S169_Bit_Shift2 "HANcoder_E407_GTSync_v6/HANcoder STM32 Target - E407-STM32 algorithm/Global Ticks Increment/CAN Management/Matrix Cycle Manager/COMP Task - Rx_Sync_bc0_Check/Process_Messages/Demux message CAN1 and check coherence/Subsystem/Bit Shift2" /begin REF_MEASUREMENT Rx_id_sync0_CAN1 /end REF_MEASUREMENT /end GROUP
/begin GROUP S181_Bit_Shift "HANcoder_E407_GTSync_v6/HANcoder STM32 Target - E407-STM32 algorithm/Global Ticks Increment/CAN Management/Matrix Cycle Manager/COMP Task - Rx_Sync_bc0_Check/Process_Messages/Demux message CAN1 and check coherence1/Subsystem/Bit Shift" /begin REF_MEASUREMENT Rx_bc_sync0_CAN2 /end REF_MEASUREMENT /end GROUP
/begin GROUP S181_Bit_Shift1 "HANcoder_E407_GTSync_v6/HANcoder STM32 Target - E407-STM32 algorithm/Global Ticks Increment/CAN Management/Matrix Cycle Manager/COMP Task - Rx_Sync_bc0_Check/Process_Messages/Demux message CAN1 and check coherence1/Subsystem/Bit Shift1" /begin REF_MEASUREMENT Rx_mc_sync0_CAN2 /end REF_MEASUREMENT /end GROUP
/begin GROUP S181_Bit_Shift2 "HANcoder_E407_GTSync_v6/HANcoder STM32 Target - E407-STM32 algorithm/Global Ticks Increment/CAN Management/Matrix Cycle Manager/COMP Task - Rx_Sync_bc0_Check/Process_Messages/Demux message CAN1 and check coherence1/Subsystem/Bit Shift2" /begin REF_MEASUREMENT Rx_id_sync0_CAN2 /end REF_MEASUREMENT /end GROUP
/begin GROUP S197_Bit_Shift "HANcoder_E407_GTSync_v6/HANcoder STM32 Target - E407-STM32 algorithm/Global Ticks Increment/CAN Management/Matrix Cycle Manager/COMP Task - Rx_Sync_bc1_Check/Process_Messages/Demux message CAN1 and check coherence/Subsystem/Bit Shift" /begin REF_MEASUREMENT Rx_bc_sync1_CAN1 /end REF_MEASUREMENT /end GROUP
/begin GROUP S197_Bit_Shift1 "HANcoder_E407_GTSync_v6/HANcoder STM32 Target - E407-STM32 algorithm/Global Ticks Increment/CAN Management/Matrix Cycle Manager/COMP Task - Rx_Sync_bc1_Check/Process_Messages/Demux message CAN1 and check coherence/Subsystem/Bit Shift1" /begin REF_MEASUREMENT Rx_mc_sync1_CAN1 /end REF_MEASUREMENT /end GROUP
/begin GROUP S197_Bit_Shift2 "HANcoder_E407_GTSync_v6/HANcoder STM32 Target - E407-STM32 algorithm/Global Ticks Increment/CAN Management/Matrix Cycle Manager/COMP Task - Rx_Sync_bc1_Check/Process_Messages/Demux message CAN1 and check coherence/Subsystem/Bit Shift2" /begin REF_MEASUREMENT Rx_id_sync1_CAN1 /end REF_MEASUREMENT /end GROUP
/begin GROUP S209_Bit_Shift "HANcoder_E407_GTSync_v6/HANcoder STM32 Target - E407-STM32 algorithm/Global Ticks Increment/CAN Management/Matrix Cycle Manager/COMP Task - Rx_Sync_bc1_Check/Process_Messages/Demux message CAN1 and check coherence1/Subsystem/Bit Shift" /begin REF_MEASUREMENT Rx_bc_sync1_CAN2 /end REF_MEASUREMENT /end GROUP
/begin GROUP S209_Bit_Shift1 "HANcoder_E407_GTSync_v6/HANcoder STM32 Target - E407-STM32 algorithm/Global Ticks Increment/CAN Management/Matrix Cycle Manager/COMP Task - Rx_Sync_bc1_Check/Process_Messages/Demux message CAN1 and check coherence1/Subsystem/Bit Shift1" /begin REF_MEASUREMENT Rx_mc_sync1_CAN2 /end REF_MEASUREMENT /end GROUP
/begin GROUP S209_Bit_Shift2 "HANcoder_E407_GTSync_v6/HANcoder STM32 Target - E407-STM32 algorithm/Global Ticks Increment/CAN Management/Matrix Cycle Manager/COMP Task - Rx_Sync_bc1_Check/Process_Messages/Demux message CAN1 and check coherence1/Subsystem/Bit Shift2" /begin REF_MEASUREMENT Rx_id_sync1_CAN2 /end REF_MEASUREMENT /end GROUP
/begin GROUP S225_Bit_Shift "HANcoder_E407_GTSync_v6/HANcoder STM32 Target - E407-STM32 algorithm/Global Ticks Increment/CAN Management/Matrix Cycle Manager/COMP Task - Rx_Vote1_Check/Process_Messages/Demux message CAN1 and check coherence/Subsystem/Bit Shift" /begin REF_MEASUREMENT Rx_bc_vote1_CAN1 /end REF_MEASUREMENT /end GROUP
/begin GROUP S225_Bit_Shift1 "HANcoder_E407_GTSync_v6/HANcoder STM32 Target - E407-STM32 algorithm/Global Ticks Increment/CAN Management/Matrix Cycle Manager/COMP Task - Rx_Vote1_Check/Process_Messages/Demux message CAN1 and check coherence/Subsystem/Bit Shift1" /begin REF_MEASUREMENT Rx_mc_vote1_CAN1 /end REF_MEASUREMENT /end GROUP
/begin GROUP S225_Bit_Shift2 "HANcoder_E407_GTSync_v6/HANcoder STM32 Target - E407-STM32 algorithm/Global Ticks Increment/CAN Management/Matrix Cycle Manager/COMP Task - Rx_Vote1_Check/Process_Messages/Demux message CAN1 and check coherence/Subsystem/Bit Shift2" /begin REF_MEASUREMENT Rx_id_vote1_CAN1 /end REF_MEASUREMENT /end GROUP
/begin GROUP S237_Bit_Shift "HANcoder_E407_GTSync_v6/HANcoder STM32 Target - E407-STM32 algorithm/Global Ticks Increment/CAN Management/Matrix Cycle Manager/COMP Task - Rx_Vote1_Check/Process_Messages/Demux message CAN1 and check coherence1/Subsystem/Bit Shift" /begin REF_MEASUREMENT Rx_bc_vote1_CAN2 /end REF_MEASUREMENT /end GROUP
/begin GROUP S237_Bit_Shift1 "HANcoder_E407_GTSync_v6/HANcoder STM32 Target - E407-STM32 algorithm/Global Ticks Increment/CAN Management/Matrix Cycle Manager/COMP Task - Rx_Vote1_Check/Process_Messages/Demux message CAN1 and check coherence1/Subsystem/Bit Shift1" /begin REF_MEASUREMENT Rx_mc_vote1_CAN2 /end REF_MEASUREMENT /end GROUP
/begin GROUP S237_Bit_Shift2 "HANcoder_E407_GTSync_v6/HANcoder STM32 Target - E407-STM32 algorithm/Global Ticks Increment/CAN Management/Matrix Cycle Manager/COMP Task - Rx_Vote1_Check/Process_Messages/Demux message CAN1 and check coherence1/Subsystem/Bit Shift2" /begin REF_MEASUREMENT Rx_id_vote1_CAN2 /end REF_MEASUREMENT /end GROUP
/begin GROUP S253_Bit_Shift "HANcoder_E407_GTSync_v6/HANcoder STM32 Target - E407-STM32 algorithm/Global Ticks Increment/CAN Management/Matrix Cycle Manager/COMP Task - Rx_Vote2_Check/Process_Messages/Demux message CAN1 and check coherence/Subsystem/Bit Shift" /begin REF_MEASUREMENT Rx_bc_vote2_CAN1 /end REF_MEASUREMENT /end GROUP
/begin GROUP S253_Bit_Shift1 "HANcoder_E407_GTSync_v6/HANcoder STM32 Target - E407-STM32 algorithm/Global Ticks Increment/CAN Management/Matrix Cycle Manager/COMP Task - Rx_Vote2_Check/Process_Messages/Demux message CAN1 and check coherence/Subsystem/Bit Shift1" /begin REF_MEASUREMENT Rx_mc_vote2_CAN1 /end REF_MEASUREMENT /end GROUP
/begin GROUP S253_Bit_Shift2 "HANcoder_E407_GTSync_v6/HANcoder STM32 Target - E407-STM32 algorithm/Global Ticks Increment/CAN Management/Matrix Cycle Manager/COMP Task - Rx_Vote2_Check/Process_Messages/Demux message CAN1 and check coherence/Subsystem/Bit Shift2" /begin REF_MEASUREMENT Rx_id_vote2_CAN1 /end REF_MEASUREMENT /end GROUP
/begin GROUP S265_Bit_Shift "HANcoder_E407_GTSync_v6/HANcoder STM32 Target - E407-STM32 algorithm/Global Ticks Increment/CAN Management/Matrix Cycle Manager/COMP Task - Rx_Vote2_Check/Process_Messages/Demux message CAN1 and check coherence1/Subsystem/Bit Shift" /begin REF_MEASUREMENT Rx_bc_vote2_CAN2 /end REF_MEASUREMENT /end GROUP
/begin GROUP S265_Bit_Shift1 "HANcoder_E407_GTSync_v6/HANcoder STM32 Target - E407-STM32 algorithm/Global Ticks Increment/CAN Management/Matrix Cycle Manager/COMP Task - Rx_Vote2_Check/Process_Messages/Demux message CAN1 and check coherence1/Subsystem/Bit Shift1" /begin REF_MEASUREMENT Rx_mc_vote2_CAN2 /end REF_MEASUREMENT /end GROUP
/begin GROUP S265_Bit_Shift2 "HANcoder_E407_GTSync_v6/HANcoder STM32 Target - E407-STM32 algorithm/Global Ticks Increment/CAN Management/Matrix Cycle Manager/COMP Task - Rx_Vote2_Check/Process_Messages/Demux message CAN1 and check coherence1/Subsystem/Bit Shift2" /begin REF_MEASUREMENT Rx_id_vote2_CAN2 /end REF_MEASUREMENT /end GROUP
/begin GROUP S281_Bit_Shift "HANcoder_E407_GTSync_v6/HANcoder STM32 Target - E407-STM32 algorithm/Global Ticks Increment/CAN Management/Matrix Cycle Manager/COMP Task - Rx_Vote3_Check/Process_Messages/Demux message CAN1 and check coherence/Subsystem/Bit Shift" /begin REF_MEASUREMENT Rx_bc_vote3_CAN1 /end REF_MEASUREMENT /end GROUP
/begin GROUP S281_Bit_Shift1 "HANcoder_E407_GTSync_v6/HANcoder STM32 Target - E407-STM32 algorithm/Global Ticks Increment/CAN Management/Matrix Cycle Manager/COMP Task - Rx_Vote3_Check/Process_Messages/Demux message CAN1 and check coherence/Subsystem/Bit Shift1" /begin REF_MEASUREMENT Rx_mc_vote3_CAN1 /end REF_MEASUREMENT /end GROUP
/begin GROUP S281_Bit_Shift2 "HANcoder_E407_GTSync_v6/HANcoder STM32 Target - E407-STM32 algorithm/Global Ticks Increment/CAN Management/Matrix Cycle Manager/COMP Task - Rx_Vote3_Check/Process_Messages/Demux message CAN1 and check coherence/Subsystem/Bit Shift2" /begin REF_MEASUREMENT Rx_id_vote3_CAN1 /end REF_MEASUREMENT /end GROUP
/begin GROUP S293_Bit_Shift "HANcoder_E407_GTSync_v6/HANcoder STM32 Target - E407-STM32 algorithm/Global Ticks Increment/CAN Management/Matrix Cycle Manager/COMP Task - Rx_Vote3_Check/Process_Messages/Demux message CAN1 and check coherence1/Subsystem/Bit Shift" /begin REF_MEASUREMENT Rx_bc_vote3_CAN2 /end REF_MEASUREMENT /end GROUP
/begin GROUP S293_Bit_Shift1 "HANcoder_E407_GTSync_v6/HANcoder STM32 Target - E407-STM32 algorithm/Global Ticks Increment/CAN Management/Matrix Cycle Manager/COMP Task - Rx_Vote3_Check/Process_Messages/Demux message CAN1 and check coherence1/Subsystem/Bit Shift1" /begin REF_MEASUREMENT Rx_mc_vote3_CAN2 /end REF_MEASUREMENT /end GROUP
/begin GROUP S293_Bit_Shift2 "HANcoder_E407_GTSync_v6/HANcoder STM32 Target - E407-STM32 algorithm/Global Ticks Increment/CAN Management/Matrix Cycle Manager/COMP Task - Rx_Vote3_Check/Process_Messages/Demux message CAN1 and check coherence1/Subsystem/Bit Shift2" /begin REF_MEASUREMENT Rx_id_vote3_CAN2 /end REF_MEASUREMENT /end GROUP
/end MODULE
/end PROJECT
/* (add any file trailer comments here) */
/* EOF HANcoder_E407_GTSync_v6.a2l */
