/******************************************************************************
* ASAP2 file: HANcoder_E407_TTA_Controller_v3.a2l
* Academic License - for use in teaching, academic research, and meeting
* course requirements at degree granting institutions only. Not for
* government, commercial, or other organizational use.
* Code generation for model "HANcoder_E407_TTA_Controller_v3".
* Model version : 1.95
* Simulink Coder version : 9.0 (R2018b) 24-May-2018
* C source code generated on : Tue Jan 4 20:31:32 2022
* Target selection: ert.tlc
* Embedded hardware selection: ARM Compatible->ARM Cortex
* Code generation objectives: Unspecified
* Validation result: Not run
* (add additional file header information here)
******************************************************************************/ ASAP2_VERSION 1 31
/* Version 1.31 */
/begin PROJECT ProjectName "HANcoder_E407_TTA_Controller_v3_softwareID_v1_040122_202927"
/begin HEADER "Header Comments go here" /end HEADER
/begin MODULE ModuleName "Module Comment Goes Here"
/begin MOD_PAR "MOD PAR Comment Goes Here" ADDR_EPK 0x0800cd14 CPU_TYPE "STM32F407" ECU "E407" EPK "HANcoder_E407_TTA_Controller_v3_softwareID_v1_040122_202927"
 SYSTEM_CONSTANT "XcpStationID string length" "0x0000003b"
 SYSTEM_CONSTANT "RAM-FlashOffset" "-402480608" /end MOD_PAR
/begin MOD_COMMON "Mod Common Comment Here" BYTE_ORDER MSB_LAST /end MOD_COMMON
/begin RECORD_LAYOUT Scalar_BOOLEAN FNC_VALUES 1 UBYTE COLUMN_DIR DIRECT /end RECORD_LAYOUT
/begin RECORD_LAYOUT Scalar_UBYTE FNC_VALUES 1 UBYTE COLUMN_DIR DIRECT /end RECORD_LAYOUT
/begin RECORD_LAYOUT Scalar_BYTE FNC_VALUES 1 SBYTE COLUMN_DIR DIRECT /end RECORD_LAYOUT
/begin RECORD_LAYOUT Scalar_UWORD FNC_VALUES 1 UWORD COLUMN_DIR DIRECT /end RECORD_LAYOUT
/begin RECORD_LAYOUT Scalar_SWORD FNC_VALUES 1 SWORD COLUMN_DIR DIRECT /end RECORD_LAYOUT
/begin RECORD_LAYOUT Scalar_ULONG FNC_VALUES 1 ULONG COLUMN_DIR DIRECT /end RECORD_LAYOUT
/begin RECORD_LAYOUT Scalar_LONG FNC_VALUES 1 SLONG COLUMN_DIR DIRECT /end RECORD_LAYOUT
/begin RECORD_LAYOUT Scalar_FLOAT32_IEEE FNC_VALUES 1 FLOAT32_IEEE COLUMN_DIR DIRECT /end RECORD_LAYOUT
/begin RECORD_LAYOUT Scalar_FLOAT64_IEEE FNC_VALUES 1 FLOAT64_IEEE COLUMN_DIR DIRECT /end RECORD_LAYOUT
/begin RECORD_LAYOUT Lookup1D_BYTE FNC_VALUES 1 SBYTE COLUMN_DIR DIRECT /end RECORD_LAYOUT
/begin RECORD_LAYOUT Lookup1D_X_BYTE AXIS_PTS_X 1 SBYTE INDEX_INCR DIRECT /end RECORD_LAYOUT
/begin RECORD_LAYOUT Lookup1D_UBYTE FNC_VALUES 1 UBYTE COLUMN_DIR DIRECT /end RECORD_LAYOUT
/begin RECORD_LAYOUT Lookup1D_X_UBYTE AXIS_PTS_X 1 UBYTE INDEX_INCR DIRECT /end RECORD_LAYOUT
/begin RECORD_LAYOUT Lookup1D_UWORD FNC_VALUES 1 UWORD COLUMN_DIR DIRECT /end RECORD_LAYOUT
/begin RECORD_LAYOUT Lookup1D_X_UWORD AXIS_PTS_X 1 UWORD INDEX_INCR DIRECT /end RECORD_LAYOUT
/begin RECORD_LAYOUT Lookup1D_WORD FNC_VALUES 1 SWORD COLUMN_DIR DIRECT /end RECORD_LAYOUT
/begin RECORD_LAYOUT Lookup1D_X_WORD AXIS_PTS_X 1 SWORD INDEX_INCR DIRECT /end RECORD_LAYOUT
/begin RECORD_LAYOUT Lookup1D_ULONG FNC_VALUES 1 ULONG COLUMN_DIR DIRECT /end RECORD_LAYOUT
/begin RECORD_LAYOUT Lookup1D_X_ULONG AXIS_PTS_X 1 ULONG INDEX_INCR DIRECT /end RECORD_LAYOUT
/begin RECORD_LAYOUT Lookup1D_SLONG FNC_VALUES 1 SLONG COLUMN_DIR DIRECT /end RECORD_LAYOUT
/begin RECORD_LAYOUT Lookup1D_X_LONG AXIS_PTS_X 1 SLONG INDEX_INCR DIRECT /end RECORD_LAYOUT
/begin RECORD_LAYOUT Lookup1D_FLOAT32_IEEE FNC_VALUES 1 FLOAT32_IEEE COLUMN_DIR DIRECT /end RECORD_LAYOUT
/begin RECORD_LAYOUT Lookup1D_X_FLOAT32_IEEE AXIS_PTS_X 1 FLOAT32_IEEE INDEX_INCR DIRECT /end RECORD_LAYOUT
/begin RECORD_LAYOUT Lookup1D_FLOAT64_IEEE FNC_VALUES 1 FLOAT64_IEEE COLUMN_DIR DIRECT /end RECORD_LAYOUT
/begin RECORD_LAYOUT Lookup1D_X_FLOAT64_IEEE AXIS_PTS_X 1 FLOAT64_IEEE INDEX_INCR DIRECT /end RECORD_LAYOUT
/begin RECORD_LAYOUT Lookup2D_UBYTE FNC_VALUES 1 UBYTE COLUMN_DIR DIRECT /end RECORD_LAYOUT
/begin RECORD_LAYOUT Lookup2D_X_UBYTE AXIS_PTS_X 1 UBYTE INDEX_INCR DIRECT /end RECORD_LAYOUT
/begin RECORD_LAYOUT Lookup2D_BYTE FNC_VALUES 1 SBYTE COLUMN_DIR DIRECT /end RECORD_LAYOUT
/begin RECORD_LAYOUT Lookup2D_X_BYTE AXIS_PTS_X 1 SBYTE INDEX_INCR DIRECT /end RECORD_LAYOUT
/begin RECORD_LAYOUT Lookup2D_UWORD FNC_VALUES 1 UWORD COLUMN_DIR DIRECT /end RECORD_LAYOUT
/begin RECORD_LAYOUT Lookup2D_X_UWORD AXIS_PTS_X 1 UWORD INDEX_INCR DIRECT /end RECORD_LAYOUT
/begin RECORD_LAYOUT Lookup2D_WORD FNC_VALUES 1 SWORD COLUMN_DIR DIRECT /end RECORD_LAYOUT
/begin RECORD_LAYOUT Lookup2D_X_WORD AXIS_PTS_X 1 SWORD INDEX_INCR DIRECT /end RECORD_LAYOUT
/begin RECORD_LAYOUT Lookup2D_ULONG FNC_VALUES 1 ULONG COLUMN_DIR DIRECT /end RECORD_LAYOUT
/begin RECORD_LAYOUT Lookup2D_X_ULONG AXIS_PTS_X 1 ULONG INDEX_INCR DIRECT /end RECORD_LAYOUT
/begin RECORD_LAYOUT Lookup2D_LONG FNC_VALUES 1 SLONG COLUMN_DIR DIRECT /end RECORD_LAYOUT
/begin RECORD_LAYOUT Lookup2D_X_LONG AXIS_PTS_X 1 SLONG INDEX_INCR DIRECT /end RECORD_LAYOUT
/begin RECORD_LAYOUT Lookup2D_FLOAT32_IEEE FNC_VALUES 1 FLOAT32_IEEE COLUMN_DIR DIRECT /end RECORD_LAYOUT
/begin RECORD_LAYOUT Lookup2D_X_FLOAT32_IEEE AXIS_PTS_X 1 FLOAT32_IEEE INDEX_INCR DIRECT /end RECORD_LAYOUT
/begin RECORD_LAYOUT Lookup2D_FLOAT64_IEEE FNC_VALUES 1 FLOAT64_IEEE COLUMN_DIR DIRECT /end RECORD_LAYOUT
/begin RECORD_LAYOUT Lookup2D_X_FLOAT64_IEEE AXIS_PTS_X 1 FLOAT64_IEEE INDEX_INCR DIRECT /end RECORD_LAYOUT
/begin CHARACTERISTIC delta_a_set "" VALUE 0x20000068 Scalar_FLOAT64_IEEE 0 HANcoder_E407_TTA_Controller_v3_CM_double -1.7E+308 1.7E+308 /end CHARACTERISTIC
/begin CHARACTERISTIC delta_f_set "" VALUE 0x20000008 Scalar_FLOAT64_IEEE 0 HANcoder_E407_TTA_Controller_v3_CM_double -1.7E+308 1.7E+308 /end CHARACTERISTIC
/begin CHARACTERISTIC speed_k_d "" VALUE 0x20000050 Scalar_FLOAT64_IEEE 0 HANcoder_E407_TTA_Controller_v3_CM_double -1.7E+308 1.7E+308 /end CHARACTERISTIC
/begin CHARACTERISTIC speed_k_i "" VALUE 0x20000058 Scalar_FLOAT64_IEEE 0 HANcoder_E407_TTA_Controller_v3_CM_double -1.7E+308 1.7E+308 /end CHARACTERISTIC
/begin CHARACTERISTIC speed_k_p "" VALUE 0x20000060 Scalar_FLOAT64_IEEE 0 HANcoder_E407_TTA_Controller_v3_CM_double -1.7E+308 1.7E+308 /end CHARACTERISTIC
/begin CHARACTERISTIC torque_a_k_d "" VALUE 0x20000018 Scalar_FLOAT64_IEEE 0 HANcoder_E407_TTA_Controller_v3_CM_double -1.7E+308 1.7E+308 /end CHARACTERISTIC
/begin CHARACTERISTIC torque_a_k_i "" VALUE 0x20000020 Scalar_FLOAT64_IEEE 0 HANcoder_E407_TTA_Controller_v3_CM_double -1.7E+308 1.7E+308 /end CHARACTERISTIC
/begin CHARACTERISTIC torque_a_k_p "" VALUE 0x20000030 Scalar_FLOAT64_IEEE 0 HANcoder_E407_TTA_Controller_v3_CM_double -1.7E+308 1.7E+308 /end CHARACTERISTIC
/begin CHARACTERISTIC torque_f_k_d "" VALUE 0x20000038 Scalar_FLOAT64_IEEE 0 HANcoder_E407_TTA_Controller_v3_CM_double -1.7E+308 1.7E+308 /end CHARACTERISTIC
/begin CHARACTERISTIC torque_f_k_i "" VALUE 0x20000028 Scalar_FLOAT64_IEEE 0 HANcoder_E407_TTA_Controller_v3_CM_double -1.7E+308 1.7E+308 /end CHARACTERISTIC
/begin CHARACTERISTIC torque_f_k_p "" VALUE 0x20000048 Scalar_FLOAT64_IEEE 0 HANcoder_E407_TTA_Controller_v3_CM_double -1.7E+308 1.7E+308 /end CHARACTERISTIC
/begin CHARACTERISTIC v_set "" VALUE 0x20000040 Scalar_FLOAT64_IEEE 0 HANcoder_E407_TTA_Controller_v3_CM_double -1.7E+308 1.7E+308 /end CHARACTERISTIC
/begin CHARACTERISTIC HANtuneOverride "" VALUE 0x20000010 Scalar_BOOLEAN 0 HANcoder_E407_TTA_Controller_v3_CM_boolean 0 1 /end CHARACTERISTIC
/begin MEASUREMENT simulation_time "" FLOAT64_IEEE HANcoder_E407_TTA_Controller_v3_CM_double 0 0 -1.7E+308 1.7E+308 ECU_ADDRESS 0x2000c308 /end MEASUREMENT
/begin MEASUREMENT Board_ID_s "" FLOAT64_IEEE HANcoder_E407_TTA_Controller_v3_CM_double 0 0 -1.7E+308 1.7E+308 ECU_ADDRESS 0x2000c0b8 /end MEASUREMENT
/begin MEASUREMENT SI_FreeHeap "" ULONG HANcoder_E407_TTA_Controller_v3_CM_uint32 0 0 0 4294967295 ECU_ADDRESS 0x2000c1bc /end MEASUREMENT
/begin MEASUREMENT SI_FreeStack "" ULONG HANcoder_E407_TTA_Controller_v3_CM_uint32 0 0 0 4294967295 ECU_ADDRESS 0x2000c360 /end MEASUREMENT
/begin MEASUREMENT local_ticks_interrupt "" UWORD HANcoder_E407_TTA_Controller_v3_CM_uint16 0 0 0 65535 ECU_ADDRESS 0x2000c84a /end MEASUREMENT
/begin MEASUREMENT SI_CPUload "" UBYTE HANcoder_E407_TTA_Controller_v3_CM_uint8 0 0 0 255 ECU_ADDRESS 0x2000c7ca /end MEASUREMENT
/begin MEASUREMENT LedValue "" UBYTE HANcoder_E407_TTA_Controller_v3_CM_boolean 0 0 0 1 ECU_ADDRESS 0x2000c212 /end MEASUREMENT
/begin MEASUREMENT Master_ID_vem_s "" FLOAT64_IEEE HANcoder_E407_TTA_Controller_v3_CM_double 0 0 -1.7E+308 1.7E+308 ECU_ADDRESS 0x2000c828 /end MEASUREMENT
/begin MEASUREMENT Role_ID_vem_s "" FLOAT64_IEEE HANcoder_E407_TTA_Controller_v3_CM_double 0 0 -1.7E+308 1.7E+308 ECU_ADDRESS 0x2000c0a0 /end MEASUREMENT
/begin MEASUREMENT msg_count_DEBUG_vem_s "" FLOAT64_IEEE HANcoder_E407_TTA_Controller_v3_CM_double 0 0 -1.7E+308 1.7E+308 ECU_ADDRESS 0x2000bc00 /end MEASUREMENT
/begin MEASUREMENT Desync_Sync_bc1_vem_s "" FLOAT64_IEEE HANcoder_E407_TTA_Controller_v3_CM_double 0 0 -1.7E+308 1.7E+308 ECU_ADDRESS 0x2000c868 /end MEASUREMENT
/begin MEASUREMENT expected_LT_sensorvalues_CAN1_vem_s "" FLOAT64_IEEE HANcoder_E407_TTA_Controller_v3_CM_double 0 0 -1.7E+308 1.7E+308 ECU_ADDRESS 0x2000c398 /end MEASUREMENT
/begin MEASUREMENT expected_LT_sensorvalues_CAN2_vem_s "" FLOAT64_IEEE HANcoder_E407_TTA_Controller_v3_CM_double 0 0 -1.7E+308 1.7E+308 ECU_ADDRESS 0x2000c270 /end MEASUREMENT
/begin MEASUREMENT Desync_sensorvalues_vem_s "" FLOAT64_IEEE HANcoder_E407_TTA_Controller_v3_CM_double 0 0 -1.7E+308 1.7E+308 ECU_ADDRESS 0x2000c1e0 /end MEASUREMENT
/begin MEASUREMENT Rx_temporal_sensorvalues_CAN2_vem "" FLOAT64_IEEE HANcoder_E407_TTA_Controller_v3_CM_double 0 0 -1.7E+308 1.7E+308 ECU_ADDRESS 0x2000c160 /end MEASUREMENT
/begin MEASUREMENT Rx_temporal_sensorvalues_CAN1_vem "" FLOAT64_IEEE HANcoder_E407_TTA_Controller_v3_CM_double 0 0 -1.7E+308 1.7E+308 ECU_ADDRESS 0x2000c290 /end MEASUREMENT
/begin MEASUREMENT theta_fr_s "" FLOAT64_IEEE HANcoder_E407_TTA_Controller_v3_CM_double 0 0 -1.7E+308 1.7E+308 ECU_ADDRESS 0x2000c758 /end MEASUREMENT
/begin MEASUREMENT theta_fl_s "" FLOAT64_IEEE HANcoder_E407_TTA_Controller_v3_CM_double 0 0 -1.7E+308 1.7E+308 ECU_ADDRESS 0x2000bb80 /end MEASUREMENT
/begin MEASUREMENT theta_ar_s "" FLOAT64_IEEE HANcoder_E407_TTA_Controller_v3_CM_double 0 0 -1.7E+308 1.7E+308 ECU_ADDRESS 0x2000c7b8 /end MEASUREMENT
/begin MEASUREMENT theta_al_s "" FLOAT64_IEEE HANcoder_E407_TTA_Controller_v3_CM_double 0 0 -1.7E+308 1.7E+308 ECU_ADDRESS 0x2000c258 /end MEASUREMENT
/begin MEASUREMENT Desync_Sync_bc0_vem_s "" FLOAT64_IEEE HANcoder_E407_TTA_Controller_v3_CM_double 0 0 -1.7E+308 1.7E+308 ECU_ADDRESS 0x2000bb60 /end MEASUREMENT
/begin MEASUREMENT Master_ID_ing_s "" FLOAT64_IEEE HANcoder_E407_TTA_Controller_v3_CM_double 0 0 -1.7E+308 1.7E+308 ECU_ADDRESS 0x2000c280 /end MEASUREMENT
/begin MEASUREMENT Role_ID_ing_s "" FLOAT64_IEEE HANcoder_E407_TTA_Controller_v3_CM_double 0 0 -1.7E+308 1.7E+308 ECU_ADDRESS 0x2000c140 /end MEASUREMENT
/begin MEASUREMENT msg_count_DEBUG_ing_s "" FLOAT64_IEEE HANcoder_E407_TTA_Controller_v3_CM_double 0 0 -1.7E+308 1.7E+308 ECU_ADDRESS 0x2000bc58 /end MEASUREMENT
/begin MEASUREMENT Desync_Sync_bc1_ing_s "" FLOAT64_IEEE HANcoder_E407_TTA_Controller_v3_CM_double 0 0 -1.7E+308 1.7E+308 ECU_ADDRESS 0x2000bb20 /end MEASUREMENT
/begin MEASUREMENT Desync_Sync_bc0_ing_s "" FLOAT64_IEEE HANcoder_E407_TTA_Controller_v3_CM_double 0 0 -1.7E+308 1.7E+308 ECU_ADDRESS 0x2000bba0 /end MEASUREMENT
/begin MEASUREMENT Master_ID_s "" FLOAT64_IEEE HANcoder_E407_TTA_Controller_v3_CM_double 0 0 -1.7E+308 1.7E+308 ECU_ADDRESS 0x2000c208 /end MEASUREMENT
/begin MEASUREMENT Role_ID_s "" FLOAT64_IEEE HANcoder_E407_TTA_Controller_v3_CM_double 0 0 -1.7E+308 1.7E+308 ECU_ADDRESS 0x2000bbd0 /end MEASUREMENT
/begin MEASUREMENT votes_Board_1_DEBUG "" FLOAT64_IEEE HANcoder_E407_TTA_Controller_v3_CM_double 0 0 -1.7E+308 1.7E+308 ECU_ADDRESS 0x2000c830 /end MEASUREMENT
/begin MEASUREMENT votes_Board_2_DEBUG "" FLOAT64_IEEE HANcoder_E407_TTA_Controller_v3_CM_double 0 0 -1.7E+308 1.7E+308 ECU_ADDRESS 0x2000c7e0 /end MEASUREMENT
/begin MEASUREMENT votes_Board_3_DEBUG "" FLOAT64_IEEE HANcoder_E407_TTA_Controller_v3_CM_double 0 0 -1.7E+308 1.7E+308 ECU_ADDRESS 0x2000c0f8 /end MEASUREMENT
/begin MEASUREMENT Board_1_error_counter_s "" FLOAT64_IEEE HANcoder_E407_TTA_Controller_v3_CM_double 0 0 -1.7E+308 1.7E+308 ECU_ADDRESS 0x2000c180 /end MEASUREMENT
/begin MEASUREMENT Board_2_error_counter_s "" FLOAT64_IEEE HANcoder_E407_TTA_Controller_v3_CM_double 0 0 -1.7E+308 1.7E+308 ECU_ADDRESS 0x2000bc18 /end MEASUREMENT
/begin MEASUREMENT Board_3_error_counter_s "" FLOAT64_IEEE HANcoder_E407_TTA_Controller_v3_CM_double 0 0 -1.7E+308 1.7E+308 ECU_ADDRESS 0x2000c748 /end MEASUREMENT
/begin MEASUREMENT msg_count_DEBUG_s "" FLOAT64_IEEE HANcoder_E407_TTA_Controller_v3_CM_double 0 0 -1.7E+308 1.7E+308 ECU_ADDRESS 0x2000c128 /end MEASUREMENT
/begin MEASUREMENT Desync_Sync_bc1_s "" FLOAT64_IEEE HANcoder_E407_TTA_Controller_v3_CM_double 0 0 -1.7E+308 1.7E+308 ECU_ADDRESS 0x2000c2a0 /end MEASUREMENT
/begin MEASUREMENT expected_LT_setvalues_CAN1_s "" FLOAT64_IEEE HANcoder_E407_TTA_Controller_v3_CM_double 0 0 -1.7E+308 1.7E+308 ECU_ADDRESS 0x2000bc48 /end MEASUREMENT
/begin MEASUREMENT expected_LT_setvalues_CAN2_s "" FLOAT64_IEEE HANcoder_E407_TTA_Controller_v3_CM_double 0 0 -1.7E+308 1.7E+308 ECU_ADDRESS 0x2000c1d0 /end MEASUREMENT
/begin MEASUREMENT Desync_setvalues_s "" FLOAT64_IEEE HANcoder_E407_TTA_Controller_v3_CM_double 0 0 -1.7E+308 1.7E+308 ECU_ADDRESS 0x2000c338 /end MEASUREMENT
/begin MEASUREMENT Rx_temporal_setvalues_CAN2 "" FLOAT64_IEEE HANcoder_E407_TTA_Controller_v3_CM_double 0 0 -1.7E+308 1.7E+308 ECU_ADDRESS 0x2000c388 /end MEASUREMENT
/begin MEASUREMENT Rx_temporal_setvalues_CAN1 "" FLOAT64_IEEE HANcoder_E407_TTA_Controller_v3_CM_double 0 0 -1.7E+308 1.7E+308 ECU_ADDRESS 0x2000bc08 /end MEASUREMENT
/begin MEASUREMENT expected_LT_sensorvalues_CAN1_s "" FLOAT64_IEEE HANcoder_E407_TTA_Controller_v3_CM_double 0 0 -1.7E+308 1.7E+308 ECU_ADDRESS 0x2000bb40 /end MEASUREMENT
/begin MEASUREMENT expected_LT_sensorvalues_CAN2_s "" FLOAT64_IEEE HANcoder_E407_TTA_Controller_v3_CM_double 0 0 -1.7E+308 1.7E+308 ECU_ADDRESS 0x2000c2f8 /end MEASUREMENT
/begin MEASUREMENT Desync_sensorvalues_s "" FLOAT64_IEEE HANcoder_E407_TTA_Controller_v3_CM_double 0 0 -1.7E+308 1.7E+308 ECU_ADDRESS 0x2000c1b0 /end MEASUREMENT
/begin MEASUREMENT Rx_temporal_sensorvalues_CAN2 "" FLOAT64_IEEE HANcoder_E407_TTA_Controller_v3_CM_double 0 0 -1.7E+308 1.7E+308 ECU_ADDRESS 0x2000c850 /end MEASUREMENT
/begin MEASUREMENT Rx_temporal_sensorvalues_CAN1 "" FLOAT64_IEEE HANcoder_E407_TTA_Controller_v3_CM_double 0 0 -1.7E+308 1.7E+308 ECU_ADDRESS 0x2000c858 /end MEASUREMENT
/begin MEASUREMENT expected_LT_outemulator_CAN1_s "" FLOAT64_IEEE HANcoder_E407_TTA_Controller_v3_CM_double 0 0 -1.7E+308 1.7E+308 ECU_ADDRESS 0x2000bb90 /end MEASUREMENT
/begin MEASUREMENT expected_LT_outemulator_CAN2_s "" FLOAT64_IEEE HANcoder_E407_TTA_Controller_v3_CM_double 0 0 -1.7E+308 1.7E+308 ECU_ADDRESS 0x2000bb30 /end MEASUREMENT
/begin MEASUREMENT Desync_outemulator_s "" FLOAT64_IEEE HANcoder_E407_TTA_Controller_v3_CM_double 0 0 -1.7E+308 1.7E+308 ECU_ADDRESS 0x2000bbb0 /end MEASUREMENT
/begin MEASUREMENT Rx_temporal_outemulator_CAN2 "" FLOAT64_IEEE HANcoder_E407_TTA_Controller_v3_CM_double 0 0 -1.7E+308 1.7E+308 ECU_ADDRESS 0x2000c298 /end MEASUREMENT
/begin MEASUREMENT Rx_temporal_outemulator_CAN1 "" FLOAT64_IEEE HANcoder_E407_TTA_Controller_v3_CM_double 0 0 -1.7E+308 1.7E+308 ECU_ADDRESS 0x2000c090 /end MEASUREMENT
/begin MEASUREMENT expected_LT_outcontrol2_CAN1_s "" FLOAT64_IEEE HANcoder_E407_TTA_Controller_v3_CM_double 0 0 -1.7E+308 1.7E+308 ECU_ADDRESS 0x2000bbe0 /end MEASUREMENT
/begin MEASUREMENT expected_LT_outcontrol2_CAN2_s "" FLOAT64_IEEE HANcoder_E407_TTA_Controller_v3_CM_double 0 0 -1.7E+308 1.7E+308 ECU_ADDRESS 0x2000c190 /end MEASUREMENT
/begin MEASUREMENT Desync_outcontrol2_s "" FLOAT64_IEEE HANcoder_E407_TTA_Controller_v3_CM_double 0 0 -1.7E+308 1.7E+308 ECU_ADDRESS 0x2000c7c0 /end MEASUREMENT
/begin MEASUREMENT Rx_temporal_outcontrol2_CAN2 "" FLOAT64_IEEE HANcoder_E407_TTA_Controller_v3_CM_double 0 0 -1.7E+308 1.7E+308 ECU_ADDRESS 0x2000c368 /end MEASUREMENT
/begin MEASUREMENT Rx_temporal_outcontrol2_CAN1 "" FLOAT64_IEEE HANcoder_E407_TTA_Controller_v3_CM_double 0 0 -1.7E+308 1.7E+308 ECU_ADDRESS 0x2000c1a0 /end MEASUREMENT
/begin MEASUREMENT expected_LT_outcontrol1_CAN1_s "" FLOAT64_IEEE HANcoder_E407_TTA_Controller_v3_CM_double 0 0 -1.7E+308 1.7E+308 ECU_ADDRESS 0x2000c7d0 /end MEASUREMENT
/begin MEASUREMENT expected_LT_outcontrol1_CAN2_s "" FLOAT64_IEEE HANcoder_E407_TTA_Controller_v3_CM_double 0 0 -1.7E+308 1.7E+308 ECU_ADDRESS 0x2000c2c8 /end MEASUREMENT
/begin MEASUREMENT Desync_outcontrol1_s "" FLOAT64_IEEE HANcoder_E407_TTA_Controller_v3_CM_double 0 0 -1.7E+308 1.7E+308 ECU_ADDRESS 0x2000c768 /end MEASUREMENT
/begin MEASUREMENT Rx_temporal_outcontrol1_CAN2 "" FLOAT64_IEEE HANcoder_E407_TTA_Controller_v3_CM_double 0 0 -1.7E+308 1.7E+308 ECU_ADDRESS 0x2000bbe8 /end MEASUREMENT
/begin MEASUREMENT Rx_temporal_outcontrol1_CAN1 "" FLOAT64_IEEE HANcoder_E407_TTA_Controller_v3_CM_double 0 0 -1.7E+308 1.7E+308 ECU_ADDRESS 0x2000bb48 /end MEASUREMENT
/begin MEASUREMENT theta_fr_stored_s "" FLOAT64_IEEE HANcoder_E407_TTA_Controller_v3_CM_double 0 0 -1.7E+308 1.7E+308 ECU_ADDRESS 0x2000c7a0 /end MEASUREMENT
/begin MEASUREMENT theta_fl_stored_s "" FLOAT64_IEEE HANcoder_E407_TTA_Controller_v3_CM_double 0 0 -1.7E+308 1.7E+308 ECU_ADDRESS 0x2000c118 /end MEASUREMENT
/begin MEASUREMENT delta_dot_f_s "" FLOAT64_IEEE HANcoder_E407_TTA_Controller_v3_CM_double 0 0 -1.7E+308 1.7E+308 ECU_ADDRESS 0x2000bb50 /end MEASUREMENT
/begin MEASUREMENT theta_ar_stored_s "" FLOAT64_IEEE HANcoder_E407_TTA_Controller_v3_CM_double 0 0 -1.7E+308 1.7E+308 ECU_ADDRESS 0x2000c778 /end MEASUREMENT
/begin MEASUREMENT theta_al_stored_s "" FLOAT64_IEEE HANcoder_E407_TTA_Controller_v3_CM_double 0 0 -1.7E+308 1.7E+308 ECU_ADDRESS 0x2000c230 /end MEASUREMENT
/begin MEASUREMENT delta_dot_a_s "" FLOAT64_IEEE HANcoder_E407_TTA_Controller_v3_CM_double 0 0 -1.7E+308 1.7E+308 ECU_ADDRESS 0x2000c100 /end MEASUREMENT
/begin MEASUREMENT delta_f_est_current_s "" FLOAT64_IEEE HANcoder_E407_TTA_Controller_v3_CM_double 0 0 -1.7E+308 1.7E+308 ECU_ADDRESS 0x2000c378 /end MEASUREMENT
/begin MEASUREMENT delta_dot_f_prev_s "" FLOAT64_IEEE HANcoder_E407_TTA_Controller_v3_CM_double 0 0 -1.7E+308 1.7E+308 ECU_ADDRESS 0x2000c150 /end MEASUREMENT
/begin MEASUREMENT rx_data_t_steerF_s "" FLOAT64_IEEE HANcoder_E407_TTA_Controller_v3_CM_double 0 0 -1.7E+308 1.7E+308 ECU_ADDRESS 0x2000c0c8 /end MEASUREMENT
/begin MEASUREMENT delta_f_est_s "" FLOAT64_IEEE HANcoder_E407_TTA_Controller_v3_CM_double 0 0 -1.7E+308 1.7E+308 ECU_ADDRESS 0x2000c1f0 /end MEASUREMENT
/begin MEASUREMENT delta_a_est_current_s "" FLOAT64_IEEE HANcoder_E407_TTA_Controller_v3_CM_double 0 0 -1.7E+308 1.7E+308 ECU_ADDRESS 0x2000c168 /end MEASUREMENT
/begin MEASUREMENT delta_dot_a_prev_s "" FLOAT64_IEEE HANcoder_E407_TTA_Controller_v3_CM_double 0 0 -1.7E+308 1.7E+308 ECU_ADDRESS 0x2000c138 /end MEASUREMENT
/begin MEASUREMENT rx_data_t_steerA_s "" FLOAT64_IEEE HANcoder_E407_TTA_Controller_v3_CM_double 0 0 -1.7E+308 1.7E+308 ECU_ADDRESS 0x2000bbc0 /end MEASUREMENT
/begin MEASUREMENT delta_a_est_s "" FLOAT64_IEEE HANcoder_E407_TTA_Controller_v3_CM_double 0 0 -1.7E+308 1.7E+308 ECU_ADDRESS 0x2000c200 /end MEASUREMENT
/begin MEASUREMENT v_est_s "" FLOAT64_IEEE HANcoder_E407_TTA_Controller_v3_CM_double 0 0 -1.7E+308 1.7E+308 ECU_ADDRESS 0x2000c2e8 /end MEASUREMENT
/begin MEASUREMENT v_integral_s "" FLOAT64_IEEE HANcoder_E407_TTA_Controller_v3_CM_double 0 0 -1.7E+308 1.7E+308 ECU_ADDRESS 0x2000bb70 /end MEASUREMENT
/begin MEASUREMENT v_ctreff_s "" FLOAT64_IEEE HANcoder_E407_TTA_Controller_v3_CM_double 0 0 -1.7E+308 1.7E+308 ECU_ADDRESS 0x2000c358 /end MEASUREMENT
/begin MEASUREMENT torque_fr_set_s "" FLOAT64_IEEE HANcoder_E407_TTA_Controller_v3_CM_double 0 0 -1.7E+308 1.7E+308 ECU_ADDRESS 0x2000c318 /end MEASUREMENT
/begin MEASUREMENT torque_fl_set_s "" FLOAT64_IEEE HANcoder_E407_TTA_Controller_v3_CM_double 0 0 -1.7E+308 1.7E+308 ECU_ADDRESS 0x2000c0d8 /end MEASUREMENT
/begin MEASUREMENT torque_ar_set_s "" FLOAT64_IEEE HANcoder_E407_TTA_Controller_v3_CM_double 0 0 -1.7E+308 1.7E+308 ECU_ADDRESS 0x2000c248 /end MEASUREMENT
/begin MEASUREMENT torque_al_set_s "" FLOAT64_IEEE HANcoder_E407_TTA_Controller_v3_CM_double 0 0 -1.7E+308 1.7E+308 ECU_ADDRESS 0x2000c7b0 /end MEASUREMENT
/begin MEASUREMENT expected_LT_vote3_CAN1_s "" FLOAT64_IEEE HANcoder_E407_TTA_Controller_v3_CM_double 0 0 -1.7E+308 1.7E+308 ECU_ADDRESS 0x2000c800 /end MEASUREMENT
/begin MEASUREMENT expected_LT_vote3_CAN2_s "" FLOAT64_IEEE HANcoder_E407_TTA_Controller_v3_CM_double 0 0 -1.7E+308 1.7E+308 ECU_ADDRESS 0x2000c240 /end MEASUREMENT
/begin MEASUREMENT Desync_Vote3_s "" FLOAT64_IEEE HANcoder_E407_TTA_Controller_v3_CM_double 0 0 -1.7E+308 1.7E+308 ECU_ADDRESS 0x2000bbf0 /end MEASUREMENT
/begin MEASUREMENT Rx_temporal_vote3_CAN2 "" FLOAT64_IEEE HANcoder_E407_TTA_Controller_v3_CM_double 0 0 -1.7E+308 1.7E+308 ECU_ADDRESS 0x2000c2b8 /end MEASUREMENT
/begin MEASUREMENT Rx_temporal_vote3_CAN1 "" FLOAT64_IEEE HANcoder_E407_TTA_Controller_v3_CM_double 0 0 -1.7E+308 1.7E+308 ECU_ADDRESS 0x2000c7f0 /end MEASUREMENT
/begin MEASUREMENT expected_LT_vote2_CAN1_s "" FLOAT64_IEEE HANcoder_E407_TTA_Controller_v3_CM_double 0 0 -1.7E+308 1.7E+308 ECU_ADDRESS 0x2000c0e8 /end MEASUREMENT
/begin MEASUREMENT expected_LT_vote2_CAN2_s "" FLOAT64_IEEE HANcoder_E407_TTA_Controller_v3_CM_double 0 0 -1.7E+308 1.7E+308 ECU_ADDRESS 0x2000bc50 /end MEASUREMENT
/begin MEASUREMENT Desync_Vote2_s "" FLOAT64_IEEE HANcoder_E407_TTA_Controller_v3_CM_double 0 0 -1.7E+308 1.7E+308 ECU_ADDRESS 0x2000bbd8 /end MEASUREMENT
/begin MEASUREMENT Rx_temporal_vote2_CAN2 "" FLOAT64_IEEE HANcoder_E407_TTA_Controller_v3_CM_double 0 0 -1.7E+308 1.7E+308 ECU_ADDRESS 0x2000c2c0 /end MEASUREMENT
/begin MEASUREMENT Rx_temporal_vote2_CAN1 "" FLOAT64_IEEE HANcoder_E407_TTA_Controller_v3_CM_double 0 0 -1.7E+308 1.7E+308 ECU_ADDRESS 0x2000c820 /end MEASUREMENT
/begin MEASUREMENT expected_LT_vote1_CAN1_s "" FLOAT64_IEEE HANcoder_E407_TTA_Controller_v3_CM_double 0 0 -1.7E+308 1.7E+308 ECU_ADDRESS 0x2000c328 /end MEASUREMENT
/begin MEASUREMENT expected_LT_vote1_CAN2_s "" FLOAT64_IEEE HANcoder_E407_TTA_Controller_v3_CM_double 0 0 -1.7E+308 1.7E+308 ECU_ADDRESS 0x2000c2d8 /end MEASUREMENT
/begin MEASUREMENT Desync_Vote1_s "" FLOAT64_IEEE HANcoder_E407_TTA_Controller_v3_CM_double 0 0 -1.7E+308 1.7E+308 ECU_ADDRESS 0x2000c788 /end MEASUREMENT
/begin MEASUREMENT Rx_temporal_vote1_CAN2 "" FLOAT64_IEEE HANcoder_E407_TTA_Controller_v3_CM_double 0 0 -1.7E+308 1.7E+308 ECU_ADDRESS 0x2000c220 /end MEASUREMENT
/begin MEASUREMENT Rx_temporal_vote1_CAN1 "" FLOAT64_IEEE HANcoder_E407_TTA_Controller_v3_CM_double 0 0 -1.7E+308 1.7E+308 ECU_ADDRESS 0x2000c170 /end MEASUREMENT
/begin MEASUREMENT Desync_Sync_bc0_s "" FLOAT64_IEEE HANcoder_E407_TTA_Controller_v3_CM_double 0 0 -1.7E+308 1.7E+308 ECU_ADDRESS 0x2000bc20 /end MEASUREMENT
/begin MEASUREMENT TM1_timeout_counter_s "" FLOAT64_IEEE HANcoder_E407_TTA_Controller_v3_CM_double 0 0 -1.7E+308 1.7E+308 ECU_ADDRESS 0x2000c108 /end MEASUREMENT
/begin MEASUREMENT TM2_timeout_counter_s "" FLOAT64_IEEE HANcoder_E407_TTA_Controller_v3_CM_double 0 0 -1.7E+308 1.7E+308 ECU_ADDRESS 0x2000c348 /end MEASUREMENT
/begin MEASUREMENT TM3_timeout_counter_s "" FLOAT64_IEEE HANcoder_E407_TTA_Controller_v3_CM_double 0 0 -1.7E+308 1.7E+308 ECU_ADDRESS 0x2000c1c8 /end MEASUREMENT
/begin MEASUREMENT Rx_msg_ticks_sensorvalues_CAN1_vem_s "" UWORD HANcoder_E407_TTA_Controller_v3_CM_uint16 0 0 0 65535 ECU_ADDRESS 0x2000bc40 /end MEASUREMENT
/begin MEASUREMENT Rx_msg_ticks_sensorvalues_CAN2_vem_s "" UWORD HANcoder_E407_TTA_Controller_v3_CM_uint16 0 0 0 65535 ECU_ADDRESS 0x2000c7fc /end MEASUREMENT
/begin MEASUREMENT Rx_msg_ticks_setvalues_CAN1_s "" UWORD HANcoder_E407_TTA_Controller_v3_CM_uint16 0 0 0 65535 ECU_ADDRESS 0x2000c864 /end MEASUREMENT
/begin MEASUREMENT Rx_msg_ticks_setvalues_CAN2_s "" UWORD HANcoder_E407_TTA_Controller_v3_CM_uint16 0 0 0 65535 ECU_ADDRESS 0x2000bc34 /end MEASUREMENT
/begin MEASUREMENT Rx_msg_ticks_sensorvalues_CAN1_s "" UWORD HANcoder_E407_TTA_Controller_v3_CM_uint16 0 0 0 65535 ECU_ADDRESS 0x2000c3a0 /end MEASUREMENT
/begin MEASUREMENT Rx_msg_ticks_sensorvalues_CAN2_s "" UWORD HANcoder_E407_TTA_Controller_v3_CM_uint16 0 0 0 65535 ECU_ADDRESS 0x2000bb6a /end MEASUREMENT
/begin MEASUREMENT Rx_msg_ticks_outemulator_CAN1_s "" UWORD HANcoder_E407_TTA_Controller_v3_CM_uint16 0 0 0 65535 ECU_ADDRESS 0x2000bb18 /end MEASUREMENT
/begin MEASUREMENT Rx_msg_ticks_outemulator_CAN2_s "" UWORD HANcoder_E407_TTA_Controller_v3_CM_uint16 0 0 0 65535 ECU_ADDRESS 0x2000c17a /end MEASUREMENT
/begin MEASUREMENT Rx_msg_ticks_outcontrol2_CAN1_s "" UWORD HANcoder_E407_TTA_Controller_v3_CM_uint16 0 0 0 65535 ECU_ADDRESS 0x2000c350 /end MEASUREMENT
/begin MEASUREMENT Rx_msg_ticks_outcontrol2_CAN2_s "" UWORD HANcoder_E407_TTA_Controller_v3_CM_uint16 0 0 0 65535 ECU_ADDRESS 0x2000c7ec /end MEASUREMENT
/begin MEASUREMENT Rx_msg_ticks_outcontrol1_CAN1_s "" UWORD HANcoder_E407_TTA_Controller_v3_CM_uint16 0 0 0 65535 ECU_ADDRESS 0x2000c2e2 /end MEASUREMENT
/begin MEASUREMENT Rx_msg_ticks_outcontrol1_CAN2_s "" UWORD HANcoder_E407_TTA_Controller_v3_CM_uint16 0 0 0 65535 ECU_ADDRESS 0x2000c0f0 /end MEASUREMENT
/begin MEASUREMENT Rx_msg_ticks_vote3_CAN1_s "" UWORD HANcoder_E407_TTA_Controller_v3_CM_uint16 0 0 0 65535 ECU_ADDRESS 0x2000c840 /end MEASUREMENT
/begin MEASUREMENT Rx_msg_ticks_vote3_CAN2_s "" UWORD HANcoder_E407_TTA_Controller_v3_CM_uint16 0 0 0 65535 ECU_ADDRESS 0x2000c2f0 /end MEASUREMENT
/begin MEASUREMENT Rx_msg_ticks_vote2_CAN1_s "" UWORD HANcoder_E407_TTA_Controller_v3_CM_uint16 0 0 0 65535 ECU_ADDRESS 0x2000bb98 /end MEASUREMENT
/begin MEASUREMENT Rx_msg_ticks_vote2_CAN2_s "" UWORD HANcoder_E407_TTA_Controller_v3_CM_uint16 0 0 0 65535 ECU_ADDRESS 0x2000c27c /end MEASUREMENT
/begin MEASUREMENT Rx_msg_ticks_vote1_CAN1_s "" UWORD HANcoder_E407_TTA_Controller_v3_CM_uint16 0 0 0 65535 ECU_ADDRESS 0x2000c330 /end MEASUREMENT
/begin MEASUREMENT Rx_msg_ticks_vote1_CAN2_s "" UWORD HANcoder_E407_TTA_Controller_v3_CM_uint16 0 0 0 65535 ECU_ADDRESS 0x2000c21c /end MEASUREMENT
/begin MEASUREMENT Rx_init_LT "" UWORD HANcoder_E407_TTA_Controller_v3_CM_uint16 0 0 0 65535 ECU_ADDRESS 0x2000c2b0 /end MEASUREMENT
/begin MEASUREMENT Rx_id_sync1_CAN2_vem "" UBYTE HANcoder_E407_TTA_Controller_v3_CM_uint8 0 0 0 255 ECU_ADDRESS 0x2000c189 /end MEASUREMENT
/begin MEASUREMENT Rx_mc_sync1_CAN2_vem "" UBYTE HANcoder_E407_TTA_Controller_v3_CM_uint8 0 0 0 255 ECU_ADDRESS 0x2000c110 /end MEASUREMENT
/begin MEASUREMENT Rx_bc_sync1_CAN2_vem "" UBYTE HANcoder_E407_TTA_Controller_v3_CM_uint8 0 0 0 255 ECU_ADDRESS 0x2000c340 /end MEASUREMENT
/begin MEASUREMENT Rx_id_sync1_CAN1_vem "" UBYTE HANcoder_E407_TTA_Controller_v3_CM_uint8 0 0 0 255 ECU_ADDRESS 0x2000c0c1 /end MEASUREMENT
/begin MEASUREMENT Rx_mc_sync1_CAN1_vem "" UBYTE HANcoder_E407_TTA_Controller_v3_CM_uint8 0 0 0 255 ECU_ADDRESS 0x2000c861 /end MEASUREMENT
/begin MEASUREMENT Rx_bc_sync1_CAN1_vem "" UBYTE HANcoder_E407_TTA_Controller_v3_CM_uint8 0 0 0 255 ECU_ADDRESS 0x2000c7ee /end MEASUREMENT
/begin MEASUREMENT Rx_id_sensorvalues_CAN2_vem "" UBYTE HANcoder_E407_TTA_Controller_v3_CM_uint8 0 0 0 255 ECU_ADDRESS 0x2000c799 /end MEASUREMENT
/begin MEASUREMENT Rx_mc_sensorvalues_CAN2_vem "" UBYTE HANcoder_E407_TTA_Controller_v3_CM_uint8 0 0 0 255 ECU_ADDRESS 0x2000c819 /end MEASUREMENT
/begin MEASUREMENT Rx_bc_sensorvalues_CAN2_vem "" UBYTE HANcoder_E407_TTA_Controller_v3_CM_uint8 0 0 0 255 ECU_ADDRESS 0x2000bc3c /end MEASUREMENT
/begin MEASUREMENT Rx_id_sensorvalues_CAN1_vem "" UBYTE HANcoder_E407_TTA_Controller_v3_CM_uint8 0 0 0 255 ECU_ADDRESS 0x2000c2d2 /end MEASUREMENT
/begin MEASUREMENT Rx_mc_sensorvalues_CAN1_vem "" UBYTE HANcoder_E407_TTA_Controller_v3_CM_uint8 0 0 0 255 ECU_ADDRESS 0x2000c188 /end MEASUREMENT
/begin MEASUREMENT Rx_bc_sensorvalues_CAN1_vem "" UBYTE HANcoder_E407_TTA_Controller_v3_CM_uint8 0 0 0 255 ECU_ADDRESS 0x2000bb59 /end MEASUREMENT
/begin MEASUREMENT Rx_id_sync0_CAN2_vem "" UBYTE HANcoder_E407_TTA_Controller_v3_CM_uint8 0 0 0 255 ECU_ADDRESS 0x2000c210 /end MEASUREMENT
/begin MEASUREMENT Rx_mc_sync0_CAN2_vem "" UBYTE HANcoder_E407_TTA_Controller_v3_CM_uint8 0 0 0 255 ECU_ADDRESS 0x2000c0b2 /end MEASUREMENT
/begin MEASUREMENT Rx_bc_sync0_CAN2_vem "" UBYTE HANcoder_E407_TTA_Controller_v3_CM_uint8 0 0 0 255 ECU_ADDRESS 0x2000c1d9 /end MEASUREMENT
/begin MEASUREMENT Rx_id_sync0_CAN1_vem "" UBYTE HANcoder_E407_TTA_Controller_v3_CM_uint8 0 0 0 255 ECU_ADDRESS 0x2000c780 /end MEASUREMENT
/begin MEASUREMENT Rx_mc_sync0_CAN1_vem "" UBYTE HANcoder_E407_TTA_Controller_v3_CM_uint8 0 0 0 255 ECU_ADDRESS 0x2000c098 /end MEASUREMENT
/begin MEASUREMENT Rx_bc_sync0_CAN1_vem "" UBYTE HANcoder_E407_TTA_Controller_v3_CM_uint8 0 0 0 255 ECU_ADDRESS 0x2000bbfa /end MEASUREMENT
/begin MEASUREMENT Rx_id_sync1_CAN2_ing "" UBYTE HANcoder_E407_TTA_Controller_v3_CM_uint8 0 0 0 255 ECU_ADDRESS 0x2000c761 /end MEASUREMENT
/begin MEASUREMENT Rx_mc_sync1_CAN2_ing "" UBYTE HANcoder_E407_TTA_Controller_v3_CM_uint8 0 0 0 255 ECU_ADDRESS 0x2000c770 /end MEASUREMENT
/begin MEASUREMENT Rx_bc_sync1_CAN2_ing "" UBYTE HANcoder_E407_TTA_Controller_v3_CM_uint8 0 0 0 255 ECU_ADDRESS 0x2000c79a /end MEASUREMENT
/begin MEASUREMENT Rx_id_sync1_CAN1_ing "" UBYTE HANcoder_E407_TTA_Controller_v3_CM_uint8 0 0 0 255 ECU_ADDRESS 0x2000c390 /end MEASUREMENT
/begin MEASUREMENT Rx_mc_sync1_CAN1_ing "" UBYTE HANcoder_E407_TTA_Controller_v3_CM_uint8 0 0 0 255 ECU_ADDRESS 0x2000c158 /end MEASUREMENT
/begin MEASUREMENT Rx_bc_sync1_CAN1_ing "" UBYTE HANcoder_E407_TTA_Controller_v3_CM_uint8 0 0 0 255 ECU_ADDRESS 0x2000c17c /end MEASUREMENT
/begin MEASUREMENT Rx_id_sync0_CAN2_ing "" UBYTE HANcoder_E407_TTA_Controller_v3_CM_uint8 0 0 0 255 ECU_ADDRESS 0x2000c1ea /end MEASUREMENT
/begin MEASUREMENT Rx_mc_sync0_CAN2_ing "" UBYTE HANcoder_E407_TTA_Controller_v3_CM_uint8 0 0 0 255 ECU_ADDRESS 0x2000c7d8 /end MEASUREMENT
/begin MEASUREMENT Rx_bc_sync0_CAN2_ing "" UBYTE HANcoder_E407_TTA_Controller_v3_CM_uint8 0 0 0 255 ECU_ADDRESS 0x2000c3a2 /end MEASUREMENT
/begin MEASUREMENT Rx_id_sync0_CAN1_ing "" UBYTE HANcoder_E407_TTA_Controller_v3_CM_uint8 0 0 0 255 ECU_ADDRESS 0x2000c2f3 /end MEASUREMENT
/begin MEASUREMENT Rx_mc_sync0_CAN1_ing "" UBYTE HANcoder_E407_TTA_Controller_v3_CM_uint8 0 0 0 255 ECU_ADDRESS 0x2000c229 /end MEASUREMENT
/begin MEASUREMENT Rx_bc_sync0_CAN1_ing "" UBYTE HANcoder_E407_TTA_Controller_v3_CM_uint8 0 0 0 255 ECU_ADDRESS 0x2000c22e /end MEASUREMENT
/begin MEASUREMENT TMR_miss1_set "" UBYTE HANcoder_E407_TTA_Controller_v3_CM_uint8 0 0 0 255 ECU_ADDRESS 0x2000c7e8 /end MEASUREMENT
/begin MEASUREMENT TMR_miss2_set "" UBYTE HANcoder_E407_TTA_Controller_v3_CM_uint8 0 0 0 255 ECU_ADDRESS 0x2000c0e0 /end MEASUREMENT
/begin MEASUREMENT TMR_miss1_sensor "" UBYTE HANcoder_E407_TTA_Controller_v3_CM_uint8 0 0 0 255 ECU_ADDRESS 0x2000c278 /end MEASUREMENT
/begin MEASUREMENT TMR_miss2_sensor "" UBYTE HANcoder_E407_TTA_Controller_v3_CM_uint8 0 0 0 255 ECU_ADDRESS 0x2000c301 /end MEASUREMENT
/begin MEASUREMENT error_log1_s "" UBYTE HANcoder_E407_TTA_Controller_v3_CM_uint8 0 0 0 255 ECU_ADDRESS 0x2000c760 /end MEASUREMENT
/begin MEASUREMENT error_log2_s "" UBYTE HANcoder_E407_TTA_Controller_v3_CM_uint8 0 0 0 255 ECU_ADDRESS 0x2000c2f4 /end MEASUREMENT
/begin MEASUREMENT error_log3_s "" UBYTE HANcoder_E407_TTA_Controller_v3_CM_uint8 0 0 0 255 ECU_ADDRESS 0x2000c380 /end MEASUREMENT
/begin MEASUREMENT shift7_s "" UBYTE HANcoder_E407_TTA_Controller_v3_CM_uint8 0 0 0 255 ECU_ADDRESS 0x2000bb2a /end MEASUREMENT
/begin MEASUREMENT shift6_s "" UBYTE HANcoder_E407_TTA_Controller_v3_CM_uint8 0 0 0 255 ECU_ADDRESS 0x2000c2f2 /end MEASUREMENT
/begin MEASUREMENT shift5_s "" UBYTE HANcoder_E407_TTA_Controller_v3_CM_uint8 0 0 0 255 ECU_ADDRESS 0x2000c0c0 /end MEASUREMENT
/begin MEASUREMENT shift4_s "" UBYTE HANcoder_E407_TTA_Controller_v3_CM_uint8 0 0 0 255 ECU_ADDRESS 0x2000bb5e /end MEASUREMENT
/begin MEASUREMENT shift3_s "" UBYTE HANcoder_E407_TTA_Controller_v3_CM_uint8 0 0 0 255 ECU_ADDRESS 0x2000c781 /end MEASUREMENT
/begin MEASUREMENT shift2_s "" UBYTE HANcoder_E407_TTA_Controller_v3_CM_uint8 0 0 0 255 ECU_ADDRESS 0x2000c19a /end MEASUREMENT
/begin MEASUREMENT shift1_s "" UBYTE HANcoder_E407_TTA_Controller_v3_CM_uint8 0 0 0 255 ECU_ADDRESS 0x2000bb38 /end MEASUREMENT
/begin MEASUREMENT Rx_id_sync1_CAN2 "" UBYTE HANcoder_E407_TTA_Controller_v3_CM_uint8 0 0 0 255 ECU_ADDRESS 0x2000c250 /end MEASUREMENT
/begin MEASUREMENT Rx_mc_sync1_CAN2 "" UBYTE HANcoder_E407_TTA_Controller_v3_CM_uint8 0 0 0 255 ECU_ADDRESS 0x2000c148 /end MEASUREMENT
/begin MEASUREMENT Rx_bc_sync1_CAN2 "" UBYTE HANcoder_E407_TTA_Controller_v3_CM_uint8 0 0 0 255 ECU_ADDRESS 0x2000c7e9 /end MEASUREMENT
/begin MEASUREMENT Rx_id_sync1_CAN1 "" UBYTE HANcoder_E407_TTA_Controller_v3_CM_uint8 0 0 0 255 ECU_ADDRESS 0x2000c310 /end MEASUREMENT
/begin MEASUREMENT Rx_mc_sync1_CAN1 "" UBYTE HANcoder_E407_TTA_Controller_v3_CM_uint8 0 0 0 255 ECU_ADDRESS 0x2000c860 /end MEASUREMENT
/begin MEASUREMENT Rx_bc_sync1_CAN1 "" UBYTE HANcoder_E407_TTA_Controller_v3_CM_uint8 0 0 0 255 ECU_ADDRESS 0x2000c0ac /end MEASUREMENT
/begin MEASUREMENT Rx_id_setvalues_CAN2 "" UBYTE HANcoder_E407_TTA_Controller_v3_CM_uint8 0 0 0 255 ECU_ADDRESS 0x2000c7a9 /end MEASUREMENT
/begin MEASUREMENT Rx_mc_setvalues_CAN2 "" UBYTE HANcoder_E407_TTA_Controller_v3_CM_uint8 0 0 0 255 ECU_ADDRESS 0x2000c159 /end MEASUREMENT
/begin MEASUREMENT Rx_bc_setvalues_CAN2 "" UBYTE HANcoder_E407_TTA_Controller_v3_CM_uint8 0 0 0 255 ECU_ADDRESS 0x2000c214 /end MEASUREMENT
/begin MEASUREMENT Rx_id_setvalues_CAN1 "" UBYTE HANcoder_E407_TTA_Controller_v3_CM_uint8 0 0 0 255 ECU_ADDRESS 0x2000bc3d /end MEASUREMENT
/begin MEASUREMENT Rx_mc_setvalues_CAN1 "" UBYTE HANcoder_E407_TTA_Controller_v3_CM_uint8 0 0 0 255 ECU_ADDRESS 0x2000c846 /end MEASUREMENT
/begin MEASUREMENT Rx_bc_setvalues_CAN1 "" UBYTE HANcoder_E407_TTA_Controller_v3_CM_uint8 0 0 0 255 ECU_ADDRESS 0x2000c785 /end MEASUREMENT
/begin MEASUREMENT Rx_id_sensorvalues_CAN2 "" UBYTE HANcoder_E407_TTA_Controller_v3_CM_uint8 0 0 0 255 ECU_ADDRESS 0x2000c341 /end MEASUREMENT
/begin MEASUREMENT Rx_mc_sensorvalues_CAN2 "" UBYTE HANcoder_E407_TTA_Controller_v3_CM_uint8 0 0 0 255 ECU_ADDRESS 0x2000c178 /end MEASUREMENT
/begin MEASUREMENT Rx_bc_sensorvalues_CAN2 "" UBYTE HANcoder_E407_TTA_Controller_v3_CM_uint8 0 0 0 255 ECU_ADDRESS 0x2000bc42 /end MEASUREMENT
/begin MEASUREMENT Rx_id_sensorvalues_CAN1 "" UBYTE HANcoder_E407_TTA_Controller_v3_CM_uint8 0 0 0 255 ECU_ADDRESS 0x2000c268 /end MEASUREMENT
/begin MEASUREMENT Rx_mc_sensorvalues_CAN1 "" UBYTE HANcoder_E407_TTA_Controller_v3_CM_uint8 0 0 0 255 ECU_ADDRESS 0x2000c798 /end MEASUREMENT
/begin MEASUREMENT Rx_bc_sensorvalues_CAN1 "" UBYTE HANcoder_E407_TTA_Controller_v3_CM_uint8 0 0 0 255 ECU_ADDRESS 0x2000bb5b /end MEASUREMENT
/begin MEASUREMENT Rx_id_outemulator_CAN2 "" UBYTE HANcoder_E407_TTA_Controller_v3_CM_uint8 0 0 0 255 ECU_ADDRESS 0x2000c808 /end MEASUREMENT
/begin MEASUREMENT Rx_mc_outemulator_CAN2 "" UBYTE HANcoder_E407_TTA_Controller_v3_CM_uint8 0 0 0 255 ECU_ADDRESS 0x2000c199 /end MEASUREMENT
/begin MEASUREMENT Rx_bc_outemulator_CAN2 "" UBYTE HANcoder_E407_TTA_Controller_v3_CM_uint8 0 0 0 255 ECU_ADDRESS 0x2000c782 /end MEASUREMENT
/begin MEASUREMENT Rx_id_outemulator_CAN1 "" UBYTE HANcoder_E407_TTA_Controller_v3_CM_uint8 0 0 0 255 ECU_ADDRESS 0x2000c252 /end MEASUREMENT
/begin MEASUREMENT Rx_mc_outemulator_CAN1 "" UBYTE HANcoder_E407_TTA_Controller_v3_CM_uint8 0 0 0 255 ECU_ADDRESS 0x2000c784 /end MEASUREMENT
/begin MEASUREMENT Rx_bc_outemulator_CAN1 "" UBYTE HANcoder_E407_TTA_Controller_v3_CM_uint8 0 0 0 255 ECU_ADDRESS 0x2000c1b8 /end MEASUREMENT
/begin MEASUREMENT Rx_id_outcontrol2_CAN2 "" UBYTE HANcoder_E407_TTA_Controller_v3_CM_uint8 0 0 0 255 ECU_ADDRESS 0x2000c750 /end MEASUREMENT
/begin MEASUREMENT Rx_mc_outcontrol2_CAN2 "" UBYTE HANcoder_E407_TTA_Controller_v3_CM_uint8 0 0 0 255 ECU_ADDRESS 0x2000c2ad /end MEASUREMENT
/begin MEASUREMENT Rx_bc_outcontrol2_CAN2 "" UBYTE HANcoder_E407_TTA_Controller_v3_CM_uint8 0 0 0 255 ECU_ADDRESS 0x2000c0ae /end MEASUREMENT
/begin MEASUREMENT Rx_id_outcontrol2_CAN1 "" UBYTE HANcoder_E407_TTA_Controller_v3_CM_uint8 0 0 0 255 ECU_ADDRESS 0x2000bba8 /end MEASUREMENT
/begin MEASUREMENT Rx_mc_outcontrol2_CAN1 "" UBYTE HANcoder_E407_TTA_Controller_v3_CM_uint8 0 0 0 255 ECU_ADDRESS 0x2000c848 /end MEASUREMENT
/begin MEASUREMENT Rx_bc_outcontrol2_CAN1 "" UBYTE HANcoder_E407_TTA_Controller_v3_CM_uint8 0 0 0 255 ECU_ADDRESS 0x2000c238 /end MEASUREMENT
/begin MEASUREMENT Rx_id_outcontrol1_CAN2 "" UBYTE HANcoder_E407_TTA_Controller_v3_CM_uint8 0 0 0 255 ECU_ADDRESS 0x2000c0e1 /end MEASUREMENT
/begin MEASUREMENT Rx_mc_outcontrol1_CAN2 "" UBYTE HANcoder_E407_TTA_Controller_v3_CM_uint8 0 0 0 255 ECU_ADDRESS 0x2000c21a /end MEASUREMENT
/begin MEASUREMENT Rx_bc_outcontrol1_CAN2 "" UBYTE HANcoder_E407_TTA_Controller_v3_CM_uint8 0 0 0 255 ECU_ADDRESS 0x2000c2d5 /end MEASUREMENT
/begin MEASUREMENT Rx_id_outcontrol1_CAN1 "" UBYTE HANcoder_E407_TTA_Controller_v3_CM_uint8 0 0 0 255 ECU_ADDRESS 0x2000c2ac /end MEASUREMENT
/begin MEASUREMENT Rx_mc_outcontrol1_CAN1 "" UBYTE HANcoder_E407_TTA_Controller_v3_CM_uint8 0 0 0 255 ECU_ADDRESS 0x2000c365 /end MEASUREMENT
/begin MEASUREMENT Rx_bc_outcontrol1_CAN1 "" UBYTE HANcoder_E407_TTA_Controller_v3_CM_uint8 0 0 0 255 ECU_ADDRESS 0x2000c2e0 /end MEASUREMENT
/begin MEASUREMENT Rx_id_vote3_CAN2 "" UBYTE HANcoder_E407_TTA_Controller_v3_CM_uint8 0 0 0 255 ECU_ADDRESS 0x2000c862 /end MEASUREMENT
/begin MEASUREMENT Rx_mc_vote3_CAN2 "" UBYTE HANcoder_E407_TTA_Controller_v3_CM_uint8 0 0 0 255 ECU_ADDRESS 0x2000bc3e /end MEASUREMENT
/begin MEASUREMENT Rx_bc_vote3_CAN2 "" UBYTE HANcoder_E407_TTA_Controller_v3_CM_uint8 0 0 0 255 ECU_ADDRESS 0x2000c790 /end MEASUREMENT
/begin MEASUREMENT Rx_id_vote3_CAN1 "" UBYTE HANcoder_E407_TTA_Controller_v3_CM_uint8 0 0 0 255 ECU_ADDRESS 0x2000c818 /end MEASUREMENT
/begin MEASUREMENT Rx_mc_vote3_CAN1 "" UBYTE HANcoder_E407_TTA_Controller_v3_CM_uint8 0 0 0 255 ECU_ADDRESS 0x2000c7ea /end MEASUREMENT
/begin MEASUREMENT Rx_bc_vote3_CAN1 "" UBYTE HANcoder_E407_TTA_Controller_v3_CM_uint8 0 0 0 255 ECU_ADDRESS 0x2000bc10 /end MEASUREMENT
/begin MEASUREMENT Rx_id_vote2_CAN2 "" UBYTE HANcoder_E407_TTA_Controller_v3_CM_uint8 0 0 0 255 ECU_ADDRESS 0x2000c740 /end MEASUREMENT
/begin MEASUREMENT Rx_mc_vote2_CAN2 "" UBYTE HANcoder_E407_TTA_Controller_v3_CM_uint8 0 0 0 255 ECU_ADDRESS 0x2000bbc8 /end MEASUREMENT
/begin MEASUREMENT Rx_bc_vote2_CAN2 "" UBYTE HANcoder_E407_TTA_Controller_v3_CM_uint8 0 0 0 255 ECU_ADDRESS 0x2000c300 /end MEASUREMENT
/begin MEASUREMENT Rx_id_vote2_CAN1 "" UBYTE HANcoder_E407_TTA_Controller_v3_CM_uint8 0 0 0 255 ECU_ADDRESS 0x2000bbf9 /end MEASUREMENT
/begin MEASUREMENT Rx_mc_vote2_CAN1 "" UBYTE HANcoder_E407_TTA_Controller_v3_CM_uint8 0 0 0 255 ECU_ADDRESS 0x2000c1d8 /end MEASUREMENT
/begin MEASUREMENT Rx_bc_vote2_CAN1 "" UBYTE HANcoder_E407_TTA_Controller_v3_CM_uint8 0 0 0 255 ECU_ADDRESS 0x2000c870 /end MEASUREMENT
/begin MEASUREMENT Rx_id_vote1_CAN2 "" UBYTE HANcoder_E407_TTA_Controller_v3_CM_uint8 0 0 0 255 ECU_ADDRESS 0x2000c311 /end MEASUREMENT
/begin MEASUREMENT Rx_mc_vote1_CAN2 "" UBYTE HANcoder_E407_TTA_Controller_v3_CM_uint8 0 0 0 255 ECU_ADDRESS 0x2000c22d /end MEASUREMENT
/begin MEASUREMENT Rx_bc_vote1_CAN2 "" UBYTE HANcoder_E407_TTA_Controller_v3_CM_uint8 0 0 0 255 ECU_ADDRESS 0x2000c130 /end MEASUREMENT
/begin MEASUREMENT Rx_id_vote1_CAN1 "" UBYTE HANcoder_E407_TTA_Controller_v3_CM_uint8 0 0 0 255 ECU_ADDRESS 0x2000bb5a /end MEASUREMENT
/begin MEASUREMENT Rx_mc_vote1_CAN1 "" UBYTE HANcoder_E407_TTA_Controller_v3_CM_uint8 0 0 0 255 ECU_ADDRESS 0x2000c279 /end MEASUREMENT
/begin MEASUREMENT Rx_bc_vote1_CAN1 "" UBYTE HANcoder_E407_TTA_Controller_v3_CM_uint8 0 0 0 255 ECU_ADDRESS 0x2000c847 /end MEASUREMENT
/begin MEASUREMENT Vote_s "" UBYTE HANcoder_E407_TTA_Controller_v3_CM_uint8 0 0 0 255 ECU_ADDRESS 0x2000bb29 /end MEASUREMENT
/begin MEASUREMENT Rx_id_sync0_CAN2 "" UBYTE HANcoder_E407_TTA_Controller_v3_CM_uint8 0 0 0 255 ECU_ADDRESS 0x2000bbf8 /end MEASUREMENT
/begin MEASUREMENT Rx_mc_sync0_CAN2 "" UBYTE HANcoder_E407_TTA_Controller_v3_CM_uint8 0 0 0 255 ECU_ADDRESS 0x2000c228 /end MEASUREMENT
/begin MEASUREMENT Rx_bc_sync0_CAN2 "" UBYTE HANcoder_E407_TTA_Controller_v3_CM_uint8 0 0 0 255 ECU_ADDRESS 0x2000c2d4 /end MEASUREMENT
/begin MEASUREMENT Rx_id_sync0_CAN1 "" UBYTE HANcoder_E407_TTA_Controller_v3_CM_uint8 0 0 0 255 ECU_ADDRESS 0x2000c213 /end MEASUREMENT
/begin MEASUREMENT Rx_mc_sync0_CAN1 "" UBYTE HANcoder_E407_TTA_Controller_v3_CM_uint8 0 0 0 255 ECU_ADDRESS 0x2000bbb8 /end MEASUREMENT
/begin MEASUREMENT Rx_bc_sync0_CAN1 "" UBYTE HANcoder_E407_TTA_Controller_v3_CM_uint8 0 0 0 255 ECU_ADDRESS 0x2000c2d0 /end MEASUREMENT
/begin MEASUREMENT Rx_init_id "" UBYTE HANcoder_E407_TTA_Controller_v3_CM_uint8 0 0 0 255 ECU_ADDRESS 0x2000c783 /end MEASUREMENT
/begin MEASUREMENT Rx_init_mc "" UBYTE HANcoder_E407_TTA_Controller_v3_CM_uint8 0 0 0 255 ECU_ADDRESS 0x2000c7c9 /end MEASUREMENT
/begin MEASUREMENT Rx_init_bc "" UBYTE HANcoder_E407_TTA_Controller_v3_CM_uint8 0 0 0 255 ECU_ADDRESS 0x2000c198 /end MEASUREMENT
/begin MEASUREMENT bacic_cycle_s "" UBYTE HANcoder_E407_TTA_Controller_v3_CM_uint8 0 0 0 255 ECU_ADDRESS 0x2000c17d /end MEASUREMENT
/begin MEASUREMENT BC1_sync_processed_vem__s "" UBYTE HANcoder_E407_TTA_Controller_v3_CM_boolean 0 0 0 1 ECU_ADDRESS 0x2000bb89 /end MEASUREMENT
/begin MEASUREMENT BC0_sync_processed_vem__s "" UBYTE HANcoder_E407_TTA_Controller_v3_CM_boolean 0 0 0 1 ECU_ADDRESS 0x2000c0b3 /end MEASUREMENT
/begin MEASUREMENT new_sensor_rx_vem_s "" UBYTE HANcoder_E407_TTA_Controller_v3_CM_boolean 0 0 0 1 ECU_ADDRESS 0x2000bb78 /end MEASUREMENT
/begin MEASUREMENT reset_vem_s "" UBYTE HANcoder_E407_TTA_Controller_v3_CM_boolean 0 0 0 1 ECU_ADDRESS 0x2000c0d0 /end MEASUREMENT
/begin MEASUREMENT BC1_sync_processed_ing_s "" UBYTE HANcoder_E407_TTA_Controller_v3_CM_boolean 0 0 0 1 ECU_ADDRESS 0x2000c320 /end MEASUREMENT
/begin MEASUREMENT BC0_sync_processed_ing_s "" UBYTE HANcoder_E407_TTA_Controller_v3_CM_boolean 0 0 0 1 ECU_ADDRESS 0x2000c786 /end MEASUREMENT
/begin MEASUREMENT reset_bc1_ing_s "" UBYTE HANcoder_E407_TTA_Controller_v3_CM_boolean 0 0 0 1 ECU_ADDRESS 0x2000c0d2 /end MEASUREMENT
/begin MEASUREMENT reset_ing_s "" UBYTE HANcoder_E407_TTA_Controller_v3_CM_boolean 0 0 0 1 ECU_ADDRESS 0x2000c1eb /end MEASUREMENT
/begin MEASUREMENT BC1_sync_processed_s "" UBYTE HANcoder_E407_TTA_Controller_v3_CM_boolean 0 0 0 1 ECU_ADDRESS 0x2000c7a8 /end MEASUREMENT
/begin MEASUREMENT BC0_sync_processed_s "" UBYTE HANcoder_E407_TTA_Controller_v3_CM_boolean 0 0 0 1 ECU_ADDRESS 0x2000bb5c /end MEASUREMENT
/begin MEASUREMENT BC0_vote1_processed_s "" UBYTE HANcoder_E407_TTA_Controller_v3_CM_boolean 0 0 0 1 ECU_ADDRESS 0x2000c251 /end MEASUREMENT
/begin MEASUREMENT BC0_vote2_processed_s "" UBYTE HANcoder_E407_TTA_Controller_v3_CM_boolean 0 0 0 1 ECU_ADDRESS 0x2000c370 /end MEASUREMENT
/begin MEASUREMENT BC0_vote3_processed_s "" UBYTE HANcoder_E407_TTA_Controller_v3_CM_boolean 0 0 0 1 ECU_ADDRESS 0x2000c269 /end MEASUREMENT
/begin MEASUREMENT TMR_miss_set "" UBYTE HANcoder_E407_TTA_Controller_v3_CM_boolean 0 0 0 1 ECU_ADDRESS 0x2000c0ad /end MEASUREMENT
/begin MEASUREMENT TMR_miss_sensor "" UBYTE HANcoder_E407_TTA_Controller_v3_CM_boolean 0 0 0 1 ECU_ADDRESS 0x2000c1ba /end MEASUREMENT
/begin MEASUREMENT TMR_miss_out1 "" UBYTE HANcoder_E407_TTA_Controller_v3_CM_boolean 0 0 0 1 ECU_ADDRESS 0x2000c22f /end MEASUREMENT
/begin MEASUREMENT TMR_miss_out2 "" UBYTE HANcoder_E407_TTA_Controller_v3_CM_boolean 0 0 0 1 ECU_ADDRESS 0x2000c2d3 /end MEASUREMENT
/begin MEASUREMENT tau_fr_agree_s "" UBYTE HANcoder_E407_TTA_Controller_v3_CM_boolean 0 0 0 1 ECU_ADDRESS 0x2000c7c8 /end MEASUREMENT
/begin MEASUREMENT tau_fl_agree_s "" UBYTE HANcoder_E407_TTA_Controller_v3_CM_boolean 0 0 0 1 ECU_ADDRESS 0x2000bb28 /end MEASUREMENT
/begin MEASUREMENT tau_ar_agree_s "" UBYTE HANcoder_E407_TTA_Controller_v3_CM_boolean 0 0 0 1 ECU_ADDRESS 0x2000c0af /end MEASUREMENT
/begin MEASUREMENT tau_al_agree_s "" UBYTE HANcoder_E407_TTA_Controller_v3_CM_boolean 0 0 0 1 ECU_ADDRESS 0x2000c1b9 /end MEASUREMENT
/begin MEASUREMENT tau_fr2_agree_s "" UBYTE HANcoder_E407_TTA_Controller_v3_CM_boolean 0 0 0 1 ECU_ADDRESS 0x2000c2d1 /end MEASUREMENT
/begin MEASUREMENT tau_fl2_agree_s "" UBYTE HANcoder_E407_TTA_Controller_v3_CM_boolean 0 0 0 1 ECU_ADDRESS 0x2000c1bb /end MEASUREMENT
/begin MEASUREMENT tau_ar2_agree_s "" UBYTE HANcoder_E407_TTA_Controller_v3_CM_boolean 0 0 0 1 ECU_ADDRESS 0x2000bb5d /end MEASUREMENT
/begin MEASUREMENT tau_al2_agree_s "" UBYTE HANcoder_E407_TTA_Controller_v3_CM_boolean 0 0 0 1 ECU_ADDRESS 0x2000bb68 /end MEASUREMENT
/begin MEASUREMENT tau_fr1_agree_s "" UBYTE HANcoder_E407_TTA_Controller_v3_CM_boolean 0 0 0 1 ECU_ADDRESS 0x2000c364 /end MEASUREMENT
/begin MEASUREMENT tau_fl1_agree_s "" UBYTE HANcoder_E407_TTA_Controller_v3_CM_boolean 0 0 0 1 ECU_ADDRESS 0x2000c0b4 /end MEASUREMENT
/begin MEASUREMENT tau_ar1_agree_s "" UBYTE HANcoder_E407_TTA_Controller_v3_CM_boolean 0 0 0 1 ECU_ADDRESS 0x2000bb58 /end MEASUREMENT
/begin MEASUREMENT tau_al1_agree_s "" UBYTE HANcoder_E407_TTA_Controller_v3_CM_boolean 0 0 0 1 ECU_ADDRESS 0x2000c211 /end MEASUREMENT
/begin MEASUREMENT new_set_rx_s "" UBYTE HANcoder_E407_TTA_Controller_v3_CM_boolean 0 0 0 1 ECU_ADDRESS 0x2000bb88 /end MEASUREMENT
/begin MEASUREMENT new_sensor_rx_s "" UBYTE HANcoder_E407_TTA_Controller_v3_CM_boolean 0 0 0 1 ECU_ADDRESS 0x2000c1a8 /end MEASUREMENT
/begin MEASUREMENT out2_rx_s "" UBYTE HANcoder_E407_TTA_Controller_v3_CM_boolean 0 0 0 1 ECU_ADDRESS 0x2000c0d1 /end MEASUREMENT
/begin MEASUREMENT out1_rx_s "" UBYTE HANcoder_E407_TTA_Controller_v3_CM_boolean 0 0 0 1 ECU_ADDRESS 0x2000c842 /end MEASUREMENT
/begin MEASUREMENT reset_s "" UBYTE HANcoder_E407_TTA_Controller_v3_CM_boolean 0 0 0 1 ECU_ADDRESS 0x2000c2ae /end MEASUREMENT
/begin MEASUREMENT Tx_temporal_msg_CAN2 "" FLOAT64_IEEE HANcoder_E407_TTA_Controller_v3_CM_double 0 0 -1.7E+308 1.7E+308 ECU_ADDRESS 0x2000c120 /end MEASUREMENT
/begin MEASUREMENT TxCAN2_counter_s "" ULONG HANcoder_E407_TTA_Controller_v3_CM_uint32 0 0 0 4294967295 ECU_ADDRESS 0x2000c2a8 /end MEASUREMENT
/begin MEASUREMENT TxID_CAN2_s "" ULONG HANcoder_E407_TTA_Controller_v3_CM_uint32 0 0 0 4294967295 ECU_ADDRESS 0x2000bc38 /end MEASUREMENT
/begin MEASUREMENT Local_Ticks_Activation_CAN2_send "" UWORD HANcoder_E407_TTA_Controller_v3_CM_uint16 0 0 0 65535 ECU_ADDRESS 0x2000c216 /end MEASUREMENT
/begin MEASUREMENT FRC_Activation_CAN2_send "" UWORD HANcoder_E407_TTA_Controller_v3_CM_uint16 0 0 0 65535 ECU_ADDRESS 0x2000c27a /end MEASUREMENT
/begin MEASUREMENT Rx_temporal_msg_CAN2 "" FLOAT64_IEEE HANcoder_E407_TTA_Controller_v3_CM_double 0 0 -1.7E+308 1.7E+308 ECU_ADDRESS 0x2000c810 /end MEASUREMENT
/begin MEASUREMENT RxCAN2_counter_s "" ULONG HANcoder_E407_TTA_Controller_v3_CM_uint32 0 0 0 4294967295 ECU_ADDRESS 0x2000c288 /end MEASUREMENT
/begin MEASUREMENT RxID_CAN2_s "" ULONG HANcoder_E407_TTA_Controller_v3_CM_uint32 0 0 0 4294967295 ECU_ADDRESS 0x2000c7f8 /end MEASUREMENT
/begin MEASUREMENT Rx_msg_ticks_CAN2 "" UWORD HANcoder_E407_TTA_Controller_v3_CM_uint16 0 0 0 65535 ECU_ADDRESS 0x2000c844 /end MEASUREMENT
/begin MEASUREMENT Rx_temporal_msg_CAN1 "" FLOAT64_IEEE HANcoder_E407_TTA_Controller_v3_CM_double 0 0 -1.7E+308 1.7E+308 ECU_ADDRESS 0x2000c260 /end MEASUREMENT
/begin MEASUREMENT RxCAN1_counter_s "" ULONG HANcoder_E407_TTA_Controller_v3_CM_uint32 0 0 0 4294967295 ECU_ADDRESS 0x2000c0a8 /end MEASUREMENT
/begin MEASUREMENT RxID_CAN1_s "" ULONG HANcoder_E407_TTA_Controller_v3_CM_uint32 0 0 0 4294967295 ECU_ADDRESS 0x2000c1f8 /end MEASUREMENT
/begin MEASUREMENT Rx_msg_ticks_CAN1 "" UWORD HANcoder_E407_TTA_Controller_v3_CM_uint16 0 0 0 65535 ECU_ADDRESS 0x2000c1e8 /end MEASUREMENT
/begin MEASUREMENT Tx_temporal_msg_CAN1 "" FLOAT64_IEEE HANcoder_E407_TTA_Controller_v3_CM_double 0 0 -1.7E+308 1.7E+308 ECU_ADDRESS 0x2000c838 /end MEASUREMENT
/begin MEASUREMENT TxCAN1_counter_s "" ULONG HANcoder_E407_TTA_Controller_v3_CM_uint32 0 0 0 4294967295 ECU_ADDRESS 0x2000c794 /end MEASUREMENT
/begin MEASUREMENT TxID_CAN1_s "" ULONG HANcoder_E407_TTA_Controller_v3_CM_uint32 0 0 0 4294967295 ECU_ADDRESS 0x2000c1c0 /end MEASUREMENT
/begin MEASUREMENT Local_Ticks_Activation_CAN1_send "" UWORD HANcoder_E407_TTA_Controller_v3_CM_uint16 0 0 0 65535 ECU_ADDRESS 0x2000c0b0 /end MEASUREMENT
/begin MEASUREMENT FRC_Activation_CAN1_send "" UWORD HANcoder_E407_TTA_Controller_v3_CM_uint16 0 0 0 65535 ECU_ADDRESS 0x2000c218 /end MEASUREMENT
/begin COMPU_METHOD HANcoder_E407_TTA_Controller_v3_CM_double "Q = V" RAT_FUNC "%15.10" "" COEFFS 0 1 0 0 0 1 /end COMPU_METHOD
/begin COMPU_METHOD HANcoder_E407_TTA_Controller_v3_CM_boolean "Q = V" RAT_FUNC "%1.0" "" COEFFS 0 1 0 0 0 1 /end COMPU_METHOD
/begin COMPU_METHOD HANcoder_E407_TTA_Controller_v3_CM_uint32 "Q = V" RAT_FUNC "%10.0" "" COEFFS 0 1 0 0 0 1 /end COMPU_METHOD
/begin COMPU_METHOD HANcoder_E407_TTA_Controller_v3_CM_uint16 "Q = V" RAT_FUNC "%5.0" "" COEFFS 0 1 0 0 0 1 /end COMPU_METHOD
/begin COMPU_METHOD HANcoder_E407_TTA_Controller_v3_CM_uint8 "Q = V" RAT_FUNC "%3.0" "" COEFFS 0 1 0 0 0 1 /end COMPU_METHOD
/begin GROUP HANcoder_E407_TTA_Controller_v3 "HANcoder_E407_TTA_Controller_v3" /* Root */ ROOT /begin SUB_GROUP Root_HANcoder_STM32_Target___E407_STM32_algorithm /end SUB_GROUP /end GROUP
/begin GROUP Root_HANcoder_STM32_Target___E407_STM32_algorithm "HANcoder_E407_TTA_Controller_v3/HANcoder STM32 Target - E407-STM32 algorithm"
 /begin SUB_GROUP S1_Algorithm S1_Global_Ticks_Increment S1_System_information /end SUB_GROUP
/end GROUP
/begin GROUP S1_Algorithm "HANcoder_E407_TTA_Controller_v3/HANcoder STM32 Target - E407-STM32 algorithm/Algorithm" /begin REF_CHARACTERISTIC HANtuneOverride /end REF_CHARACTERISTIC /begin REF_MEASUREMENT LedValue /end REF_MEASUREMENT /end GROUP
/begin GROUP S1_Global_Ticks_Increment "HANcoder_E407_TTA_Controller_v3/HANcoder STM32 Target - E407-STM32 algorithm/Global Ticks Increment"
 /begin SUB_GROUP S6_CAN1_Recieve S6_CAN1_Send S6_CAN2_Recieve S6_CAN2_Send S6_CAN_Management S6_If_Action_Subsystem S6_Local_Time_generation /end SUB_GROUP
 /begin REF_MEASUREMENT simulation_time /end REF_MEASUREMENT
/end GROUP
/begin GROUP S1_System_information "HANcoder_E407_TTA_Controller_v3/HANcoder STM32 Target - E407-STM32 algorithm/System information" /begin SUB_GROUP S10_Get_CPU_load S10_Get_free_Heap S10_Get_free_Stack /end SUB_GROUP /end GROUP
/begin GROUP S6_CAN_Management "HANcoder_E407_TTA_Controller_v3/HANcoder STM32 Target - E407-STM32 algorithm/Global Ticks Increment/CAN Management"
 /begin SUB_GROUP S18_Basic_Cycle_Increment S18_Initialization S18_Matrix_Cycle_Manager /end SUB_GROUP
/end GROUP
/begin GROUP S6_CAN1_Recieve "HANcoder_E407_TTA_Controller_v3/HANcoder STM32 Target - E407-STM32 algorithm/Global Ticks Increment/CAN1 Recieve" /begin SUB_GROUP S19_Update_message_buffers /end SUB_GROUP /begin REF_MEASUREMENT RxCAN1_counter_s RxID_CAN1_s /end REF_MEASUREMENT /end GROUP
/begin GROUP S6_CAN1_Send "HANcoder_E407_TTA_Controller_v3/HANcoder STM32 Target - E407-STM32 algorithm/Global Ticks Increment/CAN1 Send" /begin SUB_GROUP S20_Get_Free_Running_Counter /end SUB_GROUP
 /begin REF_MEASUREMENT Local_Ticks_Activation_CAN1_send TxCAN1_counter_s TxID_CAN1_s Tx_temporal_msg_CAN1 /end REF_MEASUREMENT
/end GROUP
/begin GROUP S6_CAN2_Recieve "HANcoder_E407_TTA_Controller_v3/HANcoder STM32 Target - E407-STM32 algorithm/Global Ticks Increment/CAN2 Recieve" /begin SUB_GROUP S21_Update_message_buffers /end SUB_GROUP /begin REF_MEASUREMENT RxCAN2_counter_s RxID_CAN2_s /end REF_MEASUREMENT /end GROUP
/begin GROUP S6_CAN2_Send "HANcoder_E407_TTA_Controller_v3/HANcoder STM32 Target - E407-STM32 algorithm/Global Ticks Increment/CAN2 Send" /begin SUB_GROUP S22_Get_Free_Running_Counter1 /end SUB_GROUP
 /begin REF_MEASUREMENT Local_Ticks_Activation_CAN2_send TxCAN2_counter_s TxID_CAN2_s Tx_temporal_msg_CAN2 /end REF_MEASUREMENT
/end GROUP
/begin GROUP S6_If_Action_Subsystem "HANcoder_E407_TTA_Controller_v3/HANcoder STM32 Target - E407-STM32 algorithm/Global Ticks Increment/If Action Subsystem" /begin REF_MEASUREMENT Board_ID_s /end REF_MEASUREMENT /end GROUP
/begin GROUP S6_Local_Time_generation "HANcoder_E407_TTA_Controller_v3/HANcoder STM32 Target - E407-STM32 algorithm/Global Ticks Increment/Local Time generation" /begin REF_MEASUREMENT local_ticks_interrupt /end REF_MEASUREMENT /end GROUP
/begin GROUP S10_Get_CPU_load "HANcoder_E407_TTA_Controller_v3/HANcoder STM32 Target - E407-STM32 algorithm/System information/Get CPU load" /begin REF_MEASUREMENT SI_CPUload /end REF_MEASUREMENT /end GROUP
/begin GROUP S10_Get_free_Heap "HANcoder_E407_TTA_Controller_v3/HANcoder STM32 Target - E407-STM32 algorithm/System information/Get free Heap" /begin REF_MEASUREMENT SI_FreeHeap /end REF_MEASUREMENT /end GROUP
/begin GROUP S10_Get_free_Stack "HANcoder_E407_TTA_Controller_v3/HANcoder STM32 Target - E407-STM32 algorithm/System information/Get free Stack" /begin REF_MEASUREMENT SI_FreeStack /end REF_MEASUREMENT /end GROUP
/begin GROUP S18_Basic_Cycle_Increment "HANcoder_E407_TTA_Controller_v3/HANcoder STM32 Target - E407-STM32 algorithm/Global Ticks Increment/CAN Management/Basic Cycle Increment" /begin REF_MEASUREMENT bacic_cycle_s /end REF_MEASUREMENT /end GROUP
/begin GROUP S18_Initialization "HANcoder_E407_TTA_Controller_v3/HANcoder STM32 Target - E407-STM32 algorithm/Global Ticks Increment/CAN Management/Initialization" /begin SUB_GROUP S39_RoleID_and_Global_Time_init /end SUB_GROUP /end GROUP
/begin GROUP S18_Matrix_Cycle_Manager "HANcoder_E407_TTA_Controller_v3/HANcoder STM32 Target - E407-STM32 algorithm/Global Ticks Increment/CAN Management/Matrix Cycle Manager"
 /begin SUB_GROUP S41_Controller_Matrix_Cycle S41_Input_Generator_Matrix_Cycle S41_Vehicle_Emulator_Matrix_Cycle /end SUB_GROUP
/end GROUP
/begin GROUP S19_Update_message_buffers "HANcoder_E407_TTA_Controller_v3/HANcoder STM32 Target - E407-STM32 algorithm/Global Ticks Increment/CAN1 Recieve/Update message buffers" /begin REF_MEASUREMENT Rx_msg_ticks_CAN1 Rx_temporal_msg_CAN1 /end REF_MEASUREMENT /end GROUP
/begin GROUP S20_Get_Free_Running_Counter "HANcoder_E407_TTA_Controller_v3/HANcoder STM32 Target - E407-STM32 algorithm/Global Ticks Increment/CAN1 Send/Get Free Running Counter" /begin REF_MEASUREMENT FRC_Activation_CAN1_send /end REF_MEASUREMENT /end GROUP
/begin GROUP S21_Update_message_buffers "HANcoder_E407_TTA_Controller_v3/HANcoder STM32 Target - E407-STM32 algorithm/Global Ticks Increment/CAN2 Recieve/Update message buffers" /begin REF_MEASUREMENT Rx_msg_ticks_CAN2 Rx_temporal_msg_CAN2 /end REF_MEASUREMENT /end GROUP
/begin GROUP S22_Get_Free_Running_Counter1 "HANcoder_E407_TTA_Controller_v3/HANcoder STM32 Target - E407-STM32 algorithm/Global Ticks Increment/CAN2 Send/Get Free Running Counter1" /begin REF_MEASUREMENT FRC_Activation_CAN2_send /end REF_MEASUREMENT /end GROUP
/begin GROUP S39_RoleID_and_Global_Time_init "HANcoder_E407_TTA_Controller_v3/HANcoder STM32 Target - E407-STM32 algorithm/Global Ticks Increment/CAN Management/Initialization/RoleID and Global Time init" /begin SUB_GROUP S47_Global_Time_Initialization_Slave /end SUB_GROUP /end GROUP
/begin GROUP S41_Controller_Matrix_Cycle "HANcoder_E407_TTA_Controller_v3/HANcoder STM32 Target - E407-STM32 algorithm/Global Ticks Increment/CAN Management/Matrix Cycle Manager/Controller Matrix Cycle"
 /begin SUB_GROUP S88_Matrix_Cycle_Observation_DEBUG S88_controller_basic_cycle_0 S88_controller_basic_cycle_1 S88_msg_count_DEBUG_observer /end SUB_GROUP
/end GROUP
/begin GROUP S41_Input_Generator_Matrix_Cycle "HANcoder_E407_TTA_Controller_v3/HANcoder STM32 Target - E407-STM32 algorithm/Global Ticks Increment/CAN Management/Matrix Cycle Manager/Input Generator Matrix Cycle"
 /begin SUB_GROUP S89_Matrix_Cycle_Observation_DEBUG S89_input_generator_basic_cycle_0 S89_input_generator_basic_cycle_1 S89_msg_count_DEBUG_observer /end SUB_GROUP
/end GROUP
/begin GROUP S41_Vehicle_Emulator_Matrix_Cycle "HANcoder_E407_TTA_Controller_v3/HANcoder STM32 Target - E407-STM32 algorithm/Global Ticks Increment/CAN Management/Matrix Cycle Manager/Vehicle Emulator Matrix Cycle"
 /begin SUB_GROUP S90_Matrix_Cycle_Observation_DEBUG S90_msg_count_DEBUG_observer S90_vehicle_emulator_basic_cycle_0 S90_vehicle_emulator_basic_cycle_1 /end SUB_GROUP
/end GROUP
/begin GROUP S47_Global_Time_Initialization_Slave "HANcoder_E407_TTA_Controller_v3/HANcoder STM32 Target - E407-STM32 algorithm/Global Ticks Increment/CAN Management/Initialization/RoleID and Global Time init/Global Time Initialization Slave" /begin SUB_GROUP S49_msg_decoding /end SUB_GROUP /begin REF_MEASUREMENT Rx_init_LT /end REF_MEASUREMENT /end GROUP
/begin GROUP S88_Matrix_Cycle_Observation_DEBUG "HANcoder_E407_TTA_Controller_v3/HANcoder STM32 Target - E407-STM32 algorithm/Global Ticks Increment/CAN Management/Matrix Cycle Manager/Controller Matrix Cycle/Matrix_Cycle_Observation_DEBUG"
 /begin REF_MEASUREMENT BC0_sync_processed_s BC0_vote1_processed_s BC0_vote2_processed_s BC0_vote3_processed_s BC1_sync_processed_s Board_1_error_counter_s Board_2_error_counter_s Board_3_error_counter_s Master_ID_s Role_ID_s votes_Board_1_DEBUG votes_Board_2_DEBUG votes_Board_3_DEBUG /end REF_MEASUREMENT
/end GROUP
/begin GROUP S88_controller_basic_cycle_0 "HANcoder_E407_TTA_Controller_v3/HANcoder STM32 Target - E407-STM32 algorithm/Global Ticks Increment/CAN Management/Matrix Cycle Manager/Controller Matrix Cycle/controller basic cycle 0"
 /begin SUB_GROUP S92_COMP_Task___Check_Timeouts S92_COMP_Task___Reset_Board S92_COMP_Task___Sync_bc0_check S92_COMP_Task___Vote1_check S92_COMP_Task___Vote2_check S92_COMP_Task___Vote3_check S92_COMP_Task___Vote_Decision /end SUB_GROUP
/end GROUP
/begin GROUP S88_controller_basic_cycle_1 "HANcoder_E407_TTA_Controller_v3/HANcoder STM32 Target - E407-STM32 algorithm/Global Ticks Increment/CAN Management/Matrix Cycle Manager/Controller Matrix Cycle/controller basic cycle 1"
 /begin SUB_GROUP S93_COMM_Task___Set_Values S93_COMP_Task___Calculate_Speed S93_COMP_Task___Calculate_Steer S93_COMP_Task___Calculate_Torque S93_COMP_Task___Rx_Output_Control1_Check S93_COMP_Task___Rx_Output_Control2_Check S93_COMP_Task___Rx_Output_Emulator_Check S93_COMP_Task___Rx_Sensor_Values_Check S93_COMP_Task___Rx_Set_Values_Check S93_COMP_Task___Sync_bc1_check S93_COMP_Task___TMR /end SUB_GROUP
/end GROUP
/begin GROUP S88_msg_count_DEBUG_observer "HANcoder_E407_TTA_Controller_v3/HANcoder STM32 Target - E407-STM32 algorithm/Global Ticks Increment/CAN Management/Matrix Cycle Manager/Controller Matrix Cycle/msg_count_DEBUG observer" /begin REF_MEASUREMENT msg_count_DEBUG_s /end REF_MEASUREMENT /end GROUP
/begin GROUP S89_Matrix_Cycle_Observation_DEBUG "HANcoder_E407_TTA_Controller_v3/HANcoder STM32 Target - E407-STM32 algorithm/Global Ticks Increment/CAN Management/Matrix Cycle Manager/Input Generator Matrix Cycle/Matrix_Cycle_Observation_DEBUG"
 /begin REF_MEASUREMENT BC0_sync_processed_ing_s BC1_sync_processed_ing_s Master_ID_ing_s Role_ID_ing_s /end REF_MEASUREMENT
/end GROUP
/begin GROUP S89_input_generator_basic_cycle_0 "HANcoder_E407_TTA_Controller_v3/HANcoder STM32 Target - E407-STM32 algorithm/Global Ticks Increment/CAN Management/Matrix Cycle Manager/Input Generator Matrix Cycle/input generator basic cycle 0"
 /begin SUB_GROUP S849_COMP_Task___Reset_Board S849_COMP_Task___Sync_bc0_check /end SUB_GROUP
/end GROUP
/begin GROUP S89_input_generator_basic_cycle_1 "HANcoder_E407_TTA_Controller_v3/HANcoder STM32 Target - E407-STM32 algorithm/Global Ticks Increment/CAN Management/Matrix Cycle Manager/Input Generator Matrix Cycle/input generator basic cycle 1"
 /begin SUB_GROUP S850_COMM_Task___Set_Values S850_COMP_Task___Reset_Board S850_COMP_Task___Sync_bc1_check /end SUB_GROUP
/end GROUP
/begin GROUP S89_msg_count_DEBUG_observer "HANcoder_E407_TTA_Controller_v3/HANcoder STM32 Target - E407-STM32 algorithm/Global Ticks Increment/CAN Management/Matrix Cycle Manager/Input Generator Matrix Cycle/msg_count_DEBUG observer" /begin REF_MEASUREMENT msg_count_DEBUG_ing_s /end REF_MEASUREMENT /end GROUP
/begin GROUP S90_Matrix_Cycle_Observation_DEBUG "HANcoder_E407_TTA_Controller_v3/HANcoder STM32 Target - E407-STM32 algorithm/Global Ticks Increment/CAN Management/Matrix Cycle Manager/Vehicle Emulator Matrix Cycle/Matrix_Cycle_Observation_DEBUG"
 /begin REF_MEASUREMENT BC0_sync_processed_vem__s BC1_sync_processed_vem__s Master_ID_vem_s Role_ID_vem_s /end REF_MEASUREMENT
/end GROUP
/begin GROUP S90_msg_count_DEBUG_observer "HANcoder_E407_TTA_Controller_v3/HANcoder STM32 Target - E407-STM32 algorithm/Global Ticks Increment/CAN Management/Matrix Cycle Manager/Vehicle Emulator Matrix Cycle/msg_count_DEBUG observer" /begin REF_MEASUREMENT msg_count_DEBUG_vem_s /end REF_MEASUREMENT /end GROUP
/begin GROUP S90_vehicle_emulator_basic_cycle_0 "HANcoder_E407_TTA_Controller_v3/HANcoder STM32 Target - E407-STM32 algorithm/Global Ticks Increment/CAN Management/Matrix Cycle Manager/Vehicle Emulator Matrix Cycle/vehicle emulator basic cycle 0"
 /begin SUB_GROUP S1026_COMP_Task___Reset_Board S1026_COMP_Task___Sync_bc0_check S1026_COMP_Task___Vehicle_Emulator_Calculate_Angles /end SUB_GROUP
/end GROUP
/begin GROUP S90_vehicle_emulator_basic_cycle_1 "HANcoder_E407_TTA_Controller_v3/HANcoder STM32 Target - E407-STM32 algorithm/Global Ticks Increment/CAN Management/Matrix Cycle Manager/Vehicle Emulator Matrix Cycle/vehicle emulator basic cycle 1"
 /begin SUB_GROUP S1027_COMP_Task___Rx_Output_Emulator_Check S1027_COMP_Task___Sync_bc1_check /end SUB_GROUP
/end GROUP
/begin GROUP S49_msg_decoding "HANcoder_E407_TTA_Controller_v3/HANcoder STM32 Target - E407-STM32 algorithm/Global Ticks Increment/CAN Management/Initialization/RoleID and Global Time init/Global Time Initialization Slave/msg_decoding" /begin SUB_GROUP S50_Bit_Shift S50_Bit_Shift1 S50_Bit_Shift2 /end SUB_GROUP /end GROUP
/begin GROUP S92_COMP_Task___Check_Timeouts "HANcoder_E407_TTA_Controller_v3/HANcoder STM32 Target - E407-STM32 algorithm/Global Ticks Increment/CAN Management/Matrix Cycle Manager/Controller Matrix Cycle/controller basic cycle 0/COMP Task - Check Timeouts" /begin SUB_GROUP S99_Timeout_and_Board_error_counter /end SUB_GROUP /end GROUP
/begin GROUP S92_COMP_Task___Reset_Board "HANcoder_E407_TTA_Controller_v3/HANcoder STM32 Target - E407-STM32 algorithm/Global Ticks Increment/CAN Management/Matrix Cycle Manager/Controller Matrix Cycle/controller basic cycle 0/COMP Task - Reset Board" /begin REF_MEASUREMENT reset_s /end REF_MEASUREMENT /end GROUP
/begin GROUP S92_COMP_Task___Sync_bc0_check "HANcoder_E407_TTA_Controller_v3/HANcoder STM32 Target - E407-STM32 algorithm/Global Ticks Increment/CAN Management/Matrix Cycle Manager/Controller Matrix Cycle/controller basic cycle 0/COMP Task - Sync bc0 check" /begin SUB_GROUP S103_Process_Messages /end SUB_GROUP /end GROUP
/begin GROUP S92_COMP_Task___Vote_Decision "HANcoder_E407_TTA_Controller_v3/HANcoder STM32 Target - E407-STM32 algorithm/Global Ticks Increment/CAN Management/Matrix Cycle Manager/Controller Matrix Cycle/controller basic cycle 0/COMP Task - Vote Decision" /begin SUB_GROUP S105_Vote_Decision /end SUB_GROUP /end GROUP
/begin GROUP S92_COMP_Task___Vote1_check "HANcoder_E407_TTA_Controller_v3/HANcoder STM32 Target - E407-STM32 algorithm/Global Ticks Increment/CAN Management/Matrix Cycle Manager/Controller Matrix Cycle/controller basic cycle 0/COMP Task - Vote1 check" /begin SUB_GROUP S107_Process_Messages1 /end SUB_GROUP /end GROUP
/begin GROUP S92_COMP_Task___Vote2_check "HANcoder_E407_TTA_Controller_v3/HANcoder STM32 Target - E407-STM32 algorithm/Global Ticks Increment/CAN Management/Matrix Cycle Manager/Controller Matrix Cycle/controller basic cycle 0/COMP Task - Vote2 check" /begin SUB_GROUP S109_Process_Messages /end SUB_GROUP /end GROUP
/begin GROUP S92_COMP_Task___Vote3_check "HANcoder_E407_TTA_Controller_v3/HANcoder STM32 Target - E407-STM32 algorithm/Global Ticks Increment/CAN Management/Matrix Cycle Manager/Controller Matrix Cycle/controller basic cycle 0/COMP Task - Vote3 check" /begin SUB_GROUP S111_Process_Messages /end SUB_GROUP /end GROUP
/begin GROUP S93_COMM_Task___Set_Values "HANcoder_E407_TTA_Controller_v3/HANcoder STM32 Target - E407-STM32 algorithm/Global Ticks Increment/CAN Management/Matrix Cycle Manager/Controller Matrix Cycle/controller basic cycle 1/COMM Task - Set_Values" /begin SUB_GROUP S333_Transmission_subtasks /end SUB_GROUP /end GROUP
/begin GROUP S93_COMP_Task___Calculate_Speed "HANcoder_E407_TTA_Controller_v3/HANcoder STM32 Target - E407-STM32 algorithm/Global Ticks Increment/CAN Management/Matrix Cycle Manager/Controller Matrix Cycle/controller basic cycle 1/COMP Task - Calculate Speed" /begin SUB_GROUP S335_Calculate_speed /end SUB_GROUP /end GROUP
/begin GROUP S93_COMP_Task___Calculate_Steer "HANcoder_E407_TTA_Controller_v3/HANcoder STM32 Target - E407-STM32 algorithm/Global Ticks Increment/CAN Management/Matrix Cycle Manager/Controller Matrix Cycle/controller basic cycle 1/COMP Task - Calculate Steer" /begin SUB_GROUP S336_Calculate_steering /end SUB_GROUP /end GROUP
/begin GROUP S93_COMP_Task___Calculate_Torque "HANcoder_E407_TTA_Controller_v3/HANcoder STM32 Target - E407-STM32 algorithm/Global Ticks Increment/CAN Management/Matrix Cycle Manager/Controller Matrix Cycle/controller basic cycle 1/COMP Task - Calculate Torque" /begin SUB_GROUP S337_Calculate_torque /end SUB_GROUP /end GROUP
/begin GROUP S93_COMP_Task___Rx_Output_Control1_Check "HANcoder_E407_TTA_Controller_v3/HANcoder STM32 Target - E407-STM32 algorithm/Global Ticks Increment/CAN Management/Matrix Cycle Manager/Controller Matrix Cycle/controller basic cycle 1/COMP Task - Rx_Output_Control1_Check" /begin SUB_GROUP S339_Process_Messages /end SUB_GROUP /end GROUP
/begin GROUP S93_COMP_Task___Rx_Output_Control2_Check "HANcoder_E407_TTA_Controller_v3/HANcoder STM32 Target - E407-STM32 algorithm/Global Ticks Increment/CAN Management/Matrix Cycle Manager/Controller Matrix Cycle/controller basic cycle 1/COMP Task - Rx_Output_Control2_Check" /begin SUB_GROUP S340_Process_Messages /end SUB_GROUP /end GROUP
/begin GROUP S93_COMP_Task___Rx_Output_Emulator_Check "HANcoder_E407_TTA_Controller_v3/HANcoder STM32 Target - E407-STM32 algorithm/Global Ticks Increment/CAN Management/Matrix Cycle Manager/Controller Matrix Cycle/controller basic cycle 1/COMP Task - Rx_Output_Emulator_Check" /begin SUB_GROUP S341_Process_Messages /end SUB_GROUP /end GROUP
/begin GROUP S93_COMP_Task___Rx_Sensor_Values_Check "HANcoder_E407_TTA_Controller_v3/HANcoder STM32 Target - E407-STM32 algorithm/Global Ticks Increment/CAN Management/Matrix Cycle Manager/Controller Matrix Cycle/controller basic cycle 1/COMP Task - Rx_Sensor_Values_Check" /begin SUB_GROUP S342_Process_Messages S342_Update_Msg_buffer /end SUB_GROUP /end GROUP
/begin GROUP S93_COMP_Task___Rx_Set_Values_Check "HANcoder_E407_TTA_Controller_v3/HANcoder STM32 Target - E407-STM32 algorithm/Global Ticks Increment/CAN Management/Matrix Cycle Manager/Controller Matrix Cycle/controller basic cycle 1/COMP Task - Rx_Set_Values_Check" /begin SUB_GROUP S343_Process_Messages S343_Update_Msg_buffer /end SUB_GROUP /end GROUP
/begin GROUP S93_COMP_Task___Sync_bc1_check "HANcoder_E407_TTA_Controller_v3/HANcoder STM32 Target - E407-STM32 algorithm/Global Ticks Increment/CAN Management/Matrix Cycle Manager/Controller Matrix Cycle/controller basic cycle 1/COMP Task - Sync bc1 check" /begin SUB_GROUP S344_Process_Messages /end SUB_GROUP /end GROUP
/begin GROUP S93_COMP_Task___TMR "HANcoder_E407_TTA_Controller_v3/HANcoder STM32 Target - E407-STM32 algorithm/Global Ticks Increment/CAN Management/Matrix Cycle Manager/Controller Matrix Cycle/controller basic cycle 1/COMP Task - TMR" /begin SUB_GROUP S345_TMR_main /end SUB_GROUP /end GROUP
/begin GROUP S849_COMP_Task___Reset_Board "HANcoder_E407_TTA_Controller_v3/HANcoder STM32 Target - E407-STM32 algorithm/Global Ticks Increment/CAN Management/Matrix Cycle Manager/Input Generator Matrix Cycle/input generator basic cycle 0/COMP Task - Reset Board" /begin REF_MEASUREMENT reset_ing_s /end REF_MEASUREMENT /end GROUP
/begin GROUP S849_COMP_Task___Sync_bc0_check "HANcoder_E407_TTA_Controller_v3/HANcoder STM32 Target - E407-STM32 algorithm/Global Ticks Increment/CAN Management/Matrix Cycle Manager/Input Generator Matrix Cycle/input generator basic cycle 0/COMP Task - Sync bc0 check" /begin SUB_GROUP S855_Process_Messages /end SUB_GROUP /end GROUP
/begin GROUP S850_COMM_Task___Set_Values "HANcoder_E407_TTA_Controller_v3/HANcoder STM32 Target - E407-STM32 algorithm/Global Ticks Increment/CAN Management/Matrix Cycle Manager/Input Generator Matrix Cycle/input generator basic cycle 1/COMM Task - Set_Values" /begin SUB_GROUP S923_Transmission_subtasks /end SUB_GROUP /end GROUP
/begin GROUP S850_COMP_Task___Reset_Board "HANcoder_E407_TTA_Controller_v3/HANcoder STM32 Target - E407-STM32 algorithm/Global Ticks Increment/CAN Management/Matrix Cycle Manager/Input Generator Matrix Cycle/input generator basic cycle 1/COMP Task - Reset Board" /begin REF_MEASUREMENT reset_bc1_ing_s /end REF_MEASUREMENT /end GROUP
/begin GROUP S850_COMP_Task___Sync_bc1_check "HANcoder_E407_TTA_Controller_v3/HANcoder STM32 Target - E407-STM32 algorithm/Global Ticks Increment/CAN Management/Matrix Cycle Manager/Input Generator Matrix Cycle/input generator basic cycle 1/COMP Task - Sync bc1 check" /begin SUB_GROUP S928_Process_Messages /end SUB_GROUP /end GROUP
/begin GROUP S1026_COMP_Task___Reset_Board "HANcoder_E407_TTA_Controller_v3/HANcoder STM32 Target - E407-STM32 algorithm/Global Ticks Increment/CAN Management/Matrix Cycle Manager/Vehicle Emulator Matrix Cycle/vehicle emulator basic cycle 0/COMP Task - Reset Board" /begin REF_MEASUREMENT reset_vem_s /end REF_MEASUREMENT /end GROUP
/begin GROUP S1026_COMP_Task___Sync_bc0_check "HANcoder_E407_TTA_Controller_v3/HANcoder STM32 Target - E407-STM32 algorithm/Global Ticks Increment/CAN Management/Matrix Cycle Manager/Vehicle Emulator Matrix Cycle/vehicle emulator basic cycle 0/COMP Task - Sync bc0 check" /begin SUB_GROUP S1031_Process_Messages /end SUB_GROUP /end GROUP
/begin GROUP S1026_COMP_Task___Vehicle_Emulator_Calculate_Angles "HANcoder_E407_TTA_Controller_v3/HANcoder STM32 Target - E407-STM32 algorithm/Global Ticks Increment/CAN Management/Matrix Cycle Manager/Vehicle Emulator Matrix Cycle/vehicle emulator basic cycle 0/COMP Task - Vehicle Emulator Calculate Angles" /begin SUB_GROUP S1033_Vehicle_Emulator_Calculate_Angles /end SUB_GROUP /end GROUP
/begin GROUP S1027_COMP_Task___Rx_Output_Emulator_Check "HANcoder_E407_TTA_Controller_v3/HANcoder STM32 Target - E407-STM32 algorithm/Global Ticks Increment/CAN Management/Matrix Cycle Manager/Vehicle Emulator Matrix Cycle/vehicle emulator basic cycle 1/COMP Task - Rx Output Emulator Check" /begin SUB_GROUP S1116_Process_Messages S1116_Update_Msg_buffer /end SUB_GROUP /end GROUP
/begin GROUP S1027_COMP_Task___Sync_bc1_check "HANcoder_E407_TTA_Controller_v3/HANcoder STM32 Target - E407-STM32 algorithm/Global Ticks Increment/CAN Management/Matrix Cycle Manager/Vehicle Emulator Matrix Cycle/vehicle emulator basic cycle 1/COMP Task - Sync bc1 check" /begin SUB_GROUP S1118_Process_Messages /end SUB_GROUP /end GROUP
/begin GROUP S50_Bit_Shift "HANcoder_E407_TTA_Controller_v3/HANcoder STM32 Target - E407-STM32 algorithm/Global Ticks Increment/CAN Management/Initialization/RoleID and Global Time init/Global Time Initialization Slave/msg_decoding/Bit Shift" /begin REF_MEASUREMENT Rx_init_bc /end REF_MEASUREMENT /end GROUP
/begin GROUP S50_Bit_Shift1 "HANcoder_E407_TTA_Controller_v3/HANcoder STM32 Target - E407-STM32 algorithm/Global Ticks Increment/CAN Management/Initialization/RoleID and Global Time init/Global Time Initialization Slave/msg_decoding/Bit Shift1" /begin REF_MEASUREMENT Rx_init_mc /end REF_MEASUREMENT /end GROUP
/begin GROUP S50_Bit_Shift2 "HANcoder_E407_TTA_Controller_v3/HANcoder STM32 Target - E407-STM32 algorithm/Global Ticks Increment/CAN Management/Initialization/RoleID and Global Time init/Global Time Initialization Slave/msg_decoding/Bit Shift2" /begin REF_MEASUREMENT Rx_init_id /end REF_MEASUREMENT /end GROUP
/begin GROUP S99_Timeout_and_Board_error_counter "HANcoder_E407_TTA_Controller_v3/HANcoder STM32 Target - E407-STM32 algorithm/Global Ticks Increment/CAN Management/Matrix Cycle Manager/Controller Matrix Cycle/controller basic cycle 0/COMP Task - Check Timeouts/Timeout and Board error counter"
 /begin SUB_GROUP S199_Timeout_Counter_1_DEBUG S199_Timeout_Counter_2_DEBUG S199_Timeout_Counter_3_DEBUG /end SUB_GROUP
/end GROUP
/begin GROUP S103_Process_Messages "HANcoder_E407_TTA_Controller_v3/HANcoder STM32 Target - E407-STM32 algorithm/Global Ticks Increment/CAN Management/Matrix Cycle Manager/Controller Matrix Cycle/controller basic cycle 0/COMP Task - Sync bc0 check/Process_Messages"
 /begin SUB_GROUP S208_Demux_message_CAN1_and_check_coherence S208_Demux_message_CAN1_and_check_coherence1 /end SUB_GROUP
 /begin REF_MEASUREMENT Desync_Sync_bc0_s /end REF_MEASUREMENT
/end GROUP
/begin GROUP S105_Vote_Decision "HANcoder_E407_TTA_Controller_v3/HANcoder STM32 Target - E407-STM32 algorithm/Global Ticks Increment/CAN Management/Matrix Cycle Manager/Controller Matrix Cycle/controller basic cycle 0/COMP Task - Vote Decision/Vote Decision" /begin REF_MEASUREMENT Vote_s /end REF_MEASUREMENT /end GROUP
/begin GROUP S107_Process_Messages1 "HANcoder_E407_TTA_Controller_v3/HANcoder STM32 Target - E407-STM32 algorithm/Global Ticks Increment/CAN Management/Matrix Cycle Manager/Controller Matrix Cycle/controller basic cycle 0/COMP Task - Vote1 check/Process_Messages1"
 /begin SUB_GROUP S243_Demux_message_CAN1_and_check_coherence S243_Demux_message_CAN1_and_check_coherence1 /end SUB_GROUP
 /begin REF_MEASUREMENT Desync_Vote1_s Rx_msg_ticks_vote1_CAN1_s Rx_msg_ticks_vote1_CAN2_s expected_LT_vote1_CAN1_s expected_LT_vote1_CAN2_s /end REF_MEASUREMENT
/end GROUP
/begin GROUP S109_Process_Messages "HANcoder_E407_TTA_Controller_v3/HANcoder STM32 Target - E407-STM32 algorithm/Global Ticks Increment/CAN Management/Matrix Cycle Manager/Controller Matrix Cycle/controller basic cycle 0/COMP Task - Vote2 check/Process_Messages"
 /begin SUB_GROUP S272_Demux_message_CAN1_and_check_coherence S272_Demux_message_CAN1_and_check_coherence1 /end SUB_GROUP
 /begin REF_MEASUREMENT Desync_Vote2_s Rx_msg_ticks_vote2_CAN1_s Rx_msg_ticks_vote2_CAN2_s expected_LT_vote2_CAN1_s expected_LT_vote2_CAN2_s /end REF_MEASUREMENT
/end GROUP
/begin GROUP S111_Process_Messages "HANcoder_E407_TTA_Controller_v3/HANcoder STM32 Target - E407-STM32 algorithm/Global Ticks Increment/CAN Management/Matrix Cycle Manager/Controller Matrix Cycle/controller basic cycle 0/COMP Task - Vote3 check/Process_Messages"
 /begin SUB_GROUP S301_Demux_message_CAN1_and_check_coherence S301_Demux_message_CAN1_and_check_coherence1 /end SUB_GROUP
 /begin REF_MEASUREMENT Desync_Vote3_s Rx_msg_ticks_vote3_CAN1_s Rx_msg_ticks_vote3_CAN2_s expected_LT_vote3_CAN1_s expected_LT_vote3_CAN2_s /end REF_MEASUREMENT
/end GROUP
/begin GROUP S333_Transmission_subtasks "HANcoder_E407_TTA_Controller_v3/HANcoder STM32 Target - E407-STM32 algorithm/Global Ticks Increment/CAN Management/Matrix Cycle Manager/Controller Matrix Cycle/controller basic cycle 1/COMM Task - Set_Values/Transmission subtasks" /begin SUB_GROUP S470_Msg_Value_Data_Encoded5 /end SUB_GROUP /end GROUP
/begin GROUP S335_Calculate_speed "HANcoder_E407_TTA_Controller_v3/HANcoder STM32 Target - E407-STM32 algorithm/Global Ticks Increment/CAN Management/Matrix Cycle Manager/Controller Matrix Cycle/controller basic cycle 1/COMP Task - Calculate Speed/Calculate speed" /begin SUB_GROUP S529_Integral_speed /end SUB_GROUP /begin REF_CHARACTERISTIC speed_k_d speed_k_i speed_k_p /end REF_CHARACTERISTIC
 /begin REF_MEASUREMENT torque_al_set_s torque_ar_set_s torque_fl_set_s torque_fr_set_s v_ctreff_s v_est_s /end REF_MEASUREMENT
/end GROUP
/begin GROUP S336_Calculate_steering "HANcoder_E407_TTA_Controller_v3/HANcoder STM32 Target - E407-STM32 algorithm/Global Ticks Increment/CAN Management/Matrix Cycle Manager/Controller Matrix Cycle/controller basic cycle 1/COMP Task - Calculate Steer/Calculate steering" /begin SUB_GROUP S532_Integral_delta_a_est S532_Integral_delta_f_est /end SUB_GROUP
 /begin REF_MEASUREMENT delta_a_est_current_s delta_dot_a_prev_s delta_dot_a_s delta_dot_f_prev_s delta_dot_f_s delta_f_est_current_s rx_data_t_steerA_s rx_data_t_steerF_s theta_al_stored_s theta_ar_stored_s theta_fl_stored_s theta_fr_stored_s /end REF_MEASUREMENT
/end GROUP
/begin GROUP S337_Calculate_torque "HANcoder_E407_TTA_Controller_v3/HANcoder STM32 Target - E407-STM32 algorithm/Global Ticks Increment/CAN Management/Matrix Cycle Manager/Controller Matrix Cycle/controller basic cycle 1/COMP Task - Calculate Torque/Calculate torque"
 /begin REF_CHARACTERISTIC torque_a_k_d torque_a_k_i torque_a_k_p torque_f_k_d torque_f_k_i torque_f_k_p /end REF_CHARACTERISTIC
/end GROUP
/begin GROUP S339_Process_Messages "HANcoder_E407_TTA_Controller_v3/HANcoder STM32 Target - E407-STM32 algorithm/Global Ticks Increment/CAN Management/Matrix Cycle Manager/Controller Matrix Cycle/controller basic cycle 1/COMP Task - Rx_Output_Control1_Check/Process_Messages"
 /begin SUB_GROUP S546_Demux_message_CAN1_and_check_coherence S546_Demux_message_CAN1_and_check_coherence1 /end SUB_GROUP
 /begin REF_MEASUREMENT Desync_outcontrol1_s Rx_msg_ticks_outcontrol1_CAN1_s Rx_msg_ticks_outcontrol1_CAN2_s expected_LT_outcontrol1_CAN1_s expected_LT_outcontrol1_CAN2_s out1_rx_s /end REF_MEASUREMENT
/end GROUP
/begin GROUP S340_Process_Messages "HANcoder_E407_TTA_Controller_v3/HANcoder STM32 Target - E407-STM32 algorithm/Global Ticks Increment/CAN Management/Matrix Cycle Manager/Controller Matrix Cycle/controller basic cycle 1/COMP Task - Rx_Output_Control2_Check/Process_Messages"
 /begin SUB_GROUP S575_Demux_message_CAN1_and_check_coherence S575_Demux_message_CAN1_and_check_coherence1 /end SUB_GROUP
 /begin REF_MEASUREMENT Desync_outcontrol2_s Rx_msg_ticks_outcontrol2_CAN1_s Rx_msg_ticks_outcontrol2_CAN2_s expected_LT_outcontrol2_CAN1_s expected_LT_outcontrol2_CAN2_s out2_rx_s /end REF_MEASUREMENT
/end GROUP
/begin GROUP S341_Process_Messages "HANcoder_E407_TTA_Controller_v3/HANcoder STM32 Target - E407-STM32 algorithm/Global Ticks Increment/CAN Management/Matrix Cycle Manager/Controller Matrix Cycle/controller basic cycle 1/COMP Task - Rx_Output_Emulator_Check/Process_Messages"
 /begin SUB_GROUP S603_Demux_message_CAN1_and_check_coherence S603_Demux_message_CAN1_and_check_coherence1 /end SUB_GROUP
 /begin REF_MEASUREMENT Desync_outemulator_s Rx_msg_ticks_outemulator_CAN1_s Rx_msg_ticks_outemulator_CAN2_s expected_LT_outemulator_CAN1_s expected_LT_outemulator_CAN2_s /end REF_MEASUREMENT
/end GROUP
/begin GROUP S342_Process_Messages "HANcoder_E407_TTA_Controller_v3/HANcoder STM32 Target - E407-STM32 algorithm/Global Ticks Increment/CAN Management/Matrix Cycle Manager/Controller Matrix Cycle/controller basic cycle 1/COMP Task - Rx_Sensor_Values_Check/Process_Messages"
 /begin SUB_GROUP S631_Demux_message_CAN1_and_check_coherence S631_Demux_message_CAN1_and_check_coherence1 /end SUB_GROUP
 /begin REF_MEASUREMENT Desync_sensorvalues_s Rx_msg_ticks_sensorvalues_CAN1_s Rx_msg_ticks_sensorvalues_CAN2_s expected_LT_sensorvalues_CAN1_s expected_LT_sensorvalues_CAN2_s /end REF_MEASUREMENT
/end GROUP
/begin GROUP S342_Update_Msg_buffer "HANcoder_E407_TTA_Controller_v3/HANcoder STM32 Target - E407-STM32 algorithm/Global Ticks Increment/CAN Management/Matrix Cycle Manager/Controller Matrix Cycle/controller basic cycle 1/COMP Task - Rx_Sensor_Values_Check/Update Msg buffer" /begin REF_MEASUREMENT new_sensor_rx_s /end REF_MEASUREMENT /end GROUP
/begin GROUP S343_Process_Messages "HANcoder_E407_TTA_Controller_v3/HANcoder STM32 Target - E407-STM32 algorithm/Global Ticks Increment/CAN Management/Matrix Cycle Manager/Controller Matrix Cycle/controller basic cycle 1/COMP Task - Rx_Set_Values_Check/Process_Messages"
 /begin SUB_GROUP S684_Demux_message_CAN1_and_check_coherence S684_Demux_message_CAN1_and_check_coherence1 /end SUB_GROUP
 /begin REF_MEASUREMENT Desync_setvalues_s Rx_msg_ticks_setvalues_CAN1_s Rx_msg_ticks_setvalues_CAN2_s expected_LT_setvalues_CAN1_s expected_LT_setvalues_CAN2_s /end REF_MEASUREMENT
/end GROUP
/begin GROUP S343_Update_Msg_buffer "HANcoder_E407_TTA_Controller_v3/HANcoder STM32 Target - E407-STM32 algorithm/Global Ticks Increment/CAN Management/Matrix Cycle Manager/Controller Matrix Cycle/controller basic cycle 1/COMP Task - Rx_Set_Values_Check/Update Msg buffer" /begin REF_MEASUREMENT new_set_rx_s /end REF_MEASUREMENT /end GROUP
/begin GROUP S344_Process_Messages "HANcoder_E407_TTA_Controller_v3/HANcoder STM32 Target - E407-STM32 algorithm/Global Ticks Increment/CAN Management/Matrix Cycle Manager/Controller Matrix Cycle/controller basic cycle 1/COMP Task - Sync bc1 check/Process_Messages"
 /begin SUB_GROUP S730_Demux_message_CAN1_and_check_coherence S730_Demux_message_CAN1_and_check_coherence1 /end SUB_GROUP
 /begin REF_MEASUREMENT Desync_Sync_bc1_s /end REF_MEASUREMENT
/end GROUP
/begin GROUP S345_TMR_main "HANcoder_E407_TTA_Controller_v3/HANcoder STM32 Target - E407-STM32 algorithm/Global Ticks Increment/CAN Management/Matrix Cycle Manager/Controller Matrix Cycle/controller basic cycle 1/COMP Task - TMR/TMR_main"
 /begin SUB_GROUP S760_Agreement_Out1 S760_Agreement_Out2 S760_Agreement_Out3 S760_Bit_Shift S760_Bit_Shift1 S760_Bit_Shift2 S760_Bit_Shift3 S760_Bit_Shift4 S760_Bit_Shift5 S760_Bit_Shift6 /end SUB_GROUP
 /begin REF_MEASUREMENT TMR_miss1_sensor TMR_miss1_set TMR_miss2_sensor TMR_miss2_set TMR_miss_out1 TMR_miss_out2 TMR_miss_sensor TMR_miss_set error_log1_s error_log2_s error_log3_s /end REF_MEASUREMENT
/end GROUP
/begin GROUP S855_Process_Messages "HANcoder_E407_TTA_Controller_v3/HANcoder STM32 Target - E407-STM32 algorithm/Global Ticks Increment/CAN Management/Matrix Cycle Manager/Input Generator Matrix Cycle/input generator basic cycle 0/COMP Task - Sync bc0 check/Process_Messages"
 /begin SUB_GROUP S892_Demux_message_CAN1_and_check_coherence S892_Demux_message_CAN1_and_check_coherence1 /end SUB_GROUP
 /begin REF_MEASUREMENT Desync_Sync_bc0_ing_s /end REF_MEASUREMENT
/end GROUP
/begin GROUP S923_Transmission_subtasks "HANcoder_E407_TTA_Controller_v3/HANcoder STM32 Target - E407-STM32 algorithm/Global Ticks Increment/CAN Management/Matrix Cycle Manager/Input Generator Matrix Cycle/input generator basic cycle 1/COMM Task - Set_Values/Transmission subtasks" /begin SUB_GROUP S931_Msg_Value_Data_Encoded5 /end SUB_GROUP /end GROUP
/begin GROUP S928_Process_Messages "HANcoder_E407_TTA_Controller_v3/HANcoder STM32 Target - E407-STM32 algorithm/Global Ticks Increment/CAN Management/Matrix Cycle Manager/Input Generator Matrix Cycle/input generator basic cycle 1/COMP Task - Sync bc1 check/Process_Messages"
 /begin SUB_GROUP S993_Demux_message_CAN1_and_check_coherence S993_Demux_message_CAN1_and_check_coherence1 /end SUB_GROUP
 /begin REF_MEASUREMENT Desync_Sync_bc1_ing_s /end REF_MEASUREMENT
/end GROUP
/begin GROUP S1031_Process_Messages "HANcoder_E407_TTA_Controller_v3/HANcoder STM32 Target - E407-STM32 algorithm/Global Ticks Increment/CAN Management/Matrix Cycle Manager/Vehicle Emulator Matrix Cycle/vehicle emulator basic cycle 0/COMP Task - Sync bc0 check/Process_Messages"
 /begin SUB_GROUP S1071_Demux_message_CAN1_and_check_coherence S1071_Demux_message_CAN1_and_check_coherence1 /end SUB_GROUP
 /begin REF_MEASUREMENT Desync_Sync_bc0_vem_s /end REF_MEASUREMENT
/end GROUP
/begin GROUP S1033_Vehicle_Emulator_Calculate_Angles "HANcoder_E407_TTA_Controller_v3/HANcoder STM32 Target - E407-STM32 algorithm/Global Ticks Increment/CAN Management/Matrix Cycle Manager/Vehicle Emulator Matrix Cycle/vehicle emulator basic cycle 0/COMP Task - Vehicle Emulator Calculate Angles/Vehicle Emulator Calculate Angles"
 /begin SUB_GROUP S1102_Integral_theta_aft_left S1102_Integral_theta_aft_right S1102_Integral_theta_front_left S1102_Integral_theta_front_right /end SUB_GROUP
/end GROUP
/begin GROUP S1116_Process_Messages "HANcoder_E407_TTA_Controller_v3/HANcoder STM32 Target - E407-STM32 algorithm/Global Ticks Increment/CAN Management/Matrix Cycle Manager/Vehicle Emulator Matrix Cycle/vehicle emulator basic cycle 1/COMP Task - Rx Output Emulator Check/Process_Messages"
 /begin SUB_GROUP S1214_Demux_message_CAN1_and_check_coherence S1214_Demux_message_CAN1_and_check_coherence1 /end SUB_GROUP
 /begin REF_MEASUREMENT Desync_sensorvalues_vem_s Rx_msg_ticks_sensorvalues_CAN1_vem_s Rx_msg_ticks_sensorvalues_CAN2_vem_s expected_LT_sensorvalues_CAN1_vem_s expected_LT_sensorvalues_CAN2_vem_s /end REF_MEASUREMENT
/end GROUP
/begin GROUP S1116_Update_Msg_buffer "HANcoder_E407_TTA_Controller_v3/HANcoder STM32 Target - E407-STM32 algorithm/Global Ticks Increment/CAN Management/Matrix Cycle Manager/Vehicle Emulator Matrix Cycle/vehicle emulator basic cycle 1/COMP Task - Rx Output Emulator Check/Update Msg buffer" /begin REF_MEASUREMENT new_sensor_rx_vem_s /end REF_MEASUREMENT /end GROUP
/begin GROUP S1118_Process_Messages "HANcoder_E407_TTA_Controller_v3/HANcoder STM32 Target - E407-STM32 algorithm/Global Ticks Increment/CAN Management/Matrix Cycle Manager/Vehicle Emulator Matrix Cycle/vehicle emulator basic cycle 1/COMP Task - Sync bc1 check/Process_Messages"
 /begin SUB_GROUP S1266_Demux_message_CAN1_and_check_coherence S1266_Demux_message_CAN1_and_check_coherence1 /end SUB_GROUP
 /begin REF_MEASUREMENT Desync_Sync_bc1_vem_s /end REF_MEASUREMENT
/end GROUP
/begin GROUP S199_Timeout_Counter_1_DEBUG "HANcoder_E407_TTA_Controller_v3/HANcoder STM32 Target - E407-STM32 algorithm/Global Ticks Increment/CAN Management/Matrix Cycle Manager/Controller Matrix Cycle/controller basic cycle 0/COMP Task - Check Timeouts/Timeout and Board error counter/Timeout Counter 1 DEBUG" /begin REF_MEASUREMENT TM1_timeout_counter_s /end REF_MEASUREMENT /end GROUP
/begin GROUP S199_Timeout_Counter_2_DEBUG "HANcoder_E407_TTA_Controller_v3/HANcoder STM32 Target - E407-STM32 algorithm/Global Ticks Increment/CAN Management/Matrix Cycle Manager/Controller Matrix Cycle/controller basic cycle 0/COMP Task - Check Timeouts/Timeout and Board error counter/Timeout Counter 2 DEBUG" /begin REF_MEASUREMENT TM2_timeout_counter_s /end REF_MEASUREMENT /end GROUP
/begin GROUP S199_Timeout_Counter_3_DEBUG "HANcoder_E407_TTA_Controller_v3/HANcoder STM32 Target - E407-STM32 algorithm/Global Ticks Increment/CAN Management/Matrix Cycle Manager/Controller Matrix Cycle/controller basic cycle 0/COMP Task - Check Timeouts/Timeout and Board error counter/Timeout Counter 3 DEBUG" /begin REF_MEASUREMENT TM3_timeout_counter_s /end REF_MEASUREMENT /end GROUP
/begin GROUP S208_Demux_message_CAN1_and_check_coherence "HANcoder_E407_TTA_Controller_v3/HANcoder STM32 Target - E407-STM32 algorithm/Global Ticks Increment/CAN Management/Matrix Cycle Manager/Controller Matrix Cycle/controller basic cycle 0/COMP Task - Sync bc0 check/Process_Messages/Demux message CAN1 and check coherence" /begin SUB_GROUP S210_Subsystem /end SUB_GROUP /end GROUP
/begin GROUP S208_Demux_message_CAN1_and_check_coherence1 "HANcoder_E407_TTA_Controller_v3/HANcoder STM32 Target - E407-STM32 algorithm/Global Ticks Increment/CAN Management/Matrix Cycle Manager/Controller Matrix Cycle/controller basic cycle 0/COMP Task - Sync bc0 check/Process_Messages/Demux message CAN1 and check coherence1" /begin SUB_GROUP S211_Subsystem /end SUB_GROUP /end GROUP
/begin GROUP S243_Demux_message_CAN1_and_check_coherence "HANcoder_E407_TTA_Controller_v3/HANcoder STM32 Target - E407-STM32 algorithm/Global Ticks Increment/CAN Management/Matrix Cycle Manager/Controller Matrix Cycle/controller basic cycle 0/COMP Task - Vote1 check/Process_Messages1/Demux message CAN1 and check coherence" /begin SUB_GROUP S245_Subsystem /end SUB_GROUP /begin REF_MEASUREMENT Rx_temporal_vote1_CAN1 /end REF_MEASUREMENT /end GROUP
/begin GROUP S243_Demux_message_CAN1_and_check_coherence1 "HANcoder_E407_TTA_Controller_v3/HANcoder STM32 Target - E407-STM32 algorithm/Global Ticks Increment/CAN Management/Matrix Cycle Manager/Controller Matrix Cycle/controller basic cycle 0/COMP Task - Vote1 check/Process_Messages1/Demux message CAN1 and check coherence1" /begin SUB_GROUP S246_Subsystem /end SUB_GROUP /begin REF_MEASUREMENT Rx_temporal_vote1_CAN2 /end REF_MEASUREMENT /end GROUP
/begin GROUP S272_Demux_message_CAN1_and_check_coherence "HANcoder_E407_TTA_Controller_v3/HANcoder STM32 Target - E407-STM32 algorithm/Global Ticks Increment/CAN Management/Matrix Cycle Manager/Controller Matrix Cycle/controller basic cycle 0/COMP Task - Vote2 check/Process_Messages/Demux message CAN1 and check coherence" /begin SUB_GROUP S274_Subsystem /end SUB_GROUP /begin REF_MEASUREMENT Rx_temporal_vote2_CAN1 /end REF_MEASUREMENT /end GROUP
/begin GROUP S272_Demux_message_CAN1_and_check_coherence1 "HANcoder_E407_TTA_Controller_v3/HANcoder STM32 Target - E407-STM32 algorithm/Global Ticks Increment/CAN Management/Matrix Cycle Manager/Controller Matrix Cycle/controller basic cycle 0/COMP Task - Vote2 check/Process_Messages/Demux message CAN1 and check coherence1" /begin SUB_GROUP S275_Subsystem /end SUB_GROUP /begin REF_MEASUREMENT Rx_temporal_vote2_CAN2 /end REF_MEASUREMENT /end GROUP
/begin GROUP S301_Demux_message_CAN1_and_check_coherence "HANcoder_E407_TTA_Controller_v3/HANcoder STM32 Target - E407-STM32 algorithm/Global Ticks Increment/CAN Management/Matrix Cycle Manager/Controller Matrix Cycle/controller basic cycle 0/COMP Task - Vote3 check/Process_Messages/Demux message CAN1 and check coherence" /begin SUB_GROUP S303_Subsystem /end SUB_GROUP /begin REF_MEASUREMENT Rx_temporal_vote3_CAN1 /end REF_MEASUREMENT /end GROUP
/begin GROUP S301_Demux_message_CAN1_and_check_coherence1 "HANcoder_E407_TTA_Controller_v3/HANcoder STM32 Target - E407-STM32 algorithm/Global Ticks Increment/CAN Management/Matrix Cycle Manager/Controller Matrix Cycle/controller basic cycle 0/COMP Task - Vote3 check/Process_Messages/Demux message CAN1 and check coherence1" /begin SUB_GROUP S304_Subsystem /end SUB_GROUP /begin REF_MEASUREMENT Rx_temporal_vote3_CAN2 /end REF_MEASUREMENT /end GROUP
/begin GROUP S470_Msg_Value_Data_Encoded5 "HANcoder_E407_TTA_Controller_v3/HANcoder STM32 Target - E407-STM32 algorithm/Global Ticks Increment/CAN Management/Matrix Cycle Manager/Controller Matrix Cycle/controller basic cycle 1/COMM Task - Set_Values/Transmission subtasks/Msg_Value_Data_Encoded5" /begin REF_CHARACTERISTIC delta_a_set delta_f_set v_set /end REF_CHARACTERISTIC /end GROUP
/begin GROUP S529_Integral_speed "HANcoder_E407_TTA_Controller_v3/HANcoder STM32 Target - E407-STM32 algorithm/Global Ticks Increment/CAN Management/Matrix Cycle Manager/Controller Matrix Cycle/controller basic cycle 1/COMP Task - Calculate Speed/Calculate speed/Integral speed" /begin REF_MEASUREMENT v_integral_s /end REF_MEASUREMENT /end GROUP
/begin GROUP S532_Integral_delta_a_est "HANcoder_E407_TTA_Controller_v3/HANcoder STM32 Target - E407-STM32 algorithm/Global Ticks Increment/CAN Management/Matrix Cycle Manager/Controller Matrix Cycle/controller basic cycle 1/COMP Task - Calculate Steer/Calculate steering/Integral_delta_a_est" /begin REF_MEASUREMENT delta_a_est_s /end REF_MEASUREMENT /end GROUP
/begin GROUP S532_Integral_delta_f_est "HANcoder_E407_TTA_Controller_v3/HANcoder STM32 Target - E407-STM32 algorithm/Global Ticks Increment/CAN Management/Matrix Cycle Manager/Controller Matrix Cycle/controller basic cycle 1/COMP Task - Calculate Steer/Calculate steering/Integral_delta_f_est" /begin REF_MEASUREMENT delta_f_est_s /end REF_MEASUREMENT /end GROUP
/begin GROUP S546_Demux_message_CAN1_and_check_coherence "HANcoder_E407_TTA_Controller_v3/HANcoder STM32 Target - E407-STM32 algorithm/Global Ticks Increment/CAN Management/Matrix Cycle Manager/Controller Matrix Cycle/controller basic cycle 1/COMP Task - Rx_Output_Control1_Check/Process_Messages/Demux message CAN1 and check coherence" /begin SUB_GROUP S548_Subsystem /end SUB_GROUP /begin REF_MEASUREMENT Rx_temporal_outcontrol1_CAN1 /end REF_MEASUREMENT /end GROUP
/begin GROUP S546_Demux_message_CAN1_and_check_coherence1 "HANcoder_E407_TTA_Controller_v3/HANcoder STM32 Target - E407-STM32 algorithm/Global Ticks Increment/CAN Management/Matrix Cycle Manager/Controller Matrix Cycle/controller basic cycle 1/COMP Task - Rx_Output_Control1_Check/Process_Messages/Demux message CAN1 and check coherence1" /begin SUB_GROUP S549_Subsystem /end SUB_GROUP /begin REF_MEASUREMENT Rx_temporal_outcontrol1_CAN2 /end REF_MEASUREMENT /end GROUP
/begin GROUP S575_Demux_message_CAN1_and_check_coherence "HANcoder_E407_TTA_Controller_v3/HANcoder STM32 Target - E407-STM32 algorithm/Global Ticks Increment/CAN Management/Matrix Cycle Manager/Controller Matrix Cycle/controller basic cycle 1/COMP Task - Rx_Output_Control2_Check/Process_Messages/Demux message CAN1 and check coherence" /begin SUB_GROUP S577_Subsystem /end SUB_GROUP /begin REF_MEASUREMENT Rx_temporal_outcontrol2_CAN1 /end REF_MEASUREMENT /end GROUP
/begin GROUP S575_Demux_message_CAN1_and_check_coherence1 "HANcoder_E407_TTA_Controller_v3/HANcoder STM32 Target - E407-STM32 algorithm/Global Ticks Increment/CAN Management/Matrix Cycle Manager/Controller Matrix Cycle/controller basic cycle 1/COMP Task - Rx_Output_Control2_Check/Process_Messages/Demux message CAN1 and check coherence1" /begin SUB_GROUP S578_Subsystem /end SUB_GROUP /begin REF_MEASUREMENT Rx_temporal_outcontrol2_CAN2 /end REF_MEASUREMENT /end GROUP
/begin GROUP S603_Demux_message_CAN1_and_check_coherence "HANcoder_E407_TTA_Controller_v3/HANcoder STM32 Target - E407-STM32 algorithm/Global Ticks Increment/CAN Management/Matrix Cycle Manager/Controller Matrix Cycle/controller basic cycle 1/COMP Task - Rx_Output_Emulator_Check/Process_Messages/Demux message CAN1 and check coherence" /begin SUB_GROUP S605_Subsystem /end SUB_GROUP /begin REF_MEASUREMENT Rx_temporal_outemulator_CAN1 /end REF_MEASUREMENT /end GROUP
/begin GROUP S603_Demux_message_CAN1_and_check_coherence1 "HANcoder_E407_TTA_Controller_v3/HANcoder STM32 Target - E407-STM32 algorithm/Global Ticks Increment/CAN Management/Matrix Cycle Manager/Controller Matrix Cycle/controller basic cycle 1/COMP Task - Rx_Output_Emulator_Check/Process_Messages/Demux message CAN1 and check coherence1" /begin SUB_GROUP S606_Subsystem /end SUB_GROUP /begin REF_MEASUREMENT Rx_temporal_outemulator_CAN2 /end REF_MEASUREMENT /end GROUP
/begin GROUP S631_Demux_message_CAN1_and_check_coherence "HANcoder_E407_TTA_Controller_v3/HANcoder STM32 Target - E407-STM32 algorithm/Global Ticks Increment/CAN Management/Matrix Cycle Manager/Controller Matrix Cycle/controller basic cycle 1/COMP Task - Rx_Sensor_Values_Check/Process_Messages/Demux message CAN1 and check coherence" /begin SUB_GROUP S634_Subsystem /end SUB_GROUP /begin REF_MEASUREMENT Rx_temporal_sensorvalues_CAN1 /end REF_MEASUREMENT /end GROUP
/begin GROUP S631_Demux_message_CAN1_and_check_coherence1 "HANcoder_E407_TTA_Controller_v3/HANcoder STM32 Target - E407-STM32 algorithm/Global Ticks Increment/CAN Management/Matrix Cycle Manager/Controller Matrix Cycle/controller basic cycle 1/COMP Task - Rx_Sensor_Values_Check/Process_Messages/Demux message CAN1 and check coherence1" /begin SUB_GROUP S635_Subsystem /end SUB_GROUP /begin REF_MEASUREMENT Rx_temporal_sensorvalues_CAN2 /end REF_MEASUREMENT /end GROUP
/begin GROUP S684_Demux_message_CAN1_and_check_coherence "HANcoder_E407_TTA_Controller_v3/HANcoder STM32 Target - E407-STM32 algorithm/Global Ticks Increment/CAN Management/Matrix Cycle Manager/Controller Matrix Cycle/controller basic cycle 1/COMP Task - Rx_Set_Values_Check/Process_Messages/Demux message CAN1 and check coherence" /begin SUB_GROUP S687_Subsystem /end SUB_GROUP /begin REF_MEASUREMENT Rx_temporal_setvalues_CAN1 /end REF_MEASUREMENT /end GROUP
/begin GROUP S684_Demux_message_CAN1_and_check_coherence1 "HANcoder_E407_TTA_Controller_v3/HANcoder STM32 Target - E407-STM32 algorithm/Global Ticks Increment/CAN Management/Matrix Cycle Manager/Controller Matrix Cycle/controller basic cycle 1/COMP Task - Rx_Set_Values_Check/Process_Messages/Demux message CAN1 and check coherence1" /begin SUB_GROUP S688_Subsystem /end SUB_GROUP /begin REF_MEASUREMENT Rx_temporal_setvalues_CAN2 /end REF_MEASUREMENT /end GROUP
/begin GROUP S730_Demux_message_CAN1_and_check_coherence "HANcoder_E407_TTA_Controller_v3/HANcoder STM32 Target - E407-STM32 algorithm/Global Ticks Increment/CAN Management/Matrix Cycle Manager/Controller Matrix Cycle/controller basic cycle 1/COMP Task - Sync bc1 check/Process_Messages/Demux message CAN1 and check coherence" /begin SUB_GROUP S732_Subsystem /end SUB_GROUP /end GROUP
/begin GROUP S730_Demux_message_CAN1_and_check_coherence1 "HANcoder_E407_TTA_Controller_v3/HANcoder STM32 Target - E407-STM32 algorithm/Global Ticks Increment/CAN Management/Matrix Cycle Manager/Controller Matrix Cycle/controller basic cycle 1/COMP Task - Sync bc1 check/Process_Messages/Demux message CAN1 and check coherence1" /begin SUB_GROUP S733_Subsystem /end SUB_GROUP /end GROUP
/begin GROUP S760_Agreement_Out1 "HANcoder_E407_TTA_Controller_v3/HANcoder STM32 Target - E407-STM32 algorithm/Global Ticks Increment/CAN Management/Matrix Cycle Manager/Controller Matrix Cycle/controller basic cycle 1/COMP Task - TMR/TMR_main/Agreement Out1"
 /begin REF_MEASUREMENT tau_al1_agree_s tau_ar1_agree_s tau_fl1_agree_s tau_fr1_agree_s /end REF_MEASUREMENT
/end GROUP
/begin GROUP S760_Agreement_Out2 "HANcoder_E407_TTA_Controller_v3/HANcoder STM32 Target - E407-STM32 algorithm/Global Ticks Increment/CAN Management/Matrix Cycle Manager/Controller Matrix Cycle/controller basic cycle 1/COMP Task - TMR/TMR_main/Agreement Out2"
 /begin REF_MEASUREMENT tau_al2_agree_s tau_ar2_agree_s tau_fl2_agree_s tau_fr2_agree_s /end REF_MEASUREMENT
/end GROUP
/begin GROUP S760_Agreement_Out3 "HANcoder_E407_TTA_Controller_v3/HANcoder STM32 Target - E407-STM32 algorithm/Global Ticks Increment/CAN Management/Matrix Cycle Manager/Controller Matrix Cycle/controller basic cycle 1/COMP Task - TMR/TMR_main/Agreement Out3"
 /begin REF_MEASUREMENT tau_al_agree_s tau_ar_agree_s tau_fl_agree_s tau_fr_agree_s /end REF_MEASUREMENT
/end GROUP
/begin GROUP S760_Bit_Shift "HANcoder_E407_TTA_Controller_v3/HANcoder STM32 Target - E407-STM32 algorithm/Global Ticks Increment/CAN Management/Matrix Cycle Manager/Controller Matrix Cycle/controller basic cycle 1/COMP Task - TMR/TMR_main/Bit Shift" /begin REF_MEASUREMENT shift1_s /end REF_MEASUREMENT /end GROUP
/begin GROUP S760_Bit_Shift1 "HANcoder_E407_TTA_Controller_v3/HANcoder STM32 Target - E407-STM32 algorithm/Global Ticks Increment/CAN Management/Matrix Cycle Manager/Controller Matrix Cycle/controller basic cycle 1/COMP Task - TMR/TMR_main/Bit Shift1" /begin REF_MEASUREMENT shift2_s /end REF_MEASUREMENT /end GROUP
/begin GROUP S760_Bit_Shift2 "HANcoder_E407_TTA_Controller_v3/HANcoder STM32 Target - E407-STM32 algorithm/Global Ticks Increment/CAN Management/Matrix Cycle Manager/Controller Matrix Cycle/controller basic cycle 1/COMP Task - TMR/TMR_main/Bit Shift2" /begin REF_MEASUREMENT shift3_s /end REF_MEASUREMENT /end GROUP
/begin GROUP S760_Bit_Shift3 "HANcoder_E407_TTA_Controller_v3/HANcoder STM32 Target - E407-STM32 algorithm/Global Ticks Increment/CAN Management/Matrix Cycle Manager/Controller Matrix Cycle/controller basic cycle 1/COMP Task - TMR/TMR_main/Bit Shift3" /begin REF_MEASUREMENT shift4_s /end REF_MEASUREMENT /end GROUP
/begin GROUP S760_Bit_Shift4 "HANcoder_E407_TTA_Controller_v3/HANcoder STM32 Target - E407-STM32 algorithm/Global Ticks Increment/CAN Management/Matrix Cycle Manager/Controller Matrix Cycle/controller basic cycle 1/COMP Task - TMR/TMR_main/Bit Shift4" /begin REF_MEASUREMENT shift5_s /end REF_MEASUREMENT /end GROUP
/begin GROUP S760_Bit_Shift5 "HANcoder_E407_TTA_Controller_v3/HANcoder STM32 Target - E407-STM32 algorithm/Global Ticks Increment/CAN Management/Matrix Cycle Manager/Controller Matrix Cycle/controller basic cycle 1/COMP Task - TMR/TMR_main/Bit Shift5" /begin REF_MEASUREMENT shift6_s /end REF_MEASUREMENT /end GROUP
/begin GROUP S760_Bit_Shift6 "HANcoder_E407_TTA_Controller_v3/HANcoder STM32 Target - E407-STM32 algorithm/Global Ticks Increment/CAN Management/Matrix Cycle Manager/Controller Matrix Cycle/controller basic cycle 1/COMP Task - TMR/TMR_main/Bit Shift6" /begin REF_MEASUREMENT shift7_s /end REF_MEASUREMENT /end GROUP
/begin GROUP S892_Demux_message_CAN1_and_check_coherence "HANcoder_E407_TTA_Controller_v3/HANcoder STM32 Target - E407-STM32 algorithm/Global Ticks Increment/CAN Management/Matrix Cycle Manager/Input Generator Matrix Cycle/input generator basic cycle 0/COMP Task - Sync bc0 check/Process_Messages/Demux message CAN1 and check coherence" /begin SUB_GROUP S894_Subsystem /end SUB_GROUP /end GROUP
/begin GROUP S892_Demux_message_CAN1_and_check_coherence1 "HANcoder_E407_TTA_Controller_v3/HANcoder STM32 Target - E407-STM32 algorithm/Global Ticks Increment/CAN Management/Matrix Cycle Manager/Input Generator Matrix Cycle/input generator basic cycle 0/COMP Task - Sync bc0 check/Process_Messages/Demux message CAN1 and check coherence1" /begin SUB_GROUP S895_Subsystem /end SUB_GROUP /end GROUP
/begin GROUP S931_Msg_Value_Data_Encoded5 "HANcoder_E407_TTA_Controller_v3/HANcoder STM32 Target - E407-STM32 algorithm/Global Ticks Increment/CAN Management/Matrix Cycle Manager/Input Generator Matrix Cycle/input generator basic cycle 1/COMM Task - Set_Values/Transmission subtasks/Msg_Value_Data_Encoded5" /begin REF_CHARACTERISTIC delta_a_set delta_f_set v_set /end REF_CHARACTERISTIC /end GROUP
/begin GROUP S993_Demux_message_CAN1_and_check_coherence "HANcoder_E407_TTA_Controller_v3/HANcoder STM32 Target - E407-STM32 algorithm/Global Ticks Increment/CAN Management/Matrix Cycle Manager/Input Generator Matrix Cycle/input generator basic cycle 1/COMP Task - Sync bc1 check/Process_Messages/Demux message CAN1 and check coherence" /begin SUB_GROUP S995_Subsystem /end SUB_GROUP /end GROUP
/begin GROUP S993_Demux_message_CAN1_and_check_coherence1 "HANcoder_E407_TTA_Controller_v3/HANcoder STM32 Target - E407-STM32 algorithm/Global Ticks Increment/CAN Management/Matrix Cycle Manager/Input Generator Matrix Cycle/input generator basic cycle 1/COMP Task - Sync bc1 check/Process_Messages/Demux message CAN1 and check coherence1" /begin SUB_GROUP S996_Subsystem /end SUB_GROUP /end GROUP
/begin GROUP S1071_Demux_message_CAN1_and_check_coherence "HANcoder_E407_TTA_Controller_v3/HANcoder STM32 Target - E407-STM32 algorithm/Global Ticks Increment/CAN Management/Matrix Cycle Manager/Vehicle Emulator Matrix Cycle/vehicle emulator basic cycle 0/COMP Task - Sync bc0 check/Process_Messages/Demux message CAN1 and check coherence" /begin SUB_GROUP S1073_Subsystem /end SUB_GROUP /end GROUP
/begin GROUP S1071_Demux_message_CAN1_and_check_coherence1 "HANcoder_E407_TTA_Controller_v3/HANcoder STM32 Target - E407-STM32 algorithm/Global Ticks Increment/CAN Management/Matrix Cycle Manager/Vehicle Emulator Matrix Cycle/vehicle emulator basic cycle 0/COMP Task - Sync bc0 check/Process_Messages/Demux message CAN1 and check coherence1" /begin SUB_GROUP S1074_Subsystem /end SUB_GROUP /end GROUP
/begin GROUP S1102_Integral_theta_aft_left "HANcoder_E407_TTA_Controller_v3/HANcoder STM32 Target - E407-STM32 algorithm/Global Ticks Increment/CAN Management/Matrix Cycle Manager/Vehicle Emulator Matrix Cycle/vehicle emulator basic cycle 0/COMP Task - Vehicle Emulator Calculate Angles/Vehicle Emulator Calculate Angles/Integral theta aft left" /begin REF_MEASUREMENT theta_al_s /end REF_MEASUREMENT /end GROUP
/begin GROUP S1102_Integral_theta_aft_right "HANcoder_E407_TTA_Controller_v3/HANcoder STM32 Target - E407-STM32 algorithm/Global Ticks Increment/CAN Management/Matrix Cycle Manager/Vehicle Emulator Matrix Cycle/vehicle emulator basic cycle 0/COMP Task - Vehicle Emulator Calculate Angles/Vehicle Emulator Calculate Angles/Integral theta aft right" /begin REF_MEASUREMENT theta_ar_s /end REF_MEASUREMENT /end GROUP
/begin GROUP S1102_Integral_theta_front_left "HANcoder_E407_TTA_Controller_v3/HANcoder STM32 Target - E407-STM32 algorithm/Global Ticks Increment/CAN Management/Matrix Cycle Manager/Vehicle Emulator Matrix Cycle/vehicle emulator basic cycle 0/COMP Task - Vehicle Emulator Calculate Angles/Vehicle Emulator Calculate Angles/Integral theta front left" /begin REF_MEASUREMENT theta_fl_s /end REF_MEASUREMENT /end GROUP
/begin GROUP S1102_Integral_theta_front_right "HANcoder_E407_TTA_Controller_v3/HANcoder STM32 Target - E407-STM32 algorithm/Global Ticks Increment/CAN Management/Matrix Cycle Manager/Vehicle Emulator Matrix Cycle/vehicle emulator basic cycle 0/COMP Task - Vehicle Emulator Calculate Angles/Vehicle Emulator Calculate Angles/Integral theta front right" /begin REF_MEASUREMENT theta_fr_s /end REF_MEASUREMENT /end GROUP
/begin GROUP S1214_Demux_message_CAN1_and_check_coherence "HANcoder_E407_TTA_Controller_v3/HANcoder STM32 Target - E407-STM32 algorithm/Global Ticks Increment/CAN Management/Matrix Cycle Manager/Vehicle Emulator Matrix Cycle/vehicle emulator basic cycle 1/COMP Task - Rx Output Emulator Check/Process_Messages/Demux message CAN1 and check coherence" /begin SUB_GROUP S1217_Subsystem /end SUB_GROUP /begin REF_MEASUREMENT Rx_temporal_sensorvalues_CAN1_vem /end REF_MEASUREMENT /end GROUP
/begin GROUP S1214_Demux_message_CAN1_and_check_coherence1 "HANcoder_E407_TTA_Controller_v3/HANcoder STM32 Target - E407-STM32 algorithm/Global Ticks Increment/CAN Management/Matrix Cycle Manager/Vehicle Emulator Matrix Cycle/vehicle emulator basic cycle 1/COMP Task - Rx Output Emulator Check/Process_Messages/Demux message CAN1 and check coherence1" /begin SUB_GROUP S1218_Subsystem /end SUB_GROUP /begin REF_MEASUREMENT Rx_temporal_sensorvalues_CAN2_vem /end REF_MEASUREMENT /end GROUP
/begin GROUP S1266_Demux_message_CAN1_and_check_coherence "HANcoder_E407_TTA_Controller_v3/HANcoder STM32 Target - E407-STM32 algorithm/Global Ticks Increment/CAN Management/Matrix Cycle Manager/Vehicle Emulator Matrix Cycle/vehicle emulator basic cycle 1/COMP Task - Sync bc1 check/Process_Messages/Demux message CAN1 and check coherence" /begin SUB_GROUP S1268_Subsystem /end SUB_GROUP /end GROUP
/begin GROUP S1266_Demux_message_CAN1_and_check_coherence1 "HANcoder_E407_TTA_Controller_v3/HANcoder STM32 Target - E407-STM32 algorithm/Global Ticks Increment/CAN Management/Matrix Cycle Manager/Vehicle Emulator Matrix Cycle/vehicle emulator basic cycle 1/COMP Task - Sync bc1 check/Process_Messages/Demux message CAN1 and check coherence1" /begin SUB_GROUP S1269_Subsystem /end SUB_GROUP /end GROUP
/begin GROUP S210_Subsystem "HANcoder_E407_TTA_Controller_v3/HANcoder STM32 Target - E407-STM32 algorithm/Global Ticks Increment/CAN Management/Matrix Cycle Manager/Controller Matrix Cycle/controller basic cycle 0/COMP Task - Sync bc0 check/Process_Messages/Demux message CAN1 and check coherence/Subsystem" /begin SUB_GROUP S212_Bit_Shift S212_Bit_Shift1 S212_Bit_Shift2 /end SUB_GROUP /end GROUP
/begin GROUP S211_Subsystem "HANcoder_E407_TTA_Controller_v3/HANcoder STM32 Target - E407-STM32 algorithm/Global Ticks Increment/CAN Management/Matrix Cycle Manager/Controller Matrix Cycle/controller basic cycle 0/COMP Task - Sync bc0 check/Process_Messages/Demux message CAN1 and check coherence1/Subsystem" /begin SUB_GROUP S224_Bit_Shift S224_Bit_Shift1 S224_Bit_Shift2 /end SUB_GROUP /end GROUP
/begin GROUP S245_Subsystem "HANcoder_E407_TTA_Controller_v3/HANcoder STM32 Target - E407-STM32 algorithm/Global Ticks Increment/CAN Management/Matrix Cycle Manager/Controller Matrix Cycle/controller basic cycle 0/COMP Task - Vote1 check/Process_Messages1/Demux message CAN1 and check coherence/Subsystem" /begin SUB_GROUP S247_Bit_Shift S247_Bit_Shift1 S247_Bit_Shift2 /end SUB_GROUP /end GROUP
/begin GROUP S246_Subsystem "HANcoder_E407_TTA_Controller_v3/HANcoder STM32 Target - E407-STM32 algorithm/Global Ticks Increment/CAN Management/Matrix Cycle Manager/Controller Matrix Cycle/controller basic cycle 0/COMP Task - Vote1 check/Process_Messages1/Demux message CAN1 and check coherence1/Subsystem" /begin SUB_GROUP S259_Bit_Shift S259_Bit_Shift1 S259_Bit_Shift2 /end SUB_GROUP /end GROUP
/begin GROUP S274_Subsystem "HANcoder_E407_TTA_Controller_v3/HANcoder STM32 Target - E407-STM32 algorithm/Global Ticks Increment/CAN Management/Matrix Cycle Manager/Controller Matrix Cycle/controller basic cycle 0/COMP Task - Vote2 check/Process_Messages/Demux message CAN1 and check coherence/Subsystem" /begin SUB_GROUP S276_Bit_Shift S276_Bit_Shift1 S276_Bit_Shift2 /end SUB_GROUP /end GROUP
/begin GROUP S275_Subsystem "HANcoder_E407_TTA_Controller_v3/HANcoder STM32 Target - E407-STM32 algorithm/Global Ticks Increment/CAN Management/Matrix Cycle Manager/Controller Matrix Cycle/controller basic cycle 0/COMP Task - Vote2 check/Process_Messages/Demux message CAN1 and check coherence1/Subsystem" /begin SUB_GROUP S288_Bit_Shift S288_Bit_Shift1 S288_Bit_Shift2 /end SUB_GROUP /end GROUP
/begin GROUP S303_Subsystem "HANcoder_E407_TTA_Controller_v3/HANcoder STM32 Target - E407-STM32 algorithm/Global Ticks Increment/CAN Management/Matrix Cycle Manager/Controller Matrix Cycle/controller basic cycle 0/COMP Task - Vote3 check/Process_Messages/Demux message CAN1 and check coherence/Subsystem" /begin SUB_GROUP S305_Bit_Shift S305_Bit_Shift1 S305_Bit_Shift2 /end SUB_GROUP /end GROUP
/begin GROUP S304_Subsystem "HANcoder_E407_TTA_Controller_v3/HANcoder STM32 Target - E407-STM32 algorithm/Global Ticks Increment/CAN Management/Matrix Cycle Manager/Controller Matrix Cycle/controller basic cycle 0/COMP Task - Vote3 check/Process_Messages/Demux message CAN1 and check coherence1/Subsystem" /begin SUB_GROUP S317_Bit_Shift S317_Bit_Shift1 S317_Bit_Shift2 /end SUB_GROUP /end GROUP
/begin GROUP S548_Subsystem "HANcoder_E407_TTA_Controller_v3/HANcoder STM32 Target - E407-STM32 algorithm/Global Ticks Increment/CAN Management/Matrix Cycle Manager/Controller Matrix Cycle/controller basic cycle 1/COMP Task - Rx_Output_Control1_Check/Process_Messages/Demux message CAN1 and check coherence/Subsystem" /begin SUB_GROUP S550_Bit_Shift S550_Bit_Shift1 S550_Bit_Shift2 /end SUB_GROUP /end GROUP
/begin GROUP S549_Subsystem "HANcoder_E407_TTA_Controller_v3/HANcoder STM32 Target - E407-STM32 algorithm/Global Ticks Increment/CAN Management/Matrix Cycle Manager/Controller Matrix Cycle/controller basic cycle 1/COMP Task - Rx_Output_Control1_Check/Process_Messages/Demux message CAN1 and check coherence1/Subsystem" /begin SUB_GROUP S562_Bit_Shift S562_Bit_Shift1 S562_Bit_Shift2 /end SUB_GROUP /end GROUP
/begin GROUP S577_Subsystem "HANcoder_E407_TTA_Controller_v3/HANcoder STM32 Target - E407-STM32 algorithm/Global Ticks Increment/CAN Management/Matrix Cycle Manager/Controller Matrix Cycle/controller basic cycle 1/COMP Task - Rx_Output_Control2_Check/Process_Messages/Demux message CAN1 and check coherence/Subsystem" /begin SUB_GROUP S579_Bit_Shift S579_Bit_Shift1 S579_Bit_Shift2 /end SUB_GROUP /end GROUP
/begin GROUP S578_Subsystem "HANcoder_E407_TTA_Controller_v3/HANcoder STM32 Target - E407-STM32 algorithm/Global Ticks Increment/CAN Management/Matrix Cycle Manager/Controller Matrix Cycle/controller basic cycle 1/COMP Task - Rx_Output_Control2_Check/Process_Messages/Demux message CAN1 and check coherence1/Subsystem" /begin SUB_GROUP S591_Bit_Shift S591_Bit_Shift1 S591_Bit_Shift2 /end SUB_GROUP /end GROUP
/begin GROUP S605_Subsystem "HANcoder_E407_TTA_Controller_v3/HANcoder STM32 Target - E407-STM32 algorithm/Global Ticks Increment/CAN Management/Matrix Cycle Manager/Controller Matrix Cycle/controller basic cycle 1/COMP Task - Rx_Output_Emulator_Check/Process_Messages/Demux message CAN1 and check coherence/Subsystem" /begin SUB_GROUP S607_Bit_Shift S607_Bit_Shift1 S607_Bit_Shift2 /end SUB_GROUP /end GROUP
/begin GROUP S606_Subsystem "HANcoder_E407_TTA_Controller_v3/HANcoder STM32 Target - E407-STM32 algorithm/Global Ticks Increment/CAN Management/Matrix Cycle Manager/Controller Matrix Cycle/controller basic cycle 1/COMP Task - Rx_Output_Emulator_Check/Process_Messages/Demux message CAN1 and check coherence1/Subsystem" /begin SUB_GROUP S619_Bit_Shift S619_Bit_Shift1 S619_Bit_Shift2 /end SUB_GROUP /end GROUP
/begin GROUP S634_Subsystem "HANcoder_E407_TTA_Controller_v3/HANcoder STM32 Target - E407-STM32 algorithm/Global Ticks Increment/CAN Management/Matrix Cycle Manager/Controller Matrix Cycle/controller basic cycle 1/COMP Task - Rx_Sensor_Values_Check/Process_Messages/Demux message CAN1 and check coherence/Subsystem" /begin SUB_GROUP S636_Bit_Shift S636_Bit_Shift1 S636_Bit_Shift2 /end SUB_GROUP /end GROUP
/begin GROUP S635_Subsystem "HANcoder_E407_TTA_Controller_v3/HANcoder STM32 Target - E407-STM32 algorithm/Global Ticks Increment/CAN Management/Matrix Cycle Manager/Controller Matrix Cycle/controller basic cycle 1/COMP Task - Rx_Sensor_Values_Check/Process_Messages/Demux message CAN1 and check coherence1/Subsystem" /begin SUB_GROUP S648_Bit_Shift S648_Bit_Shift1 S648_Bit_Shift2 /end SUB_GROUP /end GROUP
/begin GROUP S687_Subsystem "HANcoder_E407_TTA_Controller_v3/HANcoder STM32 Target - E407-STM32 algorithm/Global Ticks Increment/CAN Management/Matrix Cycle Manager/Controller Matrix Cycle/controller basic cycle 1/COMP Task - Rx_Set_Values_Check/Process_Messages/Demux message CAN1 and check coherence/Subsystem" /begin SUB_GROUP S689_Bit_Shift S689_Bit_Shift1 S689_Bit_Shift2 /end SUB_GROUP /end GROUP
/begin GROUP S688_Subsystem "HANcoder_E407_TTA_Controller_v3/HANcoder STM32 Target - E407-STM32 algorithm/Global Ticks Increment/CAN Management/Matrix Cycle Manager/Controller Matrix Cycle/controller basic cycle 1/COMP Task - Rx_Set_Values_Check/Process_Messages/Demux message CAN1 and check coherence1/Subsystem" /begin SUB_GROUP S701_Bit_Shift S701_Bit_Shift1 S701_Bit_Shift2 /end SUB_GROUP /end GROUP
/begin GROUP S732_Subsystem "HANcoder_E407_TTA_Controller_v3/HANcoder STM32 Target - E407-STM32 algorithm/Global Ticks Increment/CAN Management/Matrix Cycle Manager/Controller Matrix Cycle/controller basic cycle 1/COMP Task - Sync bc1 check/Process_Messages/Demux message CAN1 and check coherence/Subsystem" /begin SUB_GROUP S734_Bit_Shift S734_Bit_Shift1 S734_Bit_Shift2 /end SUB_GROUP /end GROUP
/begin GROUP S733_Subsystem "HANcoder_E407_TTA_Controller_v3/HANcoder STM32 Target - E407-STM32 algorithm/Global Ticks Increment/CAN Management/Matrix Cycle Manager/Controller Matrix Cycle/controller basic cycle 1/COMP Task - Sync bc1 check/Process_Messages/Demux message CAN1 and check coherence1/Subsystem" /begin SUB_GROUP S746_Bit_Shift S746_Bit_Shift1 S746_Bit_Shift2 /end SUB_GROUP /end GROUP
/begin GROUP S894_Subsystem "HANcoder_E407_TTA_Controller_v3/HANcoder STM32 Target - E407-STM32 algorithm/Global Ticks Increment/CAN Management/Matrix Cycle Manager/Input Generator Matrix Cycle/input generator basic cycle 0/COMP Task - Sync bc0 check/Process_Messages/Demux message CAN1 and check coherence/Subsystem" /begin SUB_GROUP S896_Bit_Shift S896_Bit_Shift1 S896_Bit_Shift2 /end SUB_GROUP /end GROUP
/begin GROUP S895_Subsystem "HANcoder_E407_TTA_Controller_v3/HANcoder STM32 Target - E407-STM32 algorithm/Global Ticks Increment/CAN Management/Matrix Cycle Manager/Input Generator Matrix Cycle/input generator basic cycle 0/COMP Task - Sync bc0 check/Process_Messages/Demux message CAN1 and check coherence1/Subsystem" /begin SUB_GROUP S908_Bit_Shift S908_Bit_Shift1 S908_Bit_Shift2 /end SUB_GROUP /end GROUP
/begin GROUP S995_Subsystem "HANcoder_E407_TTA_Controller_v3/HANcoder STM32 Target - E407-STM32 algorithm/Global Ticks Increment/CAN Management/Matrix Cycle Manager/Input Generator Matrix Cycle/input generator basic cycle 1/COMP Task - Sync bc1 check/Process_Messages/Demux message CAN1 and check coherence/Subsystem" /begin SUB_GROUP S997_Bit_Shift S997_Bit_Shift1 S997_Bit_Shift2 /end SUB_GROUP /end GROUP
/begin GROUP S996_Subsystem "HANcoder_E407_TTA_Controller_v3/HANcoder STM32 Target - E407-STM32 algorithm/Global Ticks Increment/CAN Management/Matrix Cycle Manager/Input Generator Matrix Cycle/input generator basic cycle 1/COMP Task - Sync bc1 check/Process_Messages/Demux message CAN1 and check coherence1/Subsystem" /begin SUB_GROUP S1009_Bit_Shift S1009_Bit_Shift1 S1009_Bit_Shift2 /end SUB_GROUP /end GROUP
/begin GROUP S1073_Subsystem "HANcoder_E407_TTA_Controller_v3/HANcoder STM32 Target - E407-STM32 algorithm/Global Ticks Increment/CAN Management/Matrix Cycle Manager/Vehicle Emulator Matrix Cycle/vehicle emulator basic cycle 0/COMP Task - Sync bc0 check/Process_Messages/Demux message CAN1 and check coherence/Subsystem" /begin SUB_GROUP S1075_Bit_Shift S1075_Bit_Shift1 S1075_Bit_Shift2 /end SUB_GROUP /end GROUP
/begin GROUP S1074_Subsystem "HANcoder_E407_TTA_Controller_v3/HANcoder STM32 Target - E407-STM32 algorithm/Global Ticks Increment/CAN Management/Matrix Cycle Manager/Vehicle Emulator Matrix Cycle/vehicle emulator basic cycle 0/COMP Task - Sync bc0 check/Process_Messages/Demux message CAN1 and check coherence1/Subsystem" /begin SUB_GROUP S1087_Bit_Shift S1087_Bit_Shift1 S1087_Bit_Shift2 /end SUB_GROUP /end GROUP
/begin GROUP S1217_Subsystem "HANcoder_E407_TTA_Controller_v3/HANcoder STM32 Target - E407-STM32 algorithm/Global Ticks Increment/CAN Management/Matrix Cycle Manager/Vehicle Emulator Matrix Cycle/vehicle emulator basic cycle 1/COMP Task - Rx Output Emulator Check/Process_Messages/Demux message CAN1 and check coherence/Subsystem" /begin SUB_GROUP S1219_Bit_Shift S1219_Bit_Shift1 S1219_Bit_Shift2 /end SUB_GROUP /end GROUP
/begin GROUP S1218_Subsystem "HANcoder_E407_TTA_Controller_v3/HANcoder STM32 Target - E407-STM32 algorithm/Global Ticks Increment/CAN Management/Matrix Cycle Manager/Vehicle Emulator Matrix Cycle/vehicle emulator basic cycle 1/COMP Task - Rx Output Emulator Check/Process_Messages/Demux message CAN1 and check coherence1/Subsystem" /begin SUB_GROUP S1231_Bit_Shift S1231_Bit_Shift1 S1231_Bit_Shift2 /end SUB_GROUP /end GROUP
/begin GROUP S1268_Subsystem "HANcoder_E407_TTA_Controller_v3/HANcoder STM32 Target - E407-STM32 algorithm/Global Ticks Increment/CAN Management/Matrix Cycle Manager/Vehicle Emulator Matrix Cycle/vehicle emulator basic cycle 1/COMP Task - Sync bc1 check/Process_Messages/Demux message CAN1 and check coherence/Subsystem" /begin SUB_GROUP S1270_Bit_Shift S1270_Bit_Shift1 S1270_Bit_Shift2 /end SUB_GROUP /end GROUP
/begin GROUP S1269_Subsystem "HANcoder_E407_TTA_Controller_v3/HANcoder STM32 Target - E407-STM32 algorithm/Global Ticks Increment/CAN Management/Matrix Cycle Manager/Vehicle Emulator Matrix Cycle/vehicle emulator basic cycle 1/COMP Task - Sync bc1 check/Process_Messages/Demux message CAN1 and check coherence1/Subsystem" /begin SUB_GROUP S1282_Bit_Shift S1282_Bit_Shift1 S1282_Bit_Shift2 /end SUB_GROUP /end GROUP
/begin GROUP S212_Bit_Shift "HANcoder_E407_TTA_Controller_v3/HANcoder STM32 Target - E407-STM32 algorithm/Global Ticks Increment/CAN Management/Matrix Cycle Manager/Controller Matrix Cycle/controller basic cycle 0/COMP Task - Sync bc0 check/Process_Messages/Demux message CAN1 and check coherence/Subsystem/Bit Shift" /begin REF_MEASUREMENT Rx_bc_sync0_CAN1 /end REF_MEASUREMENT /end GROUP
/begin GROUP S212_Bit_Shift1 "HANcoder_E407_TTA_Controller_v3/HANcoder STM32 Target - E407-STM32 algorithm/Global Ticks Increment/CAN Management/Matrix Cycle Manager/Controller Matrix Cycle/controller basic cycle 0/COMP Task - Sync bc0 check/Process_Messages/Demux message CAN1 and check coherence/Subsystem/Bit Shift1" /begin REF_MEASUREMENT Rx_mc_sync0_CAN1 /end REF_MEASUREMENT /end GROUP
/begin GROUP S212_Bit_Shift2 "HANcoder_E407_TTA_Controller_v3/HANcoder STM32 Target - E407-STM32 algorithm/Global Ticks Increment/CAN Management/Matrix Cycle Manager/Controller Matrix Cycle/controller basic cycle 0/COMP Task - Sync bc0 check/Process_Messages/Demux message CAN1 and check coherence/Subsystem/Bit Shift2" /begin REF_MEASUREMENT Rx_id_sync0_CAN1 /end REF_MEASUREMENT /end GROUP
/begin GROUP S224_Bit_Shift "HANcoder_E407_TTA_Controller_v3/HANcoder STM32 Target - E407-STM32 algorithm/Global Ticks Increment/CAN Management/Matrix Cycle Manager/Controller Matrix Cycle/controller basic cycle 0/COMP Task - Sync bc0 check/Process_Messages/Demux message CAN1 and check coherence1/Subsystem/Bit Shift" /begin REF_MEASUREMENT Rx_bc_sync0_CAN2 /end REF_MEASUREMENT /end GROUP
/begin GROUP S224_Bit_Shift1 "HANcoder_E407_TTA_Controller_v3/HANcoder STM32 Target - E407-STM32 algorithm/Global Ticks Increment/CAN Management/Matrix Cycle Manager/Controller Matrix Cycle/controller basic cycle 0/COMP Task - Sync bc0 check/Process_Messages/Demux message CAN1 and check coherence1/Subsystem/Bit Shift1" /begin REF_MEASUREMENT Rx_mc_sync0_CAN2 /end REF_MEASUREMENT /end GROUP
/begin GROUP S224_Bit_Shift2 "HANcoder_E407_TTA_Controller_v3/HANcoder STM32 Target - E407-STM32 algorithm/Global Ticks Increment/CAN Management/Matrix Cycle Manager/Controller Matrix Cycle/controller basic cycle 0/COMP Task - Sync bc0 check/Process_Messages/Demux message CAN1 and check coherence1/Subsystem/Bit Shift2" /begin REF_MEASUREMENT Rx_id_sync0_CAN2 /end REF_MEASUREMENT /end GROUP
/begin GROUP S247_Bit_Shift "HANcoder_E407_TTA_Controller_v3/HANcoder STM32 Target - E407-STM32 algorithm/Global Ticks Increment/CAN Management/Matrix Cycle Manager/Controller Matrix Cycle/controller basic cycle 0/COMP Task - Vote1 check/Process_Messages1/Demux message CAN1 and check coherence/Subsystem/Bit Shift" /begin REF_MEASUREMENT Rx_bc_vote1_CAN1 /end REF_MEASUREMENT /end GROUP
/begin GROUP S247_Bit_Shift1 "HANcoder_E407_TTA_Controller_v3/HANcoder STM32 Target - E407-STM32 algorithm/Global Ticks Increment/CAN Management/Matrix Cycle Manager/Controller Matrix Cycle/controller basic cycle 0/COMP Task - Vote1 check/Process_Messages1/Demux message CAN1 and check coherence/Subsystem/Bit Shift1" /begin REF_MEASUREMENT Rx_mc_vote1_CAN1 /end REF_MEASUREMENT /end GROUP
/begin GROUP S247_Bit_Shift2 "HANcoder_E407_TTA_Controller_v3/HANcoder STM32 Target - E407-STM32 algorithm/Global Ticks Increment/CAN Management/Matrix Cycle Manager/Controller Matrix Cycle/controller basic cycle 0/COMP Task - Vote1 check/Process_Messages1/Demux message CAN1 and check coherence/Subsystem/Bit Shift2" /begin REF_MEASUREMENT Rx_id_vote1_CAN1 /end REF_MEASUREMENT /end GROUP
/begin GROUP S259_Bit_Shift "HANcoder_E407_TTA_Controller_v3/HANcoder STM32 Target - E407-STM32 algorithm/Global Ticks Increment/CAN Management/Matrix Cycle Manager/Controller Matrix Cycle/controller basic cycle 0/COMP Task - Vote1 check/Process_Messages1/Demux message CAN1 and check coherence1/Subsystem/Bit Shift" /begin REF_MEASUREMENT Rx_bc_vote1_CAN2 /end REF_MEASUREMENT /end GROUP
/begin GROUP S259_Bit_Shift1 "HANcoder_E407_TTA_Controller_v3/HANcoder STM32 Target - E407-STM32 algorithm/Global Ticks Increment/CAN Management/Matrix Cycle Manager/Controller Matrix Cycle/controller basic cycle 0/COMP Task - Vote1 check/Process_Messages1/Demux message CAN1 and check coherence1/Subsystem/Bit Shift1" /begin REF_MEASUREMENT Rx_mc_vote1_CAN2 /end REF_MEASUREMENT /end GROUP
/begin GROUP S259_Bit_Shift2 "HANcoder_E407_TTA_Controller_v3/HANcoder STM32 Target - E407-STM32 algorithm/Global Ticks Increment/CAN Management/Matrix Cycle Manager/Controller Matrix Cycle/controller basic cycle 0/COMP Task - Vote1 check/Process_Messages1/Demux message CAN1 and check coherence1/Subsystem/Bit Shift2" /begin REF_MEASUREMENT Rx_id_vote1_CAN2 /end REF_MEASUREMENT /end GROUP
/begin GROUP S276_Bit_Shift "HANcoder_E407_TTA_Controller_v3/HANcoder STM32 Target - E407-STM32 algorithm/Global Ticks Increment/CAN Management/Matrix Cycle Manager/Controller Matrix Cycle/controller basic cycle 0/COMP Task - Vote2 check/Process_Messages/Demux message CAN1 and check coherence/Subsystem/Bit Shift" /begin REF_MEASUREMENT Rx_bc_vote2_CAN1 /end REF_MEASUREMENT /end GROUP
/begin GROUP S276_Bit_Shift1 "HANcoder_E407_TTA_Controller_v3/HANcoder STM32 Target - E407-STM32 algorithm/Global Ticks Increment/CAN Management/Matrix Cycle Manager/Controller Matrix Cycle/controller basic cycle 0/COMP Task - Vote2 check/Process_Messages/Demux message CAN1 and check coherence/Subsystem/Bit Shift1" /begin REF_MEASUREMENT Rx_mc_vote2_CAN1 /end REF_MEASUREMENT /end GROUP
/begin GROUP S276_Bit_Shift2 "HANcoder_E407_TTA_Controller_v3/HANcoder STM32 Target - E407-STM32 algorithm/Global Ticks Increment/CAN Management/Matrix Cycle Manager/Controller Matrix Cycle/controller basic cycle 0/COMP Task - Vote2 check/Process_Messages/Demux message CAN1 and check coherence/Subsystem/Bit Shift2" /begin REF_MEASUREMENT Rx_id_vote2_CAN1 /end REF_MEASUREMENT /end GROUP
/begin GROUP S288_Bit_Shift "HANcoder_E407_TTA_Controller_v3/HANcoder STM32 Target - E407-STM32 algorithm/Global Ticks Increment/CAN Management/Matrix Cycle Manager/Controller Matrix Cycle/controller basic cycle 0/COMP Task - Vote2 check/Process_Messages/Demux message CAN1 and check coherence1/Subsystem/Bit Shift" /begin REF_MEASUREMENT Rx_bc_vote2_CAN2 /end REF_MEASUREMENT /end GROUP
/begin GROUP S288_Bit_Shift1 "HANcoder_E407_TTA_Controller_v3/HANcoder STM32 Target - E407-STM32 algorithm/Global Ticks Increment/CAN Management/Matrix Cycle Manager/Controller Matrix Cycle/controller basic cycle 0/COMP Task - Vote2 check/Process_Messages/Demux message CAN1 and check coherence1/Subsystem/Bit Shift1" /begin REF_MEASUREMENT Rx_mc_vote2_CAN2 /end REF_MEASUREMENT /end GROUP
/begin GROUP S288_Bit_Shift2 "HANcoder_E407_TTA_Controller_v3/HANcoder STM32 Target - E407-STM32 algorithm/Global Ticks Increment/CAN Management/Matrix Cycle Manager/Controller Matrix Cycle/controller basic cycle 0/COMP Task - Vote2 check/Process_Messages/Demux message CAN1 and check coherence1/Subsystem/Bit Shift2" /begin REF_MEASUREMENT Rx_id_vote2_CAN2 /end REF_MEASUREMENT /end GROUP
/begin GROUP S305_Bit_Shift "HANcoder_E407_TTA_Controller_v3/HANcoder STM32 Target - E407-STM32 algorithm/Global Ticks Increment/CAN Management/Matrix Cycle Manager/Controller Matrix Cycle/controller basic cycle 0/COMP Task - Vote3 check/Process_Messages/Demux message CAN1 and check coherence/Subsystem/Bit Shift" /begin REF_MEASUREMENT Rx_bc_vote3_CAN1 /end REF_MEASUREMENT /end GROUP
/begin GROUP S305_Bit_Shift1 "HANcoder_E407_TTA_Controller_v3/HANcoder STM32 Target - E407-STM32 algorithm/Global Ticks Increment/CAN Management/Matrix Cycle Manager/Controller Matrix Cycle/controller basic cycle 0/COMP Task - Vote3 check/Process_Messages/Demux message CAN1 and check coherence/Subsystem/Bit Shift1" /begin REF_MEASUREMENT Rx_mc_vote3_CAN1 /end REF_MEASUREMENT /end GROUP
/begin GROUP S305_Bit_Shift2 "HANcoder_E407_TTA_Controller_v3/HANcoder STM32 Target - E407-STM32 algorithm/Global Ticks Increment/CAN Management/Matrix Cycle Manager/Controller Matrix Cycle/controller basic cycle 0/COMP Task - Vote3 check/Process_Messages/Demux message CAN1 and check coherence/Subsystem/Bit Shift2" /begin REF_MEASUREMENT Rx_id_vote3_CAN1 /end REF_MEASUREMENT /end GROUP
/begin GROUP S317_Bit_Shift "HANcoder_E407_TTA_Controller_v3/HANcoder STM32 Target - E407-STM32 algorithm/Global Ticks Increment/CAN Management/Matrix Cycle Manager/Controller Matrix Cycle/controller basic cycle 0/COMP Task - Vote3 check/Process_Messages/Demux message CAN1 and check coherence1/Subsystem/Bit Shift" /begin REF_MEASUREMENT Rx_bc_vote3_CAN2 /end REF_MEASUREMENT /end GROUP
/begin GROUP S317_Bit_Shift1 "HANcoder_E407_TTA_Controller_v3/HANcoder STM32 Target - E407-STM32 algorithm/Global Ticks Increment/CAN Management/Matrix Cycle Manager/Controller Matrix Cycle/controller basic cycle 0/COMP Task - Vote3 check/Process_Messages/Demux message CAN1 and check coherence1/Subsystem/Bit Shift1" /begin REF_MEASUREMENT Rx_mc_vote3_CAN2 /end REF_MEASUREMENT /end GROUP
/begin GROUP S317_Bit_Shift2 "HANcoder_E407_TTA_Controller_v3/HANcoder STM32 Target - E407-STM32 algorithm/Global Ticks Increment/CAN Management/Matrix Cycle Manager/Controller Matrix Cycle/controller basic cycle 0/COMP Task - Vote3 check/Process_Messages/Demux message CAN1 and check coherence1/Subsystem/Bit Shift2" /begin REF_MEASUREMENT Rx_id_vote3_CAN2 /end REF_MEASUREMENT /end GROUP
/begin GROUP S550_Bit_Shift "HANcoder_E407_TTA_Controller_v3/HANcoder STM32 Target - E407-STM32 algorithm/Global Ticks Increment/CAN Management/Matrix Cycle Manager/Controller Matrix Cycle/controller basic cycle 1/COMP Task - Rx_Output_Control1_Check/Process_Messages/Demux message CAN1 and check coherence/Subsystem/Bit Shift" /begin REF_MEASUREMENT Rx_bc_outcontrol1_CAN1 /end REF_MEASUREMENT /end GROUP
/begin GROUP S550_Bit_Shift1 "HANcoder_E407_TTA_Controller_v3/HANcoder STM32 Target - E407-STM32 algorithm/Global Ticks Increment/CAN Management/Matrix Cycle Manager/Controller Matrix Cycle/controller basic cycle 1/COMP Task - Rx_Output_Control1_Check/Process_Messages/Demux message CAN1 and check coherence/Subsystem/Bit Shift1" /begin REF_MEASUREMENT Rx_mc_outcontrol1_CAN1 /end REF_MEASUREMENT /end GROUP
/begin GROUP S550_Bit_Shift2 "HANcoder_E407_TTA_Controller_v3/HANcoder STM32 Target - E407-STM32 algorithm/Global Ticks Increment/CAN Management/Matrix Cycle Manager/Controller Matrix Cycle/controller basic cycle 1/COMP Task - Rx_Output_Control1_Check/Process_Messages/Demux message CAN1 and check coherence/Subsystem/Bit Shift2" /begin REF_MEASUREMENT Rx_id_outcontrol1_CAN1 /end REF_MEASUREMENT /end GROUP
/begin GROUP S562_Bit_Shift "HANcoder_E407_TTA_Controller_v3/HANcoder STM32 Target - E407-STM32 algorithm/Global Ticks Increment/CAN Management/Matrix Cycle Manager/Controller Matrix Cycle/controller basic cycle 1/COMP Task - Rx_Output_Control1_Check/Process_Messages/Demux message CAN1 and check coherence1/Subsystem/Bit Shift" /begin REF_MEASUREMENT Rx_bc_outcontrol1_CAN2 /end REF_MEASUREMENT /end GROUP
/begin GROUP S562_Bit_Shift1 "HANcoder_E407_TTA_Controller_v3/HANcoder STM32 Target - E407-STM32 algorithm/Global Ticks Increment/CAN Management/Matrix Cycle Manager/Controller Matrix Cycle/controller basic cycle 1/COMP Task - Rx_Output_Control1_Check/Process_Messages/Demux message CAN1 and check coherence1/Subsystem/Bit Shift1" /begin REF_MEASUREMENT Rx_mc_outcontrol1_CAN2 /end REF_MEASUREMENT /end GROUP
/begin GROUP S562_Bit_Shift2 "HANcoder_E407_TTA_Controller_v3/HANcoder STM32 Target - E407-STM32 algorithm/Global Ticks Increment/CAN Management/Matrix Cycle Manager/Controller Matrix Cycle/controller basic cycle 1/COMP Task - Rx_Output_Control1_Check/Process_Messages/Demux message CAN1 and check coherence1/Subsystem/Bit Shift2" /begin REF_MEASUREMENT Rx_id_outcontrol1_CAN2 /end REF_MEASUREMENT /end GROUP
/begin GROUP S579_Bit_Shift "HANcoder_E407_TTA_Controller_v3/HANcoder STM32 Target - E407-STM32 algorithm/Global Ticks Increment/CAN Management/Matrix Cycle Manager/Controller Matrix Cycle/controller basic cycle 1/COMP Task - Rx_Output_Control2_Check/Process_Messages/Demux message CAN1 and check coherence/Subsystem/Bit Shift" /begin REF_MEASUREMENT Rx_bc_outcontrol2_CAN1 /end REF_MEASUREMENT /end GROUP
/begin GROUP S579_Bit_Shift1 "HANcoder_E407_TTA_Controller_v3/HANcoder STM32 Target - E407-STM32 algorithm/Global Ticks Increment/CAN Management/Matrix Cycle Manager/Controller Matrix Cycle/controller basic cycle 1/COMP Task - Rx_Output_Control2_Check/Process_Messages/Demux message CAN1 and check coherence/Subsystem/Bit Shift1" /begin REF_MEASUREMENT Rx_mc_outcontrol2_CAN1 /end REF_MEASUREMENT /end GROUP
/begin GROUP S579_Bit_Shift2 "HANcoder_E407_TTA_Controller_v3/HANcoder STM32 Target - E407-STM32 algorithm/Global Ticks Increment/CAN Management/Matrix Cycle Manager/Controller Matrix Cycle/controller basic cycle 1/COMP Task - Rx_Output_Control2_Check/Process_Messages/Demux message CAN1 and check coherence/Subsystem/Bit Shift2" /begin REF_MEASUREMENT Rx_id_outcontrol2_CAN1 /end REF_MEASUREMENT /end GROUP
/begin GROUP S591_Bit_Shift "HANcoder_E407_TTA_Controller_v3/HANcoder STM32 Target - E407-STM32 algorithm/Global Ticks Increment/CAN Management/Matrix Cycle Manager/Controller Matrix Cycle/controller basic cycle 1/COMP Task - Rx_Output_Control2_Check/Process_Messages/Demux message CAN1 and check coherence1/Subsystem/Bit Shift" /begin REF_MEASUREMENT Rx_bc_outcontrol2_CAN2 /end REF_MEASUREMENT /end GROUP
/begin GROUP S591_Bit_Shift1 "HANcoder_E407_TTA_Controller_v3/HANcoder STM32 Target - E407-STM32 algorithm/Global Ticks Increment/CAN Management/Matrix Cycle Manager/Controller Matrix Cycle/controller basic cycle 1/COMP Task - Rx_Output_Control2_Check/Process_Messages/Demux message CAN1 and check coherence1/Subsystem/Bit Shift1" /begin REF_MEASUREMENT Rx_mc_outcontrol2_CAN2 /end REF_MEASUREMENT /end GROUP
/begin GROUP S591_Bit_Shift2 "HANcoder_E407_TTA_Controller_v3/HANcoder STM32 Target - E407-STM32 algorithm/Global Ticks Increment/CAN Management/Matrix Cycle Manager/Controller Matrix Cycle/controller basic cycle 1/COMP Task - Rx_Output_Control2_Check/Process_Messages/Demux message CAN1 and check coherence1/Subsystem/Bit Shift2" /begin REF_MEASUREMENT Rx_id_outcontrol2_CAN2 /end REF_MEASUREMENT /end GROUP
/begin GROUP S607_Bit_Shift "HANcoder_E407_TTA_Controller_v3/HANcoder STM32 Target - E407-STM32 algorithm/Global Ticks Increment/CAN Management/Matrix Cycle Manager/Controller Matrix Cycle/controller basic cycle 1/COMP Task - Rx_Output_Emulator_Check/Process_Messages/Demux message CAN1 and check coherence/Subsystem/Bit Shift" /begin REF_MEASUREMENT Rx_bc_outemulator_CAN1 /end REF_MEASUREMENT /end GROUP
/begin GROUP S607_Bit_Shift1 "HANcoder_E407_TTA_Controller_v3/HANcoder STM32 Target - E407-STM32 algorithm/Global Ticks Increment/CAN Management/Matrix Cycle Manager/Controller Matrix Cycle/controller basic cycle 1/COMP Task - Rx_Output_Emulator_Check/Process_Messages/Demux message CAN1 and check coherence/Subsystem/Bit Shift1" /begin REF_MEASUREMENT Rx_mc_outemulator_CAN1 /end REF_MEASUREMENT /end GROUP
/begin GROUP S607_Bit_Shift2 "HANcoder_E407_TTA_Controller_v3/HANcoder STM32 Target - E407-STM32 algorithm/Global Ticks Increment/CAN Management/Matrix Cycle Manager/Controller Matrix Cycle/controller basic cycle 1/COMP Task - Rx_Output_Emulator_Check/Process_Messages/Demux message CAN1 and check coherence/Subsystem/Bit Shift2" /begin REF_MEASUREMENT Rx_id_outemulator_CAN1 /end REF_MEASUREMENT /end GROUP
/begin GROUP S619_Bit_Shift "HANcoder_E407_TTA_Controller_v3/HANcoder STM32 Target - E407-STM32 algorithm/Global Ticks Increment/CAN Management/Matrix Cycle Manager/Controller Matrix Cycle/controller basic cycle 1/COMP Task - Rx_Output_Emulator_Check/Process_Messages/Demux message CAN1 and check coherence1/Subsystem/Bit Shift" /begin REF_MEASUREMENT Rx_bc_outemulator_CAN2 /end REF_MEASUREMENT /end GROUP
/begin GROUP S619_Bit_Shift1 "HANcoder_E407_TTA_Controller_v3/HANcoder STM32 Target - E407-STM32 algorithm/Global Ticks Increment/CAN Management/Matrix Cycle Manager/Controller Matrix Cycle/controller basic cycle 1/COMP Task - Rx_Output_Emulator_Check/Process_Messages/Demux message CAN1 and check coherence1/Subsystem/Bit Shift1" /begin REF_MEASUREMENT Rx_mc_outemulator_CAN2 /end REF_MEASUREMENT /end GROUP
/begin GROUP S619_Bit_Shift2 "HANcoder_E407_TTA_Controller_v3/HANcoder STM32 Target - E407-STM32 algorithm/Global Ticks Increment/CAN Management/Matrix Cycle Manager/Controller Matrix Cycle/controller basic cycle 1/COMP Task - Rx_Output_Emulator_Check/Process_Messages/Demux message CAN1 and check coherence1/Subsystem/Bit Shift2" /begin REF_MEASUREMENT Rx_id_outemulator_CAN2 /end REF_MEASUREMENT /end GROUP
/begin GROUP S636_Bit_Shift "HANcoder_E407_TTA_Controller_v3/HANcoder STM32 Target - E407-STM32 algorithm/Global Ticks Increment/CAN Management/Matrix Cycle Manager/Controller Matrix Cycle/controller basic cycle 1/COMP Task - Rx_Sensor_Values_Check/Process_Messages/Demux message CAN1 and check coherence/Subsystem/Bit Shift" /begin REF_MEASUREMENT Rx_bc_sensorvalues_CAN1 /end REF_MEASUREMENT /end GROUP
/begin GROUP S636_Bit_Shift1 "HANcoder_E407_TTA_Controller_v3/HANcoder STM32 Target - E407-STM32 algorithm/Global Ticks Increment/CAN Management/Matrix Cycle Manager/Controller Matrix Cycle/controller basic cycle 1/COMP Task - Rx_Sensor_Values_Check/Process_Messages/Demux message CAN1 and check coherence/Subsystem/Bit Shift1" /begin REF_MEASUREMENT Rx_mc_sensorvalues_CAN1 /end REF_MEASUREMENT /end GROUP
/begin GROUP S636_Bit_Shift2 "HANcoder_E407_TTA_Controller_v3/HANcoder STM32 Target - E407-STM32 algorithm/Global Ticks Increment/CAN Management/Matrix Cycle Manager/Controller Matrix Cycle/controller basic cycle 1/COMP Task - Rx_Sensor_Values_Check/Process_Messages/Demux message CAN1 and check coherence/Subsystem/Bit Shift2" /begin REF_MEASUREMENT Rx_id_sensorvalues_CAN1 /end REF_MEASUREMENT /end GROUP
/begin GROUP S648_Bit_Shift "HANcoder_E407_TTA_Controller_v3/HANcoder STM32 Target - E407-STM32 algorithm/Global Ticks Increment/CAN Management/Matrix Cycle Manager/Controller Matrix Cycle/controller basic cycle 1/COMP Task - Rx_Sensor_Values_Check/Process_Messages/Demux message CAN1 and check coherence1/Subsystem/Bit Shift" /begin REF_MEASUREMENT Rx_bc_sensorvalues_CAN2 /end REF_MEASUREMENT /end GROUP
/begin GROUP S648_Bit_Shift1 "HANcoder_E407_TTA_Controller_v3/HANcoder STM32 Target - E407-STM32 algorithm/Global Ticks Increment/CAN Management/Matrix Cycle Manager/Controller Matrix Cycle/controller basic cycle 1/COMP Task - Rx_Sensor_Values_Check/Process_Messages/Demux message CAN1 and check coherence1/Subsystem/Bit Shift1" /begin REF_MEASUREMENT Rx_mc_sensorvalues_CAN2 /end REF_MEASUREMENT /end GROUP
/begin GROUP S648_Bit_Shift2 "HANcoder_E407_TTA_Controller_v3/HANcoder STM32 Target - E407-STM32 algorithm/Global Ticks Increment/CAN Management/Matrix Cycle Manager/Controller Matrix Cycle/controller basic cycle 1/COMP Task - Rx_Sensor_Values_Check/Process_Messages/Demux message CAN1 and check coherence1/Subsystem/Bit Shift2" /begin REF_MEASUREMENT Rx_id_sensorvalues_CAN2 /end REF_MEASUREMENT /end GROUP
/begin GROUP S689_Bit_Shift "HANcoder_E407_TTA_Controller_v3/HANcoder STM32 Target - E407-STM32 algorithm/Global Ticks Increment/CAN Management/Matrix Cycle Manager/Controller Matrix Cycle/controller basic cycle 1/COMP Task - Rx_Set_Values_Check/Process_Messages/Demux message CAN1 and check coherence/Subsystem/Bit Shift" /begin REF_MEASUREMENT Rx_bc_setvalues_CAN1 /end REF_MEASUREMENT /end GROUP
/begin GROUP S689_Bit_Shift1 "HANcoder_E407_TTA_Controller_v3/HANcoder STM32 Target - E407-STM32 algorithm/Global Ticks Increment/CAN Management/Matrix Cycle Manager/Controller Matrix Cycle/controller basic cycle 1/COMP Task - Rx_Set_Values_Check/Process_Messages/Demux message CAN1 and check coherence/Subsystem/Bit Shift1" /begin REF_MEASUREMENT Rx_mc_setvalues_CAN1 /end REF_MEASUREMENT /end GROUP
/begin GROUP S689_Bit_Shift2 "HANcoder_E407_TTA_Controller_v3/HANcoder STM32 Target - E407-STM32 algorithm/Global Ticks Increment/CAN Management/Matrix Cycle Manager/Controller Matrix Cycle/controller basic cycle 1/COMP Task - Rx_Set_Values_Check/Process_Messages/Demux message CAN1 and check coherence/Subsystem/Bit Shift2" /begin REF_MEASUREMENT Rx_id_setvalues_CAN1 /end REF_MEASUREMENT /end GROUP
/begin GROUP S701_Bit_Shift "HANcoder_E407_TTA_Controller_v3/HANcoder STM32 Target - E407-STM32 algorithm/Global Ticks Increment/CAN Management/Matrix Cycle Manager/Controller Matrix Cycle/controller basic cycle 1/COMP Task - Rx_Set_Values_Check/Process_Messages/Demux message CAN1 and check coherence1/Subsystem/Bit Shift" /begin REF_MEASUREMENT Rx_bc_setvalues_CAN2 /end REF_MEASUREMENT /end GROUP
/begin GROUP S701_Bit_Shift1 "HANcoder_E407_TTA_Controller_v3/HANcoder STM32 Target - E407-STM32 algorithm/Global Ticks Increment/CAN Management/Matrix Cycle Manager/Controller Matrix Cycle/controller basic cycle 1/COMP Task - Rx_Set_Values_Check/Process_Messages/Demux message CAN1 and check coherence1/Subsystem/Bit Shift1" /begin REF_MEASUREMENT Rx_mc_setvalues_CAN2 /end REF_MEASUREMENT /end GROUP
/begin GROUP S701_Bit_Shift2 "HANcoder_E407_TTA_Controller_v3/HANcoder STM32 Target - E407-STM32 algorithm/Global Ticks Increment/CAN Management/Matrix Cycle Manager/Controller Matrix Cycle/controller basic cycle 1/COMP Task - Rx_Set_Values_Check/Process_Messages/Demux message CAN1 and check coherence1/Subsystem/Bit Shift2" /begin REF_MEASUREMENT Rx_id_setvalues_CAN2 /end REF_MEASUREMENT /end GROUP
/begin GROUP S734_Bit_Shift "HANcoder_E407_TTA_Controller_v3/HANcoder STM32 Target - E407-STM32 algorithm/Global Ticks Increment/CAN Management/Matrix Cycle Manager/Controller Matrix Cycle/controller basic cycle 1/COMP Task - Sync bc1 check/Process_Messages/Demux message CAN1 and check coherence/Subsystem/Bit Shift" /begin REF_MEASUREMENT Rx_bc_sync1_CAN1 /end REF_MEASUREMENT /end GROUP
/begin GROUP S734_Bit_Shift1 "HANcoder_E407_TTA_Controller_v3/HANcoder STM32 Target - E407-STM32 algorithm/Global Ticks Increment/CAN Management/Matrix Cycle Manager/Controller Matrix Cycle/controller basic cycle 1/COMP Task - Sync bc1 check/Process_Messages/Demux message CAN1 and check coherence/Subsystem/Bit Shift1" /begin REF_MEASUREMENT Rx_mc_sync1_CAN1 /end REF_MEASUREMENT /end GROUP
/begin GROUP S734_Bit_Shift2 "HANcoder_E407_TTA_Controller_v3/HANcoder STM32 Target - E407-STM32 algorithm/Global Ticks Increment/CAN Management/Matrix Cycle Manager/Controller Matrix Cycle/controller basic cycle 1/COMP Task - Sync bc1 check/Process_Messages/Demux message CAN1 and check coherence/Subsystem/Bit Shift2" /begin REF_MEASUREMENT Rx_id_sync1_CAN1 /end REF_MEASUREMENT /end GROUP
/begin GROUP S746_Bit_Shift "HANcoder_E407_TTA_Controller_v3/HANcoder STM32 Target - E407-STM32 algorithm/Global Ticks Increment/CAN Management/Matrix Cycle Manager/Controller Matrix Cycle/controller basic cycle 1/COMP Task - Sync bc1 check/Process_Messages/Demux message CAN1 and check coherence1/Subsystem/Bit Shift" /begin REF_MEASUREMENT Rx_bc_sync1_CAN2 /end REF_MEASUREMENT /end GROUP
/begin GROUP S746_Bit_Shift1 "HANcoder_E407_TTA_Controller_v3/HANcoder STM32 Target - E407-STM32 algorithm/Global Ticks Increment/CAN Management/Matrix Cycle Manager/Controller Matrix Cycle/controller basic cycle 1/COMP Task - Sync bc1 check/Process_Messages/Demux message CAN1 and check coherence1/Subsystem/Bit Shift1" /begin REF_MEASUREMENT Rx_mc_sync1_CAN2 /end REF_MEASUREMENT /end GROUP
/begin GROUP S746_Bit_Shift2 "HANcoder_E407_TTA_Controller_v3/HANcoder STM32 Target - E407-STM32 algorithm/Global Ticks Increment/CAN Management/Matrix Cycle Manager/Controller Matrix Cycle/controller basic cycle 1/COMP Task - Sync bc1 check/Process_Messages/Demux message CAN1 and check coherence1/Subsystem/Bit Shift2" /begin REF_MEASUREMENT Rx_id_sync1_CAN2 /end REF_MEASUREMENT /end GROUP
/begin GROUP S896_Bit_Shift "HANcoder_E407_TTA_Controller_v3/HANcoder STM32 Target - E407-STM32 algorithm/Global Ticks Increment/CAN Management/Matrix Cycle Manager/Input Generator Matrix Cycle/input generator basic cycle 0/COMP Task - Sync bc0 check/Process_Messages/Demux message CAN1 and check coherence/Subsystem/Bit Shift" /begin REF_MEASUREMENT Rx_bc_sync0_CAN1_ing /end REF_MEASUREMENT /end GROUP
/begin GROUP S896_Bit_Shift1 "HANcoder_E407_TTA_Controller_v3/HANcoder STM32 Target - E407-STM32 algorithm/Global Ticks Increment/CAN Management/Matrix Cycle Manager/Input Generator Matrix Cycle/input generator basic cycle 0/COMP Task - Sync bc0 check/Process_Messages/Demux message CAN1 and check coherence/Subsystem/Bit Shift1" /begin REF_MEASUREMENT Rx_mc_sync0_CAN1_ing /end REF_MEASUREMENT /end GROUP
/begin GROUP S896_Bit_Shift2 "HANcoder_E407_TTA_Controller_v3/HANcoder STM32 Target - E407-STM32 algorithm/Global Ticks Increment/CAN Management/Matrix Cycle Manager/Input Generator Matrix Cycle/input generator basic cycle 0/COMP Task - Sync bc0 check/Process_Messages/Demux message CAN1 and check coherence/Subsystem/Bit Shift2" /begin REF_MEASUREMENT Rx_id_sync0_CAN1_ing /end REF_MEASUREMENT /end GROUP
/begin GROUP S908_Bit_Shift "HANcoder_E407_TTA_Controller_v3/HANcoder STM32 Target - E407-STM32 algorithm/Global Ticks Increment/CAN Management/Matrix Cycle Manager/Input Generator Matrix Cycle/input generator basic cycle 0/COMP Task - Sync bc0 check/Process_Messages/Demux message CAN1 and check coherence1/Subsystem/Bit Shift" /begin REF_MEASUREMENT Rx_bc_sync0_CAN2_ing /end REF_MEASUREMENT /end GROUP
/begin GROUP S908_Bit_Shift1 "HANcoder_E407_TTA_Controller_v3/HANcoder STM32 Target - E407-STM32 algorithm/Global Ticks Increment/CAN Management/Matrix Cycle Manager/Input Generator Matrix Cycle/input generator basic cycle 0/COMP Task - Sync bc0 check/Process_Messages/Demux message CAN1 and check coherence1/Subsystem/Bit Shift1" /begin REF_MEASUREMENT Rx_mc_sync0_CAN2_ing /end REF_MEASUREMENT /end GROUP
/begin GROUP S908_Bit_Shift2 "HANcoder_E407_TTA_Controller_v3/HANcoder STM32 Target - E407-STM32 algorithm/Global Ticks Increment/CAN Management/Matrix Cycle Manager/Input Generator Matrix Cycle/input generator basic cycle 0/COMP Task - Sync bc0 check/Process_Messages/Demux message CAN1 and check coherence1/Subsystem/Bit Shift2" /begin REF_MEASUREMENT Rx_id_sync0_CAN2_ing /end REF_MEASUREMENT /end GROUP
/begin GROUP S997_Bit_Shift "HANcoder_E407_TTA_Controller_v3/HANcoder STM32 Target - E407-STM32 algorithm/Global Ticks Increment/CAN Management/Matrix Cycle Manager/Input Generator Matrix Cycle/input generator basic cycle 1/COMP Task - Sync bc1 check/Process_Messages/Demux message CAN1 and check coherence/Subsystem/Bit Shift" /begin REF_MEASUREMENT Rx_bc_sync1_CAN1_ing /end REF_MEASUREMENT /end GROUP
/begin GROUP S997_Bit_Shift1 "HANcoder_E407_TTA_Controller_v3/HANcoder STM32 Target - E407-STM32 algorithm/Global Ticks Increment/CAN Management/Matrix Cycle Manager/Input Generator Matrix Cycle/input generator basic cycle 1/COMP Task - Sync bc1 check/Process_Messages/Demux message CAN1 and check coherence/Subsystem/Bit Shift1" /begin REF_MEASUREMENT Rx_mc_sync1_CAN1_ing /end REF_MEASUREMENT /end GROUP
/begin GROUP S997_Bit_Shift2 "HANcoder_E407_TTA_Controller_v3/HANcoder STM32 Target - E407-STM32 algorithm/Global Ticks Increment/CAN Management/Matrix Cycle Manager/Input Generator Matrix Cycle/input generator basic cycle 1/COMP Task - Sync bc1 check/Process_Messages/Demux message CAN1 and check coherence/Subsystem/Bit Shift2" /begin REF_MEASUREMENT Rx_id_sync1_CAN1_ing /end REF_MEASUREMENT /end GROUP
/begin GROUP S1009_Bit_Shift "HANcoder_E407_TTA_Controller_v3/HANcoder STM32 Target - E407-STM32 algorithm/Global Ticks Increment/CAN Management/Matrix Cycle Manager/Input Generator Matrix Cycle/input generator basic cycle 1/COMP Task - Sync bc1 check/Process_Messages/Demux message CAN1 and check coherence1/Subsystem/Bit Shift" /begin REF_MEASUREMENT Rx_bc_sync1_CAN2_ing /end REF_MEASUREMENT /end GROUP
/begin GROUP S1009_Bit_Shift1 "HANcoder_E407_TTA_Controller_v3/HANcoder STM32 Target - E407-STM32 algorithm/Global Ticks Increment/CAN Management/Matrix Cycle Manager/Input Generator Matrix Cycle/input generator basic cycle 1/COMP Task - Sync bc1 check/Process_Messages/Demux message CAN1 and check coherence1/Subsystem/Bit Shift1" /begin REF_MEASUREMENT Rx_mc_sync1_CAN2_ing /end REF_MEASUREMENT /end GROUP
/begin GROUP S1009_Bit_Shift2 "HANcoder_E407_TTA_Controller_v3/HANcoder STM32 Target - E407-STM32 algorithm/Global Ticks Increment/CAN Management/Matrix Cycle Manager/Input Generator Matrix Cycle/input generator basic cycle 1/COMP Task - Sync bc1 check/Process_Messages/Demux message CAN1 and check coherence1/Subsystem/Bit Shift2" /begin REF_MEASUREMENT Rx_id_sync1_CAN2_ing /end REF_MEASUREMENT /end GROUP
/begin GROUP S1075_Bit_Shift "HANcoder_E407_TTA_Controller_v3/HANcoder STM32 Target - E407-STM32 algorithm/Global Ticks Increment/CAN Management/Matrix Cycle Manager/Vehicle Emulator Matrix Cycle/vehicle emulator basic cycle 0/COMP Task - Sync bc0 check/Process_Messages/Demux message CAN1 and check coherence/Subsystem/Bit Shift" /begin REF_MEASUREMENT Rx_bc_sync0_CAN1_vem /end REF_MEASUREMENT /end GROUP
/begin GROUP S1075_Bit_Shift1 "HANcoder_E407_TTA_Controller_v3/HANcoder STM32 Target - E407-STM32 algorithm/Global Ticks Increment/CAN Management/Matrix Cycle Manager/Vehicle Emulator Matrix Cycle/vehicle emulator basic cycle 0/COMP Task - Sync bc0 check/Process_Messages/Demux message CAN1 and check coherence/Subsystem/Bit Shift1" /begin REF_MEASUREMENT Rx_mc_sync0_CAN1_vem /end REF_MEASUREMENT /end GROUP
/begin GROUP S1075_Bit_Shift2 "HANcoder_E407_TTA_Controller_v3/HANcoder STM32 Target - E407-STM32 algorithm/Global Ticks Increment/CAN Management/Matrix Cycle Manager/Vehicle Emulator Matrix Cycle/vehicle emulator basic cycle 0/COMP Task - Sync bc0 check/Process_Messages/Demux message CAN1 and check coherence/Subsystem/Bit Shift2" /begin REF_MEASUREMENT Rx_id_sync0_CAN1_vem /end REF_MEASUREMENT /end GROUP
/begin GROUP S1087_Bit_Shift "HANcoder_E407_TTA_Controller_v3/HANcoder STM32 Target - E407-STM32 algorithm/Global Ticks Increment/CAN Management/Matrix Cycle Manager/Vehicle Emulator Matrix Cycle/vehicle emulator basic cycle 0/COMP Task - Sync bc0 check/Process_Messages/Demux message CAN1 and check coherence1/Subsystem/Bit Shift" /begin REF_MEASUREMENT Rx_bc_sync0_CAN2_vem /end REF_MEASUREMENT /end GROUP
/begin GROUP S1087_Bit_Shift1 "HANcoder_E407_TTA_Controller_v3/HANcoder STM32 Target - E407-STM32 algorithm/Global Ticks Increment/CAN Management/Matrix Cycle Manager/Vehicle Emulator Matrix Cycle/vehicle emulator basic cycle 0/COMP Task - Sync bc0 check/Process_Messages/Demux message CAN1 and check coherence1/Subsystem/Bit Shift1" /begin REF_MEASUREMENT Rx_mc_sync0_CAN2_vem /end REF_MEASUREMENT /end GROUP
/begin GROUP S1087_Bit_Shift2 "HANcoder_E407_TTA_Controller_v3/HANcoder STM32 Target - E407-STM32 algorithm/Global Ticks Increment/CAN Management/Matrix Cycle Manager/Vehicle Emulator Matrix Cycle/vehicle emulator basic cycle 0/COMP Task - Sync bc0 check/Process_Messages/Demux message CAN1 and check coherence1/Subsystem/Bit Shift2" /begin REF_MEASUREMENT Rx_id_sync0_CAN2_vem /end REF_MEASUREMENT /end GROUP
/begin GROUP S1219_Bit_Shift "HANcoder_E407_TTA_Controller_v3/HANcoder STM32 Target - E407-STM32 algorithm/Global Ticks Increment/CAN Management/Matrix Cycle Manager/Vehicle Emulator Matrix Cycle/vehicle emulator basic cycle 1/COMP Task - Rx Output Emulator Check/Process_Messages/Demux message CAN1 and check coherence/Subsystem/Bit Shift" /begin REF_MEASUREMENT Rx_bc_sensorvalues_CAN1_vem /end REF_MEASUREMENT /end GROUP
/begin GROUP S1219_Bit_Shift1 "HANcoder_E407_TTA_Controller_v3/HANcoder STM32 Target - E407-STM32 algorithm/Global Ticks Increment/CAN Management/Matrix Cycle Manager/Vehicle Emulator Matrix Cycle/vehicle emulator basic cycle 1/COMP Task - Rx Output Emulator Check/Process_Messages/Demux message CAN1 and check coherence/Subsystem/Bit Shift1" /begin REF_MEASUREMENT Rx_mc_sensorvalues_CAN1_vem /end REF_MEASUREMENT /end GROUP
/begin GROUP S1219_Bit_Shift2 "HANcoder_E407_TTA_Controller_v3/HANcoder STM32 Target - E407-STM32 algorithm/Global Ticks Increment/CAN Management/Matrix Cycle Manager/Vehicle Emulator Matrix Cycle/vehicle emulator basic cycle 1/COMP Task - Rx Output Emulator Check/Process_Messages/Demux message CAN1 and check coherence/Subsystem/Bit Shift2" /begin REF_MEASUREMENT Rx_id_sensorvalues_CAN1_vem /end REF_MEASUREMENT /end GROUP
/begin GROUP S1231_Bit_Shift "HANcoder_E407_TTA_Controller_v3/HANcoder STM32 Target - E407-STM32 algorithm/Global Ticks Increment/CAN Management/Matrix Cycle Manager/Vehicle Emulator Matrix Cycle/vehicle emulator basic cycle 1/COMP Task - Rx Output Emulator Check/Process_Messages/Demux message CAN1 and check coherence1/Subsystem/Bit Shift" /begin REF_MEASUREMENT Rx_bc_sensorvalues_CAN2_vem /end REF_MEASUREMENT /end GROUP
/begin GROUP S1231_Bit_Shift1 "HANcoder_E407_TTA_Controller_v3/HANcoder STM32 Target - E407-STM32 algorithm/Global Ticks Increment/CAN Management/Matrix Cycle Manager/Vehicle Emulator Matrix Cycle/vehicle emulator basic cycle 1/COMP Task - Rx Output Emulator Check/Process_Messages/Demux message CAN1 and check coherence1/Subsystem/Bit Shift1" /begin REF_MEASUREMENT Rx_mc_sensorvalues_CAN2_vem /end REF_MEASUREMENT /end GROUP
/begin GROUP S1231_Bit_Shift2 "HANcoder_E407_TTA_Controller_v3/HANcoder STM32 Target - E407-STM32 algorithm/Global Ticks Increment/CAN Management/Matrix Cycle Manager/Vehicle Emulator Matrix Cycle/vehicle emulator basic cycle 1/COMP Task - Rx Output Emulator Check/Process_Messages/Demux message CAN1 and check coherence1/Subsystem/Bit Shift2" /begin REF_MEASUREMENT Rx_id_sensorvalues_CAN2_vem /end REF_MEASUREMENT /end GROUP
/begin GROUP S1270_Bit_Shift "HANcoder_E407_TTA_Controller_v3/HANcoder STM32 Target - E407-STM32 algorithm/Global Ticks Increment/CAN Management/Matrix Cycle Manager/Vehicle Emulator Matrix Cycle/vehicle emulator basic cycle 1/COMP Task - Sync bc1 check/Process_Messages/Demux message CAN1 and check coherence/Subsystem/Bit Shift" /begin REF_MEASUREMENT Rx_bc_sync1_CAN1_vem /end REF_MEASUREMENT /end GROUP
/begin GROUP S1270_Bit_Shift1 "HANcoder_E407_TTA_Controller_v3/HANcoder STM32 Target - E407-STM32 algorithm/Global Ticks Increment/CAN Management/Matrix Cycle Manager/Vehicle Emulator Matrix Cycle/vehicle emulator basic cycle 1/COMP Task - Sync bc1 check/Process_Messages/Demux message CAN1 and check coherence/Subsystem/Bit Shift1" /begin REF_MEASUREMENT Rx_mc_sync1_CAN1_vem /end REF_MEASUREMENT /end GROUP
/begin GROUP S1270_Bit_Shift2 "HANcoder_E407_TTA_Controller_v3/HANcoder STM32 Target - E407-STM32 algorithm/Global Ticks Increment/CAN Management/Matrix Cycle Manager/Vehicle Emulator Matrix Cycle/vehicle emulator basic cycle 1/COMP Task - Sync bc1 check/Process_Messages/Demux message CAN1 and check coherence/Subsystem/Bit Shift2" /begin REF_MEASUREMENT Rx_id_sync1_CAN1_vem /end REF_MEASUREMENT /end GROUP
/begin GROUP S1282_Bit_Shift "HANcoder_E407_TTA_Controller_v3/HANcoder STM32 Target - E407-STM32 algorithm/Global Ticks Increment/CAN Management/Matrix Cycle Manager/Vehicle Emulator Matrix Cycle/vehicle emulator basic cycle 1/COMP Task - Sync bc1 check/Process_Messages/Demux message CAN1 and check coherence1/Subsystem/Bit Shift" /begin REF_MEASUREMENT Rx_bc_sync1_CAN2_vem /end REF_MEASUREMENT /end GROUP
/begin GROUP S1282_Bit_Shift1 "HANcoder_E407_TTA_Controller_v3/HANcoder STM32 Target - E407-STM32 algorithm/Global Ticks Increment/CAN Management/Matrix Cycle Manager/Vehicle Emulator Matrix Cycle/vehicle emulator basic cycle 1/COMP Task - Sync bc1 check/Process_Messages/Demux message CAN1 and check coherence1/Subsystem/Bit Shift1" /begin REF_MEASUREMENT Rx_mc_sync1_CAN2_vem /end REF_MEASUREMENT /end GROUP
/begin GROUP S1282_Bit_Shift2 "HANcoder_E407_TTA_Controller_v3/HANcoder STM32 Target - E407-STM32 algorithm/Global Ticks Increment/CAN Management/Matrix Cycle Manager/Vehicle Emulator Matrix Cycle/vehicle emulator basic cycle 1/COMP Task - Sync bc1 check/Process_Messages/Demux message CAN1 and check coherence1/Subsystem/Bit Shift2" /begin REF_MEASUREMENT Rx_id_sync1_CAN2_vem /end REF_MEASUREMENT /end GROUP
/end MODULE
/end PROJECT
/* (add any file trailer comments here) */
/* EOF HANcoder_E407_TTA_Controller_v3.a2l */
